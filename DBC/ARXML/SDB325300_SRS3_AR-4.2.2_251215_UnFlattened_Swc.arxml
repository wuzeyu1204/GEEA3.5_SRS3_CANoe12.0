[part 2 of 2: packages /PortInterfaces to /EndToEnds]
AUTOSAR XML (schema 4-2-2)
package /PortInterfaces
  156 x sender receiver interface:
    VehMtnSt_10
      data VehMtnSt: type=VehMtnStSafe1_2
    VehSpdLgt_15
      data VehSpdLgt: type=VehSpdLgtSafe1_3
    WhlDirRotlFrnt_3
      data WhlDirRotlFrnt: type=WhlDirRotlFrnt_2
    WhlDirRotlRe_9
      data WhlDirRotlRe: type=WhlDirRotlRe_3
    WhlSpdCircumlFrnt_10
      data WhlSpdCircumlFrnt: type=WhlSpdCircumlFrntRec1_3
    WhlSpdCircumlRe_9
      data WhlSpdCircumlRe: type=WhlSpdCircumlReRec1_2
    AbsCtrlActv_9
      data AbsCtrlActv: type=AbsCtrlActv_1
    AbsSts_6
      data AbsSts: type=DevErrSts2_2
    BrkAndAbsWarnIndcnReq_7
      data BrkAndAbsWarnIndcnReq: type=BrkAndAbsWarnIndcnReqRec1_2
    BrkFricTqTotAtWhlsAct_8
      data BrkFricTqTotAtWhlsAct: type=BrkFricTqTotAtWhlsActRec1_2
    BrkSysCylPMst_7
      data BrkSysCylPMst: type=BrkSysCylPMstRec1_2
    BrkTqAtWhlsReq_6
      data BrkTqAtWhlsReq: type=Tq32_2
    BrkTracCtrlActv_7
      data BrkTracCtrlActv: type=CtrlSts1_2
    EscCtrlIndcn_8
      data EscCtrlIndcn: type=DevSts1_2
    EscSt_8
      data EscSt: type=EscStSafe1_2
    PostImpctBrkgRdy_5
      data PostImpctBrkgRdy: type=PostImpctBrkgRdy_2
    EpbSts_5
      data EpbSts: type=EpbStsRec1_2
    BrkPedlPsd_7
      data BrkPedlPsd: type=BrkPedlPsdRec_2
    BrkPedlrRat_5
      data BrkPedlrRat: type=BrkPedlrRatRec_1
    ADataRawSafe_8
      data ADataRawSafe: type=ADataRawSafe1_2
    AccrPedlRat_7
      data AccrPedlRat: type=AccrPedlRatGrp_1
    AgDataRawSafe_6
      data AgDataRawSafe: type=AgDataRawSafe1_2
    GearLvrIndcn_6
      data GearLvrIndcn: type=GearLvrIndcn2_2
    JID_6
      data JID: type=UInt64Rec_2
    PinionSteerAgGroup_2
      data PinionSteerAgGroup: type=PinionSteerAgGroupRec_1
    VehModMngtGlbSafe1_7
      data VehModMngtGlbSafe1: type=VehModMngtGlbSafe1_2
    WhlMotSysSpdAct_5
      data WhlMotSysSpdAct: type=MotSpd_1
    DoorDrvrSts_5
      data DoorDrvrSts: type=DoorSts2_2
    AgDataRaw2Safe_5
      data AgDataRaw2Safe: type=AgDataRaw2Safe_1
    BrkPedlSts_4
      data BrkPedlSts: type=OkNotOk1_2
    RecOfPostImpctBrkgCfmd_6
      data RecOfPostImpctBrkgCfmd: type=PostImpctBrkgCfmdSafe1_3
    RecOfPostImpctBrkgSuspc_4
      data RecOfPostImpctBrkgSuspc: type=PostImpctBrkgSuspcSafe1_2
    BltLockStAtDrvr_6
      data BltLockStAtDrvr: type=BltLockStFrnt_2
    VehCfgPrm_5
      data VehCfgPrm: type=VehCfgPrm_3
    BkpOfDstTrvld_7
      data BkpOfDstTrvld: type=Len31_2
    Vin_6
      data Vin: type=Vin1_3
    CarTiGlb_5
      data CarTiGlb: type=CarTiGlb_2
    VehBattU_8
      data VehBattU: type=SysU_4
    TiAndDateIndcn_5
      data TiAndDateIndcn: type=DateTi30_2
    VehCfgPrmExt_2
      data VehCfgPrmExt: type=VehCfgPrm_3
    VehCfgPrmExt2_1
      data VehCfgPrmExt2: type=VehCfgPrm_3
    AsyDataWithCmpSafe_5
      data AsyDataWithCmpSafe: type=AsyDataWithCmpSafe1_2
    CrsCtrlrSts_3
      data CrsCtrlrSts: type=CrsCtrlrSts1_2
    EngNSafe_7
      data EngNSafe: type=EngNSafe_2
    IsgSpdActSgn_8
      data IsgSpdActSgn: type=MotSpd_1
    ThrPos_3
      data ThrPos: type=Perc2_2
    SftyDecelGroupSafe_5a1
      data SftyDecelGroupSafe: type=SftyDecelGroupSafe1_3
    AsyALgtSts_5
      data AsyALgtSts: type=AsyALgtStsGrp_3
    CrashStsSafe_2
      data CrashStsSafe: type=CrashStsSafe_1
    HVfault_1
      data HVfault: type=Boolean_2
    DoorLeReSts_6
      data DoorLeReSts: type=DoorSts2_2
    DoorPassSts_5
      data DoorPassSts: type=DoorSts2_2
    DoorRiReSts_6
      data DoorRiReSts: type=DoorSts2_2
    VehTiAndData_4
      data VehTiAndData: type=DateTi30_2
    AgDataCmpQuality_3
      data AgDataCmpQuality: type=AgDataCmpQuality1_2
    BltLockStAtPass_5
      data BltLockStAtPass: type=BltLockStFrnt_2
    BltLockStAtRowSecLe_5
      data BltLockStAtRowSecLe: type=BltLockStRe_2
    BltLockStAtRowSecMid_5
      data BltLockStAtRowSecMid: type=BltLockStRe_2
    BltLockStAtRowSecRi_5
      data BltLockStAtRowSecRi: type=BltLockStRe_2
    BltLockStAtRowThrdLe_5
      data BltLockStAtRowThrdLe: type=BltLockStRe_2
    BltLockStAtRowThrdMid_1
      data BltLockStAtRowThrdMid: type=BltLockStRe_2
    BltLockStAtRowThrdRi_5
      data BltLockStAtRowThrdRi: type=BltLockStRe_2
    BltLockStSafeAtDrvr_8
      data BltLockStSafeAtDrvr: type=BltLockStSafe2_4
    CrashSts2_11
      data CrashSts2: type=CrashSts4_1
    NotifForEmgyCall_4
      data NotifForEmgyCall: type=Boolean_2
    PassAirbLampReq_5
      data PassAirbLampReq: type=PassAirbLampReqRec1_2
    PedProtnMsgReqForFlt_4
      data PedProtnMsgReqForFlt: type=OnOffCrit1_2
    PedProtnMsgReqForImpct_4
      data PedProtnMsgReqForImpct: type=OnOff1_2
    RecOfImpct_7
      data RecOfImpct: type=RecOfImpct1_3
    RestrntSysLampReq_4
      data RestrntSysLampReq: type=RestrntSysLampReq_2
    RestrntSysMsgReq_4
      data RestrntSysMsgReq: type=OnOffCrit1_2
    SafetyCrashFb_5
      data SafetyCrashFb: type=CrashFb_2
    SeatOccptAtRowThrdMid_1
      data SeatOccptAtRowThrdMid: type=PassSeatSts1_2
    BltLockStAtPassMid_1
      data BltLockStAtPassMid: type=BltLockStRe_2
    BltLockStAtRowFrthLe_1
      data BltLockStAtRowFrthLe: type=BltLockStRe_2
    BltLockStAtRowFrthMid_1
      data BltLockStAtRowFrthMid: type=BltLockStRe_2
    BltLockStAtRowFrthRi_1
      data BltLockStAtRowFrthRi: type=BltLockStRe_2
    PassMidSeatSts_1
      data PassMidSeatSts: type=PassSeatSts1_2
    SeatOccptAtRowFrthLe_1
      data SeatOccptAtRowFrthLe: type=PassSeatSts1_2
    SeatOccptAtRowFrthMid_1
      data SeatOccptAtRowFrthMid: type=PassSeatSts1_2
    SeatOccptAtRowFrthRi_1
      data SeatOccptAtRowFrthRi: type=PassSeatSts1_2
    RecOfImpct2_2
      data RecOfImpct2: type=RecOfImpct2_1
    ReqForHzrdInt_1
      data ReqForHzrdInt: type=ReqForHzrdInt_1
    VFCVectorSRS_9a1
      data VFCVectorSRS: type=VFCVector_6
    WakeUpReasonsforSRS_2
      data WakeUpReasonsforSRS: type=WakeUpReasons_4
    DstTrvldFromSftyBkp_2
      data DstTrvldFromSftyBkp: type=Len31_2
    DstTrvldVldFromSftyBkp_2
      data DstTrvldVldFromSftyBkp: type=InvldVld1_2
    ActvnReqOfRtrctrRvsbLe_2
      data ActvnReqOfRtrctrRvsbLe: type=ActvnReqOfRtrctrRvsb1_2
    ActvnReqOfRtrctrRvsbRi_2
      data ActvnReqOfRtrctrRvsbRi: type=ActvnReqOfRtrctrRvsb1_2
    BltCrashNotif_4
      data BltCrashNotif: type=BltCrashNotif_2
    PassAirbSts_5
      data PassAirbSts: type=OnOff2_2
    SRSdevelpsignalgroupTX_3
      data SRSdevelpsignalgroupTX: type=Develp1_1
    SRSResdSig1ToZCUDMSafety_1
      data SRSResdSig1ToZCUDMSafety: type=ResdDataType2_1
    SRSIntVolt_1
      data SRSIntVolt: type=U55_1
    SftyAirbRollovrSuppSts_1
      data SftyAirbRollovrSuppSts: type=OnOff1_2
    ReqForAsyDataStorgFromRestrntSys_1
      data ReqForAsyDataStorgFromRestrntSys: type=Boolean_2
    IntgtIMUDataRawSafe_1
      data IntgtIMUDataRawSafe: type=IntgtIMUDataRawSafe_1
    PassAirbStsChgNotifReq_1
      data PassAirbStsChgNotifReq: type=ReqForDisp_2
    AccrpedlSts_6
      data AccrpedlSts: type=FltStsSafe_1
    AmbTIndcdWithUnit_3
      data AmbTIndcdWithUnit: type=AmbTIndcdWithUnit_2
    AsyAutDrvCtrlTyp_7
      data AsyAutDrvCtrlTyp: type=AsyAutDrvCtrlTyp_4
    CarModCrashSaved_4
      data CarModCrashSaved: type=NoYes1_2
    CllsnAidPost_2
      data CllsnAidPost: type=OnOff1_2
    CllsnMtgtnFctSts_4
      data CllsnMtgtnFctSts: type=CllsnMtgtnFctSts_2
    CrsCtrlrActvnOk_3
      data CrsCtrlrActvnOk: type=OnOff1_2
    CrsCtrlrStbOk_2
      data CrsCtrlrStbOk: type=OnOff1_2
    DispOfPrpsnModForEv_2
      data DispOfPrpsnModForEv: type=DispOfPrpsnModForEv_2
    DoorDrvrLockSts_5
      data DoorDrvrLockSts: type=LockSts2_2
    DoorLeReLockSts_6
      data DoorLeReLockSts: type=LockSts2_2
    DoorPassLockSts_5
      data DoorPassLockSts: type=LockSts2_2
    DoorRiReLockSts_6
      data DoorRiReLockSts: type=LockSts2_2
    DrvrCrsCtrlFctSeld_8
      data DrvrCrsCtrlFctSeld: type=DrvrCrsCtrlFctSeldTyp_5
    DrvrSeatPosPerc_4
      data DrvrSeatPosPerc: type=SeatPosPercQF_3
    EngN2_4
      data EngN2: type=N30_2
    LeFrntTireMsg_6
      data LeFrntTireMsg: type=TireMsg_3
    LeReTireMsg_6
      data LeReTireMsg: type=TireMsg_3
    PassAirbLampStsRec_5
      data PassAirbLampStsRec: type=PassAirbLampStsRec_2
    PassSeatPosPerc_4
      data PassSeatPosPerc: type=SeatPosPercQF_3
    PosnBrief_3
      data PosnBrief: type=Posn_1
    ReqForPassAirbIndcnAckd_2
      data ReqForPassAirbIndcnAckd: type=ReqForPassAirbIndcnAckd_2
    RiFrntTireMsg_5
      data RiFrntTireMsg: type=TireMsg_3
    RiReTireMsg_6
      data RiReTireMsg: type=TireMsg_3
    RlyPwrDistbnCmd1WdIgnRlyCmd_6
      data RlyPwrDistbnCmd1WdIgnRlyCmd: type=OnOff1_2
    RlyPwrDistbnCmd1WdIgnRlyExtCmd_6
      data RlyPwrDistbnCmd1WdIgnRlyExtCmd: type=OnOff1_2
    TrsmActrPosnSafe_6
      data TrsmActrPosnSafe: type=TrsmActrPosnSafe1_3
    PinionSteerAgMax1_5
      data PinionSteerAgMax1: type=Ag4_2
    DispOfPrpsnMod_7
      data DispOfPrpsnMod: type=DispOfPrpsnMod4_3
    EmgyAsscTrigSts_2
      data EmgyAsscTrigSts: type=AfsStsReq_7
    SwtLiHzrdWarn_2
      data SwtLiHzrdWarn: type=PsdNotPsd_2
    SwtIndcr_4
      data SwtIndcr: type=IndcrTurnReq_2
    CllsnFwdWarn_2
      data CllsnFwdWarn: type=CllsnFwdWarnReq_1
    ActvnStsOfRtrctrRvsbLe_5
      data ActvnStsOfRtrctrRvsbLe: type=Enumeration1_2
    PreCrashFrontData_5
      data PreCrashFrontData: type=PreCrashData_3
    StsForRtrctrRvsbLe_5
      data StsForRtrctrRvsbLe: type=NotOkOk_2
    VehHomePrkgSysSts_4
      data VehHomePrkgSysSts: type=HomePrkgSysSts1_2
    Overlap_1
      data Overlap: type=PercSign1_2
    VehSpdIndcd_3
      data VehSpdIndcd: type=VehSpdIndcd1_2
    SRSdevelpsignalgroupRX_3
      data SRSdevelpsignalgroupRX: type=Develp1_1
    PrkgStsToEDR_1
      data PrkgStsToEDR: type=PrkgStsToEDR_1
    AsySftyFctStsToEDR_1
      data AsySftyFctStsToEDR: type=AsySftyFctStsToEDR_1
    ZCUDMResdSig1ToSRSSafety_1
      data ZCUDMResdSig1ToSRSSafety: type=ResdDataType2_1
    ActvnStsOfRtrctrRvsbRi_6
      data ActvnStsOfRtrctrRvsbRi: type=Enumeration1_2
    StsForRtrctrRvsbRi_6
      data StsForRtrctrRvsbRi: type=NotOkOk_2
    SftyAirbRollovrSuppSwt_1
      data SftyAirbRollovrSuppSwt: type=OnOffNoReq_2
    SumActv_5
      data SumActv: type=Boolean_2
    EfuseKL15Req1_1
      data EfuseKL15Req1: type=OnOff1_2
    EfuseKL15Req2_1
      data EfuseKL15Req2: type=OnOff1_2
    EfuseKL15Req3_1
      data EfuseKL15Req3: type=OnOff1_2
    EfuseKL15Req4_1
      data EfuseKL15Req4: type=OnOff1_2
    EfuseKL15Req5_1
      data EfuseKL15Req5: type=OnOff1_2
    CrsCtrlrMsg_2
      data CrsCtrlrMsg: type=CrsCtrlrMsg1_2
    TurnIndcrAndHwlByDrvInt_1
      data TurnIndcrAndHwlByDrvInt: type=IndcrSts1_2
    PassAirbNotiConfirm_1
      data PassAirbNotiConfirm: type=Onoff3_1
    PassStuMonSts_1
      data PassStuMonSts: type=UInt4_2
    DrvrStuMonSts_1
      data DrvrStuMonSts: type=UInt4_2
    HoodSts_5
      data HoodSts: type=DoorSts2_2
package /ApplicationDataTypes
  4 x app type, all with category=VALUE:
    GenQf1_2: compu-method=GenQf1_1, range raw 0..3
    UInt8_2: compu {identical; unit Unitless}, range phys 0..255 Unitless
    UInt4_2: compu {identical; unit Unitless}, range phys 0..15 Unitless
    NoYes1_2: compu {0=NoYes1_No, 1=NoYes1_Yes; unit Unitless}, range raw 0..1
  application record data type VehMtnStSafe1_2: category=STRUCTURE
    application record element VehMtnSt: category=VALUE, type=VehMtnSt2_2
    application record element VehMtnStChks: category=VALUE, type=UInt8_2
    application record element VehMtnStCntr: category=VALUE, type=UInt4_2
  app type VehMtnSt2_2: category=VALUE, compu-method=VehMtnSt2_1, range raw 0..7
  application record data type VehSpdLgtSafe1_3: category=STRUCTURE
    4 x application record element, all with category=VALUE:
      VehSpdLgtA: type=Spd1_2
      VehSpdLgtQf: type=GenQf1_2
      VehSpdLgtCntr: type=UInt4_2
      VehSpdLgtChks: type=UInt8_2
  app type Spd1_2: category=VALUE, compu {phys=raw*0.00391 for raw 0..31970; unit m/s}, range phys 0..125 m/s
  application record data type WhlDirRotlFrnt_2: category=STRUCTURE
    4 x application record element, all with category=VALUE:
      Le: type=WhlRotlDirStd1_2
      Ri: type=WhlRotlDirStd1_2
      Chks: type=UInt8_2
      Cntr: type=UInt4_2
  app type WhlRotlDirStd1_2: category=VALUE, compu-method=WhlRotlDirStd1_1, range raw 0..3
  application record data type WhlDirRotlRe_3: category=STRUCTURE
    4 x application record element, all with category=VALUE:
      Le: type=WhlRotlDirStd1_2
      Ri: type=WhlRotlDirStd1_2
      Chks: type=UInt8_2
      Cntr: type=UInt4_2
  app type DevErrSts2_2: category=VALUE, compu {0=DevErrSts2_NoFlt, 1=DevErrSts2_Flt; unit Unitless}, range raw 0..1
  app type Nr2_3: category=VALUE, compu {phys=raw for raw 0..255; unit Unitless}, range phys 0..255 Unitless
  application record data type WhlSpdCircumlFrntRec1_3: category=STRUCTURE
    6 x application record element, all with category=VALUE:
      WhlSpdCircumlFrntLe: type=Spd1_2
      WhlSpdCircumlFrntLeQf: type=GenQf1_2
      WhlSpdCircumlFrntWhlSpdCircumlFrntRi: type=Spd1_2
      WhlSpdCircumlFrntRiQf: type=GenQf1_2
      WhlSpdCircumlFrntChks: type=UInt8_2
      WhlSpdCircumlFrntCntr: type=UInt4_2
  application record data type WhlSpdCircumlReRec1_2: category=STRUCTURE
    6 x application record element, all with category=VALUE:
      WhlSpdCircumlReLe: type=Spd1_2
      WhlSpdCircumlReLeQf: type=GenQf1_2
      WhlSpdCircumlReRi: type=Spd1_2
      WhlSpdCircumlReRiQf: type=GenQf1_2
      WhlSpdCircumlReChks: type=UInt8_2
      WhlSpdCircumlReCntr: type=UInt4_2
  app type OnOff1_2: category=VALUE, compu {0=OnOff1_Off, 1=OnOff1_On; unit Unitless}, range raw 0..1
  application record data type AbsCtrlActv_1: category=STRUCTURE
    application record element CtrlSts1: category=VALUE, type=CtrlSts1_2
    application record element Chks: category=VALUE, type=UInt8_2
    application record element Cntr: category=VALUE, type=UInt4_2
  app type CtrlSts1_2: category=VALUE, compu {0=CtrlSts1_NoCtrl, 1=CtrlSts1_InCtrl; unit Unitless}, range raw 0..1
  application record data type BrkAndAbsWarnIndcnReqRec1_2: category=STRUCTURE
    4 x application record element, all with category=VALUE:
      BrkWarnIndcnReq: type=OnOff2_2
      AbsWarnIndcnReq: type=AbsWarnIndcnReq_2
      BrkAndAbsWarnIndcnReqChks: type=UInt8_2
      BrkAndAbsWarnIndcnReqCntr: type=UInt4_2
  app type OnOff2_2: category=VALUE, compu {0=OnOff2_On, 1=OnOff2_Off; unit Unitless}, range raw 0..1
  app type AbsWarnIndcnReq_2: category=VALUE, compu-method=AbsWarnIndcnReq_1, range raw 0..3
  application record data type BrkFricTqTotAtWhlsActRec1_2: category=STRUCTURE
    application record element BrkFricTqTotAtWhlsAct: category=VALUE, type=Tq10_2
    application record element BrkFricTqTotAtWhlsActChks: category=VALUE, type=UInt8_2
    application record element BrkFricTqTotAtWhlsActCntr: category=VALUE, type=UInt4_2
  app type Tq10_2: category=VALUE, compu {phys=raw for raw 0..20000; unit NewtonMeter}, range phys 0..20000 NewtonMeter
  application record data type BrkSysCylPMstRec1_2: category=STRUCTURE
    7 x application record element, all with category=VALUE:
      Act: type=P33_2
      ActQf: type=GenQf1_2
      Tar: type=P35_2
      Virt: type=P35_2
      VirtQf: type=GenQf1_2
      Chks: type=UInt8_2
      Cntr: type=UInt4_2
  4 x app type, all with category=VALUE:
    P33_2: compu {phys=raw*0.3-30 for raw 0..1022; unit bar}, range phys -30..276.6 bar
    P35_2: compu {phys=raw*0.25 for raw 0..1000; unit bar}, range phys 0..250 bar
    Tq32_2: compu {phys=raw*4 for raw 0..4095; unit Nm}, range phys 0..16380 Nm
    DevSts1_2: compu {0=DevSts1_On, 1=DevSts1_Off, 2=DevSts1_Flt; unit Unitless}, range raw 0..2
  application record data type EscStSafe1_2: category=STRUCTURE
    application record element EscSt: category=VALUE, type=EscSt1_2
    application record element EscStChks: category=VALUE, type=UInt8_2
    application record element EscStCntr: category=VALUE, type=UInt4_2
  app type EscSt1_2: category=VALUE, compu-method=EscSt1_1, range raw 0..4
  app type Tq1_2: category=VALUE, compu {phys=raw/256 for raw -7680..7680; unit NewtonMeter}, range phys -30..30 NewtonMeter
  app type PostImpctBrkgRdy_2: category=VALUE, compu-method=PostImpctBrkgRdy_1, range raw 0..3
  application record data type EpbStsRec1_2: category=STRUCTURE
    application record element EpbSts: category=VALUE, type=EpbSts_2
    application record element EpbStsChks: category=VALUE, type=UInt8_2
    application record element EpbStsCntr: category=VALUE, type=UInt4_2
  app type EpbSts_2: category=VALUE, compu-method=EpbSts_1, range raw 0..15
  app type Qf1_2: category=VALUE, compu-method=Qf1_1, range raw 0..3
  app type PsdNotPsd_2: category=VALUE, compu {0=PsdNotPsd_NotPsd, 1=PsdNotPsd_Psd; unit Unitless}, range raw 0..1
  application record data type BrkPedlPsdRec_2: category=STRUCTURE
    5 x application record element, all with category=VALUE:
      BrkPedlPsd: type=NoYes1_2
      BrkPedlPsdQf: type=GenQf1_2
      BrkPedlPsdCntr: type=UInt4_2
      BrkPedlPsdChks: type=UInt8_2
      BrkPedlNotPsdSafe: type=NoYes1_2
  application record data type BrkPedlrRatRec_1: category=STRUCTURE
    application record element BrkPedlrRatPerc: category=VALUE, type=Perc1_2
    application record element BrkPedlrRatQf: category=VALUE, type=GenQf1_2
  app type Perc1_2: category=VALUE, compu {phys=raw/256 for raw 0..25600; unit %}, range phys 0..100 %
  application record data type VFCVector_6: category=STRUCTURE
    63 x application record element, all with category=VALUE:
      VFCid{1..61}: type=VFCOnOff_4
      VFCid0: type=VFCOnOff_4
      BlockID: type=BlockID_3
  7 x app type:
    VFCOnOff_4: category=VALUE, compu {0=VFCOnOff_Off, 1=VFCOnOff_On; unit Unitless}, range raw 0..1
    BlockID_3: category=VALUE, compu {identical; unit Unitless}, range phys 0..3 Unitless
    WakeUpReasons_4: category=VALUE, compu-method=WakeupReasons_7, range raw 0..65535
    Len31_2: category=VALUE, compu {phys=raw for raw 0..2000000; unit km}, range phys 0..2000000 km
    InvldVld1_2: category=VALUE, compu {0=InvldVld1_Invld, 1=InvldVld1_Vld; unit Unitless}, range raw 0..1
    Ag4_2: category=VALUE, compu {phys=raw/1024 for raw -14848..14848; unit rad}, range phys -14.5..14.5 rad
    Boolean_2: category=BOOLEAN, compu {0=Boolean_FALSE, 1=Boolean_TRUE; unit Unitless}, range raw 0..1
  application record data type ADataRawSafe1_2: category=STRUCTURE
    8 x application record element, all with category=VALUE:
      ALat: type=A38_2
      ALat1Qf: type=Qf1_2
      ALgt: type=A38_2
      ALgt1Qf: type=Qf1_2
      AVert: type=A38_2
      AVertQf: type=Qf1_2
      Chks: type=UInt8_2
      Cntr: type=UInt4_2
  app type A38_2: category=VALUE, compu {phys=raw*0.0085 for raw -16352..16353; unit m/s^2}, range phys -139..139 m/s^2
  application record data type AccrPedlRatGrp_1: category=STRUCTURE
    application record element AccrPedlRat: category=VALUE, type=Perc1_2
    application record element Cntr: category=VALUE, type=UInt4_2
    application record element Chks: category=VALUE, type=UInt8_2
  application record data type AgDataRawSafe1_2: category=STRUCTURE
    6 x application record element, all with category=VALUE:
      RollRate: type=AgSpd34_2
      RollRateQf: type=Qf1_2
      YawRate: type=AgSpd34_2
      YawRateQf: type=Qf1_2
      Chks: type=UInt8_2
      Cntr: type=UInt4_2
  app type AgSpd34_2: category=VALUE, compu {phys=raw/4096 for raw -24576..24576; unit rad/s}, range phys -6..6 rad/s
  app type GearLvrIndcn2_2: category=VALUE, compu-method=GearLvrIndcn2_1, range raw 0..7
  application record data type UInt64Rec_2: category=STRUCTURE
    8 x application record element, all with category=VALUE, type=UInt8_2:
      Byte{0..7}
  application record data type PinionSteerAgGroupRec_1: category=STRUCTURE
    8 x application record element, all with category=VALUE:
      PinionSteerAg1: type=Ag4_2
      PinionSteerAg1Qf: type=GenQf1_2
      PinionSteerAgSpd1: type=AgSpd1_2
      PinionSteerAgSpd1Qf: type=GenQf1_2
      SteerWhlTq: type=Tq1_2
      SteerWhlTqQf: type=GenQf1_2
      Cntr: type=UInt4_2
      Chks: type=UInt8_2
  app type AgSpd1_2: category=VALUE, compu {phys=raw/128 for raw -6400..6400; unit rad/s}, range phys -50..50 rad/s
  app type DoorSts2_2: category=VALUE, compu {0=DoorSts2_Ukwn, 1=DoorSts2_Opend, 2=DoorSts2_Clsd; unit Unitless}, range raw 0..2
  application record data type VehModMngtGlbSafe1_2: category=STRUCTURE
    10 x application record element, all with category=VALUE:
      UsgModSts: type=UsgModSts1_2
      CarModSts1: type=CarModSts1_2
      CarModSubtypWdCarModSubtyp: type=Nr5_2
      EgyLvlElecMai: type=UInt4_2
      EgyLvlElecSubtyp: type=UInt4_2
      PwrLvlElecMai: type=UInt4_2
      PwrLvlElecSubtyp: type=UInt4_2
      FltEgyCnsWdSts: type=FltEgyCns1_2
      Chks: type=UInt8_2
      Cntr: type=UInt4_2
  5 x app type, all with category=VALUE:
    UsgModSts1_2: compu-method=UsgModSts1_1, range raw 0..13
    CarModSts1_2: compu-method=CarModSts1_1, range raw 0..5
    Nr5_2: compu {identical; unit Unitless}, range phys 0..7 Unitless
    FltEgyCns1_2: compu {0=FltEgyCns1_NoFlt, 1=FltEgyCns1_Flt; unit Unitless}, range raw 0..1
    MotSpd_1: compu {phys=raw-20000 for raw 0..65535; unit rpm}, range phys -20000..45531 rpm
  application record data type AgDataRaw2Safe_1: category=STRUCTURE
    4 x application record element, all with category=VALUE:
      Chks: type=UInt8_2
      Cntr: type=UInt4_2
      PitchRateQf: type=Qf1_2
      PitchRate: type=AgSpd34_2
  app type OkNotOk1_2: category=VALUE, compu {0=OkNotOk1_Ok, 1=OkNotOk1_NotOk; unit Unitless}, range raw 0..1
  application record data type PostImpctBrkgCfmdSafe1_3: category=STRUCTURE
    15 x application record element, all with category=VALUE:
      PostImpctBrkgCfmd: type=PostImpctBrkgNoYes_2
      CrashFrnt: type=PostImpctBrkgNoYes_2
      CrashSideLe: type=PostImpctBrkgNoYes_2
      CrashSideRi: type=PostImpctBrkgNoYes_2
      CrashRe: type=PostImpctBrkgNoYes_2
      CrashRollovr: type=PostImpctBrkgNoYes_2
      CrashPed: type=PostImpctBrkgNoYes_2
      CrashOz: type=PostImpctBrkgNoYes_2
      CrashOffroadD: type=PostImpctBrkgNoYes_2
      CrashOffroadA: type=PostImpctBrkgNoYes_2
      CrashOffroadRT: type=PostImpctBrkgNoYes_2
      CrashOffroadRTsevere: type=PostImpctBrkgNoYes_2
      CrashLargeAnimal: type=PostImpctBrkgNoYes_2
      Chks: type=UInt8_2
      Cntr: type=UInt4_2
  app type PostImpctBrkgNoYes_2: category=VALUE, compu-method=PostImpctBrkgNoYes_1, range raw 0..3
  application record data type PostImpctBrkgSuspcSafe1_2: category=STRUCTURE
    application record element SuspcPostImpctBrkg: category=VALUE, type=PostImpctBrkgNoYes_2
    application record element Chks: category=VALUE, type=UInt8_2
    application record element Cntr: category=VALUE, type=UInt4_2
  application record data type SftyDecelGroupSafe1_3: category=STRUCTURE
    4 x application record element, all with category=VALUE:
      AsySftyEnaDecel: type=OnOff1_2
      SftyDecelGroupSafeChks: type=UInt8_2
      SftyDecelGroupSafeCntr: type=UInt4_2
      AsySftyDecelReq: type=Decel_1
  app type Decel_1: category=VALUE, compu {phys=raw*0.1 for raw 0..150; unit m/s^2}, range phys 0..15 m/s^2
  application record data type BltLockStFrnt_2: category=STRUCTURE
    application record element BltLockSt1: category=VALUE, type=BltLockSt1_2
    application record element BltLockSts: category=VALUE, type=DevErrSts2_2
  app type BltLockSt1_2: category=VALUE, compu {0=BltLockSt1_Unlock, 1=BltLockSt1_Lock; unit Unitless}, range raw 0..1
  app type NoYesCrit1_2: category=VALUE, compu-method=NoYesCrit1_1, range raw 0..3
  application record data type VehCfgPrm_3: category=STRUCTURE
    8 x application record element, all with category=VALUE, type=Nr2_3:
      BlkIDBytePosn1
      CCPBytePosn{2..8}
  app type CrsCtrlrSts1_2: category=VALUE, compu-method=CrsCtrlrSts1_1, range raw 1..3
  application record data type Vin1_3: category=STRUCTURE
    8 x application record element, all with category=VALUE, type=Nr2_3:
      BlockNr
      VINSignalPos{1..7}
  app type CarTiGlb_2: category=VALUE, compu {phys=raw*0.1 for raw 0..4294967295; unit s}, range phys 0..429496729.4 s
  application record data type SysU_4: category=STRUCTURE
    application record element SysU: category=VALUE, type=U1_2
    application record element SysUQf: category=VALUE, type=GenQf1_2
  app type U1_2: category=VALUE, compu {phys=raw*0.1 for raw 0..250; unit Volt}, range phys 0..25 Volt
  application record data type DateTi30_2: category=STRUCTURE
    7 x application record element, all with category=VALUE:
      Yr1: type=Yr1_2
      Mth1: type=Mth1_2
      Day: type=Day1_2
      Hr1: type=Hr1_2
      Mins1: type=Mins1_2
      Sec1: type=Sec1_2
      DataValid: type=NoYes1_2
  6 x app type, all with category=VALUE:
    Yr1_2: compu {identical; unit Year}, range phys 0..99 Year
    Mth1_2: compu {identical; unit Month}, range phys 1..12 Month
    Day1_2: compu {identical; unit Days}, range phys 1..31 Days
    Hr1_2: compu {identical; unit hours}, range phys 0..23 hours
    Mins1_2: compu {identical; unit Mins}, range phys 0..59 Mins
    Sec1_2: compu {identical; unit s}, range phys 0..59 s
  application record data type AsyDataWithCmpSafe1_2: category=STRUCTURE
    8 x application record element, all with category=VALUE:
      YawRateWithCmp: type=AgSpd34_2
      YawRateQf: type=Qf1_2
      ALatWithCmp: type=A38_2
      ALat1Qf: type=Qf1_2
      GrdtOfALgt: type=Jerk1_2
      ALgt1Qf: type=Qf1_2
      Chks: type=UInt8_2
      Cntr: type=UInt4_2
  app type Jerk1_2: category=VALUE, compu {phys=raw/256 for raw -7680..7680; unit m/s^3}, range phys -30..30 m/s^3
  application record data type EngNSafe_2: category=STRUCTURE
    4 x application record element, all with category=VALUE:
      EngN: type=N30_2
      EngNGrdt: type=NGrdt1_2
      EngNChks: type=UInt8_2
      EngNCntr: type=UInt4_2
  4 x app type, all with category=VALUE:
    N30_2: compu {phys=raw*0.5 for raw 0..32767; unit rpm}, range phys 0..16383 rpm
    NGrdt1_2: compu {phys=raw for raw -30000..32767; unit RpmPerSec}, range phys -30000..30000 RpmPerSec
    Perc2_2: compu {phys=raw*0.5 for raw 0..200; unit %}, range phys 0..100 %
    UInt32_2: compu {identical; unit Unitless}, range phys 0..4294967295 Unitless
  application record data type ResdDataType2_1: category=STRUCTURE
    application record element Chks: category=VALUE, type=UInt8_2
    application record element Cntr: category=VALUE, type=UInt4_2
    application record element UInt32: category=VALUE, type=UInt32_2
  app type OnOffNoReq_2: category=VALUE, compu {0=OnOffNoReq_NoReq, 1=OnOffNoReq_On, 2=OnOffNoReq_Off; unit Unitless}, range raw 0..2
  application record data type AsyALgtStsGrp_3: category=STRUCTURE
    application record element AsyALgtSts: category=VALUE, type=AsyALgtSts_4
    application record element Cntr: category=VALUE, type=UInt4_2
    application record element Chks: category=VALUE, type=UInt8_2
  app type AsyALgtSts_4: category=VALUE, compu-method=AsyALgtSts_4, range raw 0..15
  app type CrashFb_2: category=VALUE, compu-method=CrashFb_1, range raw 0..3
  app type UInt2_2: category=VALUE, compu {identical; unit Unitless}, range phys 0..3 Unitless
  application record data type CrashStsSafe_1: category=STRUCTURE
    application record element Sts: category=VALUE, type=CrashSts2_2
    application record element Chks: category=VALUE, type=UInt8_2
    application record element Cntr: category=VALUE, type=UInt4_2
  4 x app type, all with category=VALUE:
    CrashSts2_2: compu {0=CrashSts2_NoCrash, 1=CrashSts2_Crash; unit Unitless}, range raw 0..1
    Flt_3: compu {0=Flt_NoFault, 1=Flt_Fault; unit Unitless}, range raw 0..1
    Perc9_2: compu {phys=raw*0.1 for raw 0..1000; unit %}, range phys 0..100 %
    IndcrSts1_2: compu-method=IndcrSts1_1, range raw 0..3
  application record data type AgDataCmpQuality1_2: category=STRUCTURE
    application record element YawRateCmpQuality: category=VALUE, type=UInt8_2
    application record element RollRateCmpQuality: category=VALUE, type=UInt8_2
    application record element PitchRateCmpQuality: category=VALUE, type=UInt8_2
  application record data type BltLockStRe_2: category=STRUCTURE
    application record element BltLockSt1: category=VALUE, type=BltLockSt1_2
    application record element BltLockSts: category=VALUE, type=DevErrSts2_2
    application record element BltLockEquid: category=VALUE, type=CptEquid_2
  app type CptEquid_2: category=VALUE, compu {0=CptEquid_Equid, 1=CptEquid_NotEquid; unit Unitless}, range raw 0..1
  application record data type BltLockStSafe2_4: category=STRUCTURE
    4 x application record element, all with category=VALUE:
      BltLockSt1: type=BltLockSt1_2
      BltLockStErrSts: type=DevErrSts2_2
      Chks: type=UInt8_2
      Cntr: type=UInt4_2
  app type CrashSts4_1: category=VALUE, compu-method=CrashSts4_1, range raw 0..3
  application record data type PassAirbLampReqRec1_2: category=STRUCTURE
    5 x application record element, all with category=VALUE:
      PassAirbLampDiReq: type=PassAirbLampReq_2
      PassAirbLampEnaReq: type=PassAirbLampReq_2
      PassAirbLampReqChks: type=UInt8_2
      PassAirbLampReqCntr: type=UInt4_2
      ChgOfPassAirbSts: type=ReqForDisp_2
  app type PassAirbLampReq_2: category=VALUE, compu-method=PassAirbLampReq_1, range raw 0..3
  app type ReqForDisp_2: category=VALUE, compu {0=ReqForDisp_Idle, 1=ReqForDisp_IndcnReqd; unit Unitless}, range raw 0..1
  app type OnOffCrit1_2: category=VALUE, compu-method=OnOffCrit1_1, range raw 0..3
  application record data type RecOfImpct1_3: category=STRUCTURE
    15 x application record element:
      VehOri: category=VALUE, type=Orntn_2
      CrashState: category=VALUE, type=CrashSt_2
      CrashFrnt: category=BOOLEAN, type=Boolean_2
      CrashSideLe: category=BOOLEAN, type=Boolean_2
      CrashSideRi: category=BOOLEAN, type=Boolean_2
      CrashRe: category=BOOLEAN, type=Boolean_2
      CrashRollovr: category=BOOLEAN, type=Boolean_2
      CrashPed: category=BOOLEAN, type=Boolean_2
      CrashOffroadD: category=BOOLEAN, type=Boolean_2
      CrashOffroadA: category=BOOLEAN, type=Boolean_2
      CrashOffroadRT: category=BOOLEAN, type=Boolean_2
      CrashOffroadRTsevere: category=BOOLEAN, type=Boolean_2
      ImpctDvy: category=VALUE, type=U8Kmph_1
      ImpctDvx: category=VALUE, type=U8Kmph_1
      ImpctRollAg: category=VALUE, type=U8WithRngDeg_1
  6 x app type, all with category=VALUE:
    Orntn_2: compu-method=Orntn_1, range raw 0..7
    CrashSt_2: compu-method=CrashSt_1, range raw 0..3
    U8Kmph_1: compu {identical; unit Km/h}, range phys 0..255 Km/h
    U8WithRngDeg_1: compu {phys=raw*15 for raw 0..127; unit Deg}, range phys 0..1905 Deg
    RestrntSysLampReq_2: compu-method=RestrntSysLampReq_1, range raw 0..3
    PassSeatSts1_2: compu-method=PassSeatSts1_1, range raw 0..3
  application record data type RecOfImpct2_1: category=STRUCTURE
    application record element ImpctDvxSigned: category=VALUE, type=Spd51_1
    application record element ImpctDvySigned: category=VALUE, type=Spd51_1
  app type Spd51_1: category=VALUE, compu {phys=raw-255 for raw 0..512; unit Km/h}, range phys -255..255 Km/h
  app type ReqForHzrdInt_1: category=VALUE, compu-method=ReqForHzrdInt_1, range raw 0..1
  app type ActvnReqOfRtrctrRvsb1_2: category=VALUE, compu {0=NoActvn, 1=ActvnFLo, 2=ActvnFHi, 3=Resd1, 4=Resd2; unit Unitless}, range raw 0..4
  application record data type BltCrashNotif_2: category=STRUCTURE
    application record element BltCrashNotifDrvr: category=VALUE, type=NoYesCrit1_2
    application record element BltCrashNotifPass: category=VALUE, type=NoYesCrit1_2
  application record data type Develp1_1: category=STRUCTURE
    8 x application record element, all with category=VALUE, type=UInt8_2:
      Functiondevpsignalgroup{1..8}
  app type U55_1: category=VALUE, compu {phys=raw*0.1 for raw 0..255; unit Volt}, range phys 0..25.5 Volt
  application record data type IntgtIMUDataRawSafe_1: category=STRUCTURE
    14 x application record element, all with category=VALUE:
      ALat: type=A38_2
      ALat1Qf: type=Qf1_2
      ALgt: type=A38_2
      ALgt1Qf: type=Qf1_2
      Avert: type=A38_2
      AVertQf: type=Qf1_2
      YawRate: type=AgSpd34_2
      YawRateQf: type=Qf1_2
      RollRate: type=AgSpd34_2
      RollRateQf: type=Qf1_2
      PitchRate: type=AgSpd34_2
      PitchRateQf: type=Qf1_2
      Chks: type=UInt8_2
      Cntr: type=UInt4_2
  application record data type FltStsSafe_1: category=STRUCTURE
    application record element FltSts: category=VALUE, type=Flt_3
    application record element Chks: category=VALUE, type=UInt8_2
    application record element Cntr: category=VALUE, type=UInt4_2
  application record data type AmbTIndcdWithUnit_2: category=STRUCTURE
    application record element AmbTIndcd: category=VALUE, type=AmbTIndcd_2
    application record element AmbTIndcdUnit: category=VALUE, type=AmbTIndcdUnit_2
    application record element QF: category=VALUE, type=GenQf1_2
  7 x app type, all with category=VALUE:
    AmbTIndcd_2: compu {phys=raw*0.1-100 for raw 0..4095; unit Unitless}, range phys -100..309.5 Unitless
    AmbTIndcdUnit_2: compu-method=AmbTIndcdUnit_1, range raw 0..2
    AsyAutDrvCtrlTyp_4: compu-method=AsyAutDrvCtrlTyp_4, range raw 0..7
    CllsnMtgtnFctSts_2: compu-method=CllsnMtgtnFctSts_2, range raw 0..7
    DispOfPrpsnModForEv_2: compu-method=DispOfPrpsnModForEv_2, range raw 0..15
    LockSts2_2: compu-method=LockSts2_1, range raw 0..3
    DrvrCrsCtrlFctSeldTyp_5: compu-method=DrvrCrsCtrlFctSeldTyp_4, range raw 0..7
  application record data type SeatPosPercQF_3: category=STRUCTURE
    6 x application record element, all with category=VALUE:
      SeatPosSldQF: type=Qf1_2
      SeatPosSldPerc: type=Perc9_2
      SeatPosHeiQF: type=Qf1_2
      SeatPosHeiPerc: type=Perc9_2
      SeatPosFrntHeiQF: type=Qf1_2
      SeatPosFrntHeiPerc: type=Perc9_2
  application record data type TireMsg_3: category=STRUCTURE
    9 x application record element, all with category=VALUE:
      PWarnFlg: type=PWarnFlg_2
      TWarnFlg: type=Normalwarning_2
      SysWarnFlg: type=Normalwarning_2
      FastLoseWarnFlg: type=Normalwarning_2
      BattLoSt: type=Normalwarning_2
      MsgOldFlg: type=Normalwarning_2
      TireFillgAssiPSts: type=Normalwarning_2
      T: type=T8_1
      P: type=Kpa8_1
  4 x app type, all with category=VALUE:
    PWarnFlg_2: compu-method=PWarnFlg_2, range raw 0..3
    Normalwarning_2: compu {0=Normalwarning_Normal, 1=Normalwarning_Warning; unit Unitless}, range raw 0..1
    T8_1: compu {phys=raw-50 for raw 0..255; unit degC}, range phys -50..205 degC
    Kpa8_1: compu {phys=raw*1.373 for raw 0..255; unit KiloPa}, range phys 0..350.115 KiloPa
  application record data type PassAirbLampStsRec_2: category=STRUCTURE
    application record element PassAirbLampSts: category=VALUE, type=PassAirbLampSts1_2
    application record element PassAirbLampStsChks: category=VALUE, type=UInt8_2
    application record element PassAirbLampStsCntr: category=VALUE, type=UInt4_2
  app type PassAirbLampSts1_2: category=VALUE, compu-method=PassAirbLampSts1_1, range raw 0..3
  application record data type Posn_1: category=STRUCTURE
    application record element PosnLat: category=VALUE, type=PosnLat_2
    application record element PosnLgt: category=VALUE, type=PosnLgt_2
  app type PosnLat_2: category=VALUE, compu {phys=raw/3600000 for raw -324000000..324000000; unit Deg}, range phys -90..90 Deg
  app type PosnLgt_2: category=VALUE, compu {phys=raw/3600000 for raw -648000000..648000000; unit Deg}, range phys -180..180 Deg
  app type ReqForPassAirbIndcnAckd_2: category=VALUE, compu-method=ReqForPassAirbIndcnAckd_1, range raw 0..1
  application record data type TrsmActrPosnSafe1_3: category=STRUCTURE
    application record element TrsmActrPosn: category=VALUE, type=TrsmActrPosn1_2
    application record element TrsmActrPosnChks: category=VALUE, type=UInt8_2
    application record element TrsmActrPosnCntr: category=VALUE, type=UInt4_2
  app type TrsmActrPosn1_2: category=VALUE, compu-method=TrsmActrPosn1_1, range raw 0..7
  app type DispOfPrpsnMod4_3: category=VALUE, compu-method=DispOfPrpsnMod4_3, range raw 0..15
  app type AfsStsReq_7: category=VALUE, compu-method=AfsStsReq_4, range raw 0..3
  application record data type IndcrTurnReq_2: category=STRUCTURE
    4 x application record element, all with category=VALUE:
      IndcrTypExtReq: type=IndcrTypExt1_2
      IndcrTypExtReqToUpdQf: type=Qf1_2
      IndcrTypExtReqCntr: type=UInt2_2
      IndcrTypExtReqChks: type=UInt8_2
  app type IndcrTypExt1_2: category=VALUE, compu-method=IndcrTypExt1_1, range raw 0..2
  app type CllsnFwdWarnReq_1: category=VALUE, compu-method=CllsnFwdWarnReq_1, range raw 0..2
  app type Enumeration1_2: category=VALUE, compu {0=Enumeration1_NotActvd, 1=Enumeration1_Actvd; unit Unitless}, range raw 0..1
  application record data type PreCrashData_3: category=STRUCTURE
    6 x application record element, all with category=VALUE:
      Chks: type=UInt8_2
      Cntr: type=UInt4_2
      TimeToImpact: type=TimeToImpact_1
      ObjectClass: type=ObjectClass_2
      ClosingVelocity: type=ClosingVelocity_1
      OverLap: type=PercSign1_2
  6 x app type, all with category=VALUE:
    TimeToImpact_1: compu {phys=raw*0.004 for raw 0..255; unit s}, range phys 0..1 s
    ObjectClass_2: compu-method=ObjectClass_2, range raw 0..7
    ClosingVelocity_1: compu {phys=raw*0.167 for raw 0..255; unit m/s}, range phys 0..41.917 m/s
    PercSign1_2: compu {phys=raw-100 for raw 0..200; unit %}, range phys -100..100 %
    NotOkOk_2: compu-method=NotOkOk_2, range raw 0..3
    HomePrkgSysSts1_2: compu-method=HomePrkgSysSts1_2, range raw 0..31
  application record data type VehSpdIndcd1_2: category=STRUCTURE
    application record element VehSpdIndcd: category=VALUE, type=Nr32_2
    application record element VeSpdIndcdUnit: category=VALUE, type=VehSpdIndcdUnit_2
  app type Nr32_2: category=VALUE, compu {identical; unit Unitless}, range phys 0..511 Unitless
  app type VehSpdIndcdUnit_2: category=VALUE, compu-method=VehSpdIndcdUnit_1, range raw 0..2
  application record data type PrkgStsToEDR_1: category=STRUCTURE
    7 x application record element, all with category=VALUE, type=APATo_1:
      APATo
      RPATo
      HPATo
      LSDAandTBATo
      reserved{1..3}
  app type APATo_1: category=VALUE, compu-method=APATo_1, range raw 0..7
  application record data type AsySftyFctStsToEDR_1: category=STRUCTURE
    10 x application record element, all with category=VALUE:
      AEBSFctSts: type=AEBSFctSts_1
      ACCFctSTs: type=FctSTs_1
      LDWSFctSts: type=LDWSFctSts_1
      CSFFctSts: type=FctSTs_1
      ESFFctSts: type=FctSTs_1
      ACSFB1FctSts: type=FctSTs_1
      ACSFB2FctSts: type=FctSTs_1
      ACSFCFctSts: type=FctSTs_1
      ACSFDFctSts: type=FctSTs_1
      ACSFEFctSts: type=FctSTs_1
  5 x app type, all with category=VALUE:
    AEBSFctSts_1: compu-method=AEBSFctSts_1, range raw 0..7
    FctSTs_1: compu-method=ACCFctSTs_1, range raw 0..7
    LDWSFctSts_1: compu-method=LDWSFctSts_1, range raw 0..7
    CrsCtrlrMsg1_2: compu-method=CrsCtrlrMsg1_1, range raw 0..7
    Onoff3_1: compu {0=Onoff2_Idle, 1=Onoff2_On, 2=Onoff2_On1, 3=Onoff2_Off; unit Unitless}, range raw 0..3
package /CompuMethods
  compu method GenQf1_1: 0=GenQf1_UndefindDataAccur, 1=GenQf1_TmpUndefdData, 2=GenQf1_DataAccurNotWithinSpcn, 3=GenQf1_AccurData; unit Unitless
  compu method VehMtnSt2_1: 0=VehMtnSt2_Ukwn, 1=VehMtnSt2_StandStillVal1, 2=VehMtnSt2_StandStillVal2, 3=VehMtnSt2_StandStillVal3, 4=VehMtnSt2_RollgFwdVal1, 5=VehMtnSt2_RollgFwdVal2, 6=VehMtnSt2_RollgBackwVal1, 7=VehMtnSt2_RollgBackwVal2; unit Unitless
  compu method WhlRotlDirStd1_1: 0=WhlRotlDirStd1_Undefd, 1=WhlRotlDirStd1_StandStill, 2=WhlRotlDirStd1_Fwd, 3=WhlRotlDirStd1_Backw; unit Unitless
  compu method AbsWarnIndcnReq_1: 0=AbsWarnIndcnReq_AbsWarnIndcnOnReq, 1=AbsWarnIndcnReq_AbsWarnIndcnFlsgReq, 2=AbsWarnIndcnReq_Resd2, 3=AbsWarnIndcnReq_AbsWarnIndcnOffReq; unit Unitless
  compu method EscSt1_1: 0=EscSt1_Inin, 1=EscSt1_Ok, 2=EscSt1_TmpErr, 3=EscSt1_PrmntErr, 4=EscSt1_UsrOff; unit Unitless
  compu method PostImpctBrkgRdy_1: 0=PostImpctBrkgRdy_No, 1=PostImpctBrkgRdy_Yes, 2=PostImpctBrkgRdy_Di, 3=PostImpctBrkgRdy_Resd; unit Unitless
  compu method EpbSts_1: 0=EpbSts_Resd0, 1=EpbSts_Resd1, 2=EpbSts_Resd2, 3=EpbSts_AllAppld, 4=EpbSts_Resd4, 5=EpbSts_AllInTran, 6=EpbSts_BrkgDynByActr, 7=EpbSts_Resd7, 8=EpbSts_Resd8, 9=EpbSts_ActrAllReld, 10=EpbSts_BrkgDynDegraded, 11=EpbSts_Resd11, 12=EpbSts_BrkgDyn, 13=EpbSts_Resd13, 14=EpbSts_Resd14, 15=EpbSts_Err; unit Unitless
  compu method Qf1_1: 0=Qf1_DevOfDataUndefd, 1=Qf1_DataTmpUndefdAndEvlnInProgs, 2=Qf1_DevOfDataNotWithinRngAllwd, 3=Qf1_DataCalcdWithDevDefd; unit Unitless
  compu method WakeupReasons_7: 0=WakeupReasons_0, 1=WakeupReasons_667950, 2=WakeupReasons_169654, 3=WakeupReasons_667951, 4=WakeupReasons_168965, 5=WakeupReasons_197643, 6=WakeupReasons_264933, 7=WakeupReasons_45654, 8=WakeupReasons_22058, 9=WakeupReasons_49446, 10=WakeupReasons_22060, 11=WakeupReasons_269740, 12=WakeupReasons_269735, 13=WakeupReasons_269739, 14=WakeupReasons_658500, 15=WakeupReasons_21901, 16=WakeupReasons_45793, 17=WakeupReasons_45794, 18=WakeupReasons_22005, 19=WakeupReasons_22013, 20=WakeupReasons_22100, 21=WakeupReasons_45659, 22=WakeupReasons_45657, 23=WakeupReasons_140084, 24=WakeupReasons_21973, 25=WakeupReasons_91253, 26=WakeupReasons_88123, 27=WakeupReasons_88125, 28=WakeupReasons_321583, 29=WakeupReasons_74188, 30=WakeupReasons_667945, 31=WakeupReasons_169655, 32=WakeupReasons_667948, 33=WakeupReasons_168966, 34=WakeupReasons_170865, 35=WakeupReasons_197642, 36=WakeupReasons_264876, 37=WakeupReasons_191050, 38=WakeupReasons_182033, 39=WakeupReasons_200937, 40=WakeupReasons_170807, 41=WakeupReasons_319139, 42=WakeupReasons_100298, 43=WakeupReasons_100275, 44=WakeupReasons_100300, 45=WakeupReasons_100278, 46=WakeupReasons_100281, 47=WakeupReasons_265333, 48=WakeupReasons_108776, 49=WakeupReasons_176921, 50=WakeupReasons_197826, 51=WakeupReasons_185670, 52=WakeupReasons_161066, 53=WakeupReasons_200156, 54=WakeupReasons_225696, 55=WakeupReasons_21997, 56=WakeupReasons_45656, 57=WakeupReasons_266860, 58=WakeupReasons_169894, 59=WakeupReasons_320282, 60=WakeupReasons_319422, 61=WakeupReasons_320277, 62=WakeupReasons_355601, 63=WakeupReasons_360904, 64=WakeupReasons_361505, 65=WakeupReasons_361509, 66=WakeupReasons_645094, 67=WakeupReasons_68676, 68=WakeupReasons_360008, 69=WakeupReasons_109382, 70=WakeupReasons_119273, 71=WakeupReasons_224065, 72=WakeupReasons_68644, 73=WakeupReasons_109364, 74=WakeupReasons_68481, 75=WakeupReasons_224061, 76=WakeupReasons_360006, 77=WakeupReasons_138997, 78=WakeupReasons_634696, 79=WakeupReasons_645810, 80=WakeupReasons_297868, 81=WakeupReasons_315364, 82=WakeupReasons_109367, 83=WakeupReasons_320126, 84=WakeupReasons_109387, 85=WakeupReasons_634710, 86=WakeupReasons_338820, 87=WakeupReasons_67182, 88=WakeupReasons_152237, 89=WakeupReasons_145707, 90=WakeupReasons_199172, 91=WakeupReasons_144897, 92=WakeupReasons_186489, 93=WakeupReasons_144970, 94=WakeupReasons_152786, 95=WakeupReasons_264932, 96=WakeupReasons_264934, 97=WakeupReasons_356190, 98=WakeupReasons_145688, 99=WakeupReasons_95444, 100=WakeupReasons_169945, 101=WakeupReasons_140678, 102=WakeupReasons_222553, 103=WakeupReasons_224831, 104=WakeupReasons_201815, 105=WakeupReasons_45864, 106=WakeupReasons_659549, 107=WakeupReasons_45866, 108=WakeupReasons_45867, 109=WakeupReasons_169884, 110=WakeupReasons_264962, 111=WakeupReasons_201348, 112=WakeupReasons_320287, 113=WakeupReasons_156412, 114=WakeupReasons_133749, 115=WakeupReasons_355409, 116=WakeupReasons_636692, 117=WakeupReasons_533044, 118=WakeupReasons_106774, 119=WakeupReasons_145311, 120=WakeupReasons_145319, 121=WakeupReasons_152774, 122=WakeupReasons_145330, 123=WakeupReasons_145388, 124=WakeupReasons_145399, 125=WakeupReasons_145362, 126=WakeupReasons_145385, 127=WakeupReasons_145373, 128=WakeupReasons_145288, 129=WakeupReasons_145419, 130=WakeupReasons_145454, 131=WakeupReasons_145462, 132=WakeupReasons_269156, 133=WakeupReasons_300427, 134=WakeupReasons_220322, 135=WakeupReasons_224617, 136=WakeupReasons_224634, 137=WakeupReasons_300682, 138=WakeupReasons_264958, 139=WakeupReasons_160597, 140=WakeupReasons_160602, 141=WakeupReasons_108841, 142=WakeupReasons_265569, 143=WakeupReasons_526429, 144=WakeupReasons_514545, 145=WakeupReasons_265232, 146=WakeupReasons_644550, 147=WakeupReasons_317616, 148=WakeupReasons_354791, 149=WakeupReasons_320631, 150=WakeupReasons_337565, 151=WakeupReasons_532007, 152=WakeupReasons_514503, 153=WakeupReasons_299117, 154=WakeupReasons_340667, 155=WakeupReasons_321845, 156=WakeupReasons_179103, 157=WakeupReasons_108810, 158=WakeupReasons_322857, 159=WakeupReasons_658603, 160=WakeupReasons_197648, 161=WakeupReasons_160596, 162=WakeupReasons_361272, 163=WakeupReasons_361279, 164=WakeupReasons_265305, 165=WakeupReasons_265328, 166=WakeupReasons_265330, 167=WakeupReasons_298808, 168=WakeupReasons_515804, 169=WakeupReasons_514502, 170=WakeupReasons_645753, 171=WakeupReasons_646109, 172=WakeupReasons_299547, 173=WakeupReasons_318342, 174=WakeupReasons_360543, 175=WakeupReasons_356549, 176=WakeupReasons_198484, 177=WakeupReasons_300681, 178=WakeupReasons_359211, 179=WakeupReasons_534077, 180=WakeupReasons_525705, 181=WakeupReasons_360299, 182=WakeupReasons_526445, 183=WakeupReasons_534145, 184=WakeupReasons_192030, 185=WakeupReasons_652361, 186=WakeupReasons_355214, 187=WakeupReasons_321317, 188=WakeupReasons_359187, 189=WakeupReasons_321057, 190=WakeupReasons_321319, 191=WakeupReasons_321323, 192=WakeupReasons_321077, 193=WakeupReasons_320895, 194=WakeupReasons_655340, 195=WakeupReasons_636556, 196=WakeupReasons_108834, 197=WakeupReasons_265937, 198=WakeupReasons_533050, 199=WakeupReasons_526426, 200=WakeupReasons_264712, 201=WakeupReasons_319401, 202=WakeupReasons_643973, 203=WakeupReasons_223715, 204=WakeupReasons_199159, 205=WakeupReasons_318382, 206=WakeupReasons_226967, 207=WakeupReasons_531743, 208=WakeupReasons_360542, 209=WakeupReasons_264726, 210=WakeupReasons_535214, 211=WakeupReasons_335068, 212=WakeupReasons_316796, 213=WakeupReasons_526438, 214=WakeupReasons_198433, 215=WakeupReasons_225961, 216=WakeupReasons_197665, 217=WakeupReasons_224550, 218=WakeupReasons_667962, 219=WakeupReasons_667953, 220=WakeupReasons_110885, 221=WakeupReasons_224552, 222=WakeupReasons_224553, 223=WakeupReasons_652546, 224=WakeupReasons_331194, 225=WakeupReasons_667820, 226=WakeupReasons_659350, 227=WakeupReasons_101706, 228=WakeupReasons_101725, 229=WakeupReasons_101728, 230=WakeupReasons_101727, 231=WakeupReasons_166267, 232=WakeupReasons_156440, 233=WakeupReasons_95949, 234=WakeupReasons_112799, 235=WakeupReasons_146470, 236=WakeupReasons_176748, 237=WakeupReasons_223920, 238=WakeupReasons_668531, 239=WakeupReasons_670087, 240=WakeupReasons_668529, 241=WakeupReasons_45858, 242=WakeupReasons_315981, 243=WakeupReasons_533370, 244=WakeupReasons_533371, 245=WakeupReasons_533372, 246=WakeupReasons_241902, 247=WakeupReasons_359559, 248=WakeupReasons_516327, 249=WakeupReasons_533872, 250=WakeupReasons_45856, 251=WakeupReasons_45853, 252=WakeupReasons_45854, 253=WakeupReasons_45852, 254=WakeupReasons_45851, 255=WakeupReasons_45850, 256=WakeupReasons_45849, 257=WakeupReasons_636801, 258=WakeupReasons_109466, 259=WakeupReasons_109467, 260=WakeupReasons_670345, 261=WakeupReasons_NMPDUReceived, 262=WakeupReasons_358832, 263=WakeupReasons_200683, 264=WakeupReasons_198452, 265=WakeupReasons_185457, 266=WakeupReasons_185490, 267=WakeupReasons_4471, 268=WakeupReasons_269034, 269=WakeupReasons_215560, 270=WakeupReasons_312881, 271=WakeupReasons_269140, 272=WakeupReasons_197653, 273=WakeupReasons_337991, 274=WakeupReasons_658188, 275=WakeupReasons_674953, 276=WakeupReasons_675064, 277=WakeupReasons_674958, 278=WakeupReasons_675494, 279=WakeupReasons_675837, 280=WakeupReasons_667879, 281=WakeupReasons_667947, 282=WakeupReasons_676265, 283=WakeupReasons_669465, 284=WakeupReasons_670928, 285=WakeupReasons_669447, 286=WakeupReasons_667922, 287=WakeupReasons_670753, 288=WakeupReasons_668395, 289=WakeupReasons_668393, 290=WakeupReasons_667850, 291=WakeupReasons_667848, 292=WakeupReasons_311279, 293=WakeupReasons_182918, 294=WakeupReasons_667988, 295=WakeupReasons_532555, 296=WakeupReasons_532556, 297=WakeupReasons_113348, 298=WakeupReasons_193474, 299=WakeupReasons_667871, 300=WakeupReasons_670966, 301=WakeupReasons_667985, 302=WakeupReasons_670354, 303=WakeupReasons_46017, 304=WakeupReasons_675742, 305=WakeupReasons_106669, 306=WakeupReasons_80609, 307=WakeupReasons_199714, 308=WakeupReasons_200090, 309=WakeupReasons_139075, 310=WakeupReasons_268983, 311=WakeupReasons_265131, 312=WakeupReasons_263473, 313=WakeupReasons_45887, 314=WakeupReasons_69678, 315=WakeupReasons_69679, 316=WakeupReasons_45897, 317=WakeupReasons_45898, 318=WakeupReasons_80608, 319=WakeupReasons_45869, 320=WakeupReasons_45870, 321=WakeupReasons_45872, 322=WakeupReasons_45875, 323=WakeupReasons_45871, 324=WakeupReasons_45876, 325=WakeupReasons_667980, 326=WakeupReasons_45877, 327=WakeupReasons_667973, 328=WakeupReasons_670962, 329=WakeupReasons_45888, 330=WakeupReasons_45890, 331=WakeupReasons_667869, 332=WakeupReasons_45846, 333=WakeupReasons_45847, 334=WakeupReasons_45848, 335=WakeupReasons_262872, 336=WakeupReasons_127924, 337=WakeupReasons_127926, 338=WakeupReasons_674223, 339=WakeupReasons_667982, 340=WakeupReasons_657121, 341=WakeupReasons_265745, 342=WakeupReasons_657120, 343=WakeupReasons_675564, 344=WakeupReasons_197644, 345=WakeupReasons_264943, 346=WakeupReasons_264697, 347=WakeupReasons_69216, 348=WakeupReasons_128671, 349=WakeupReasons_356598, 350=WakeupReasons_675745, 351=WakeupReasons_667983, 352=WakeupReasons_667987, 353=WakeupReasons_75103, 354=WakeupReasons_305818, 355=WakeupReasons_670942, 356=WakeupReasons_532932, 357=WakeupReasons_532933, 358=WakeupReasons_83199, 359=WakeupReasons_45900, 360=WakeupReasons_88458, 361=WakeupReasons_329457, 362=WakeupReasons_45902, 363=WakeupReasons_224211, 364=WakeupReasons_667981, 365=WakeupReasons_667874, 366=WakeupReasons_46020, 367=WakeupReasons_667842, 368=WakeupReasons_145161, 369=WakeupReasons_233755, 370=WakeupReasons_297056, 371=WakeupReasons_264691, 372=WakeupReasons_262871, 373=WakeupReasons_264964, 374=WakeupReasons_667872, 375=WakeupReasons_45655, 376=WakeupReasons_177214, 377=WakeupReasons_671005, 378=WakeupReasons_680712, 379=WakeupReasons_669822, 380=WakeupReasons_668523, 381=WakeupReasons_680974, 382=WakeupReasons_680975, 383=WakeupReasons_681028, 384=WakeupReasons_670462, 385=WakeupReasons_681134, 386=WakeupReasons_681031, 387=WakeupReasons_681711, 388=WakeupReasons_682034, 389=WakeupReasons_674839, 390=WakeupReasons_681915, 391=WakeupReasons_682032, 392=WakeupReasons_682037, 393=WakeupReasons_682688, 394=WakeupReasons_681789, 395=WakeupReasons_682023, 396=WakeupReasons_681023, 397=WakeupReasons_676285, 398=WakeupReasons_682077, 399=WakeupReasons_682076, 400=WakeupReasons_682078, 401=WakeupReasons_682153, 402=WakeupReasons_682155, 403=WakeupReasons_682152, 404=WakeupReasons_682154, 405=WakeupReasons_682074, 406=WakeupReasons_680763, 407=WakeupReasons_683934, 408=WakeupReasons_265678, 409=WakeupReasons_170285, 410=WakeupReasons_200637, 411=WakeupReasons_346654, 412=WakeupReasons_91254, 413=WakeupReasons_692021, 414=WakeupReasons_690385, 415=WakeupReasons_170290, 416=WakeupReasons_357498, 417=WakeupReasons_360491, 418=WakeupReasons_265699, 419=WakeupReasons_265698, 420=WakeupReasons_641482, 421=WakeupReasons_641483, 422=WakeupReasons_168968, 423=WakeupReasons_354674, 424=WakeupReasons_168967, 425=WakeupReasons_354672, 426=WakeupReasons_112027, 427=WakeupReasons_112035, 428=WakeupReasons_692020, 429=WakeupReasons_226565, 430=WakeupReasons_675594, 431=WakeupReasons_226571, 432=WakeupReasons_690593, 433=WakeupReasons_692022, 434=WakeupReasons_354809, 435=WakeupReasons_690939, 436=WakeupReasons_677781, 437=WakeupReasons_110173, 438=WakeupReasons_112031, 439=WakeupReasons_45896, 440=WakeupReasons_226569, 441=WakeupReasons_110181, 442=WakeupReasons_654489, 443=WakeupReasons_226570, 444=WakeupReasons_351189, 445=WakeupReasons_644275, 446=WakeupReasons_45895, 447=WakeupReasons_680765, 448=WakeupReasons_354831, 449=WakeupReasons_692439, 450=WakeupReasons_265694, 451=WakeupReasons_273516, 452=WakeupReasons_299120, 453=WakeupReasons_299531, 454=WakeupReasons_299532, 455=WakeupReasons_300690, 456=WakeupReasons_112024, 457=WakeupReasons_514651, 458=WakeupReasons_514652, 459=WakeupReasons_667188, 460=WakeupReasons_533849, 461=WakeupReasons_533850, 462=WakeupReasons_692019, 463=WakeupReasons_512384, 464=WakeupReasons_680764, 465=WakeupReasons_686281, 466=WakeupReasons_667949, 467=WakeupReasons_693005, 468=WakeupReasons_693024, 469=WakeupReasons_693914, 470=WakeupReasons_692547, 471=WakeupReasons_691991, 472=WakeupReasons_698488, 473=WakeupReasons_637992, 474=WakeupReasons_702197, 475=WakeupReasons_700425, 476=WakeupReasons_700485, 477=WakeupReasons_691993, 478=WakeupReasons_698660, 479=WakeupReasons_698288, 480=WakeupReasons_681813, 481=WakeupReasons_687404, 482=WakeupReasons_700467, 483=WakeupReasons_533750, 484=WakeupReasons_698409, 485=WakeupReasons_700686, 486=WakeupReasons_700687, 487=WakeupReasons_296931, 488=WakeupReasons_697145, 489=WakeupReasons_702174, 490=WakeupReasons_194966, 491=WakeupReasons_217907, 492=WakeupReasons_700484, 493=WakeupReasons_701508, 494=WakeupReasons_701509, 495=WakeupReasons_700215, 496=WakeupReasons_700603, 497=WakeupReasons_702204, 498=WakeupReasons_700483, 499=WakeupReasons_691994, 500=WakeupReasons_696612, 501=WakeupReasons_702088, 502=WakeupReasons_696850, 503=WakeupReasons_698129, 504=WakeupReasons_691992, 505=WakeupReasons_700554, 506=WakeupReasons_683263, 507=WakeupReasons_336435, 508=WakeupReasons_644379, 509=WakeupReasons_700684, 510=WakeupReasons_697967, 511=WakeupReasons_699922, 512=WakeupReasons_698385, 513=WakeupReasons_700692, 514=WakeupReasons_696971, 515=WakeupReasons_700782, 516=WakeupReasons_700486, 517=WakeupReasons_699919, 518=WakeupReasons_699921, 519=WakeupReasons_700130, 520=WakeupReasons_698130, 521=WakeupReasons_698581, 522=WakeupReasons_533751, 523=WakeupReasons_701270, 524=WakeupReasons_702240, 525=WakeupReasons_699114, 526=WakeupReasons_701872, 527=WakeupReasons_702448, 528=WakeupReasons_702439, 529=WakeupReasons_702402, 530=WakeupReasons_700565, 531=WakeupReasons_702452, 532=WakeupReasons_698631, 533=WakeupReasons_700530, 534=WakeupReason_713752, 535=WakeupReason_702478, 536=WakeupReason_714675, 537=WakeupReason_713786, 538=WakeupReason_716243, 539=WakeupReason_710922, 540=WakeupReason_714030, 541=WakeupReason_715842, 542=WakeupReason_714678, 543=WakeupReason_714679, 544=WakeupReason_710807, 545=WakeupReason_713568, 546=WakeupReason_706194, 547=WakeupReason_713799, 548=WakeupReason_714172, 549=WakeupReason_714265, 550=WakeupReason_715529, 551=WakeupReason_708964, 552=WakeupReason_710893, 553=WakeupReason_709196, 554=WakeupReason_714806, 555=WakeupReason_714799, 556=WakeupReason_714697, 557=WakeupReason_717832, 558=WakeupReason_838116, 559=WakeupReason_839473, 560=WakeupReason_839705, 561=WakeupReason_837833, 562=WakeupReason_703140, 563=WakeupReason_837962, 564=WakeupReason_702903, 565=WakeupReason_837760, 566=WakeupReason_839458, 576=WakeupReason_840035, 577=WakeupReason_714677, 578=WakeupReason_839181, 579=WakeupReason_839787, 580=WakeupReason_841275, 581=WakeupReason_320145, 582=WakeupReason_322113, 583=WakeupReason_298032, 584=WakeupReason_675452, 585=WakeupReason_675489, 586=WakeupReason_846372, 587=WakeupReason_842273, 588=WakeupReason_845930, 589=WakeupReason_846002, 590=WakeupReason_361441, 591=WakeupReason_361474, 592=WakeupReason_362462, 593=WakeupReason_645735, 594=WakeupReason_667533, 595=WakeupReason_702420, 596=WakeupReason_851482, 597=WakeupReason_851743, 598=WakeupReason_852010, 599=WakeupReason_852050, 600=WakeupReason_852180, 601=WakeupReason_852184, 602=WakeupReason_852194, 603=WakeupReason_852195, 604=WakeupReason_852200, 605=WakeupReason_852215, 606=WakeupReason_852218, 607=WakeupReason_852219, 608=WakeupReason_852248, 609=WakeupReason_852273, 610=WakeupReason_852298, 611=WakeupReason_852385, 612=WakeupReason_852388, 613=WakeupReason_852537, 614=WakeupReason_852646, 615=WakeupReason_852944, 616=WakeupReason_852947, 617=WakeupReason_714340, 618=WakeupReason_855029, 619=WakeupReason_854999, 620=WakeupReason_854839, 621=WakeupReason_855134, 622=WakeupReason_854947, 623=WakeupReason_855002, 624=WakeupReason_855003, 625=WakeupReason_872253, 626=WakeupReason_856465, 627=WakeupReason_847054, 628=WakeupReason_858191, 629=WakeupReason_870276, 630=WakeupReason_872056, 631=WakeupReason_858188, 632=WakeupReason_858189, 633=WakeupReason_856224, 634=WakeupReason_856234, 635=WakeupReason_908115, 636=WakeupReason_908128, 637=WakeupReason_987485, 638=WakeupReason_988821, 639=WakeupReason_988826, 640=WakeupReason_858187, 641=WakeupReason_987405, 642=WakeupReason_973574, 643=WakeupReasons_973575, 644=WakeupReasons_858152, 645=WakeupReasons_858169, 646=WakeupReasons_858177, 647=WakeupReasons_909026, 648=WakeupReasons_909025, 649=WakeupReasons_885767, 650=WakeupReasons_ADCUReserve, 651=WakeupReasons_527346, 652=WakeupReasons_527347, 653=WakeupReasons_533578, 654=WakeupReasons_527348, 655=WakeupReasons_1030255, 656=WakeupReasons_533576, 657=WakeupReasons_533581, 658=WakeupReasons_533580, 659=WakeupReasons_988154, 660=WakeupReasons_527345, 661=WakeupReasons_1030293, 662=WakeupReasons_1030297, 663=WakeupReasons_1030361, 664=WakeupReasons_1030362, 665=WakeupReasons_1028729, 666=WakeupReasons_1031990, 667=WakeupReasons_1031765, 668=WakeupReasons_1030302, 669=WakeupReasons_1031288, 670=WakeupReasons_1033560, 671=WakeupReasons_1031907, 672=WakeupReasons_1030759, 673=WakeupReasons_1028778, 674=WakeupReasons_1031030, 675=WakeupReasons_1033569, 676=WakeupReasons_1032791, 677=WakeupReasons_1032743, 678=WakeupReasons_1033546, 679=WakeupReasons_1033555, 680=WakeupReasons_852370, 681=WakeupReasons_1033565, 682=WakeupReasons_1029735, 683=WakeupReasons_1030760, 684=WakeupReasons_1033540, 685=WakeupReasons_1033551, 686=WakeupReasons_1033566, 687=WakeupReasons_1031936, 688=WakeupReasons_1033557, 689=WakeupReasons_1032579, 690=WakeupReasons_1033550, 691=WakeupReasons_1030761, 692=WakeupReasons_1030360, 693=WakeupReasons_1031029, 694=WakeupReasons_1033561, 695=WakeupReasons_1033544, 696=WakeupReasons_1033559, 697=WakeupReasons_1033553, 698=WakeupReasons_1033552, 699=WakeupReasons_1031789, 700=WakeupReasons_1033538, 701=WakeupReasons_1029166, 702=WakeupReasons_1033533, 703=WakeupReasons_1033632, 704=WakeupReasons_1033542, 705=WakeupReasons_1031280, 706=WakeupReasons_1032477, 707=WakeupReasons_1033534, 708=WakeupReasons_1033539, 709=WakeupReasons_1033556, 710=WakeupReasons_1030941, 711=WakeupReasons_1030764, 712=WakeupReasons_1026103, 713=WakeupReasons_986765, 714=WakeupReasons_1033564, 715=WakeupReasons_1033562, 716=WakeupReasons_1033541, 717=WakeupReasons_1033547, 718=WakeupReasons_1024928, 719=WakeupReasons_1032619, 720=WakeupReasons_1029382, 721=WakeupReasons_1029383, 722=WakeupReasons_1029384, 723=WakeupReasons_1033558, 724=WakeupReasons_1033563, 725=WakeupReasons_1033554, 726=WakeupReasons_1033549, 727=WakeupReasons_1033543, 728=WakeupReasons_1033567, 729=WakeupReasons_1028674, 730=WakeupReasons_1030765, 731=WakeupReasons_1033479, 732=WakeupReasons_1033537, 733=WakeupReasons_1033548, 734=WakeupReasons_1031929, 735=WakeupReasons_671146, 736=WakeupReasons_675025, 737=WakeupReasons_839414, 738=WakeupReasons_700779, 739=WakeupReasons_871729, 740=WakeupReasons_871957, 741=WakeupReasons_871868; unit Unitless
  compu method GearLvrIndcn2_1: 0=GearLvrIndcn2_ParkIndcn, 1=GearLvrIndcn2_RvsIndcn, 2=GearLvrIndcn2_NeutIndcn, 3=GearLvrIndcn2_DrvIndcn, 4=GearLvrIndcn2_ManModeIndcn, 5=GearLvrIndcn2_Resd1, 6=GearLvrIndcn2_Resd2, 7=GearLvrIndcn2_Undefd; unit Unitless
  compu method UsgModSts1_1: 0=UsgModSts1_UsgModAbdnd, 1=UsgModSts1_UsgModInActv, 2=UsgModSts1_UsgModCnvinc, 11=UsgModSts1_UsgModActv, 13=UsgModSts1_UsgModDrvg; unit Unitless
  compu method CarModSts1_1: 0=CarModSts1_CarModNorm, 1=CarModSts1_CarModTrnsp, 2=CarModSts1_CarModFcy, 3=CarModSts1_CarModCrash, 5=CarModSts1_CarModDyno; unit Unitless
  compu method PostImpctBrkgNoYes_1: 0=PostImpctBrkgNoYes_Undefd0, 1=PostImpctBrkgNoYes_No, 2=PostImpctBrkgNoYes_Yes, 3=PostImpctBrkgNoYes_Undefd3; unit Unitless
  compu method NoYesCrit1_1: 0=NoYesCrit1_NotVld1, 1=NoYesCrit1_No, 2=NoYesCrit1_Yes, 3=NoYesCrit1_NotVld2; unit Unitless
  compu method CrsCtrlrSts1_1: 1=CrsCtrlrSts1_Off, 2=CrsCtrlrSts1_Stb, 3=CrsCtrlrSts1_Actv; unit Unitless
  compu method AsyALgtSts_4: 0=AsyALgtSts_Reserved1, 1=AsyALgtSts_AccSts1_StandBy, 2=AsyALgtSts_AccSts1_Active, 3=AsyALgtSts_Reserved2, 4=AsyALgtSts_AccSts1_Override, 5=AsyALgtSts_AccSts1_StandActive, 6=AsyALgtSts_AccSts1_StandWait, 7=AsyALgtSts_AccSts1_TemporaryFailure, 8=AsyALgtSts_AccSts1_PermanentFailure, 9=AsyALgtSts_Reserved3; unit Unitless
  compu method CrashFb_1: 0=CrashFb_Idle, 1=CrashFb_Evln, 2=CrashFb_Nok, 3=CrashFb_Ok; unit Unitless
  compu method IndcrSts1_1: 0=IndcrSts1_Off, 1=IndcrSts1_LeOn, 2=IndcrSts1_RiOn, 3=IndcrSts1_LeAndRiOn; unit Unitless
  compu method CrashSts4_1: 0=CrashSts4_Resd1, 1=CrashSts4_NoCrash, 2=CrashSts4_Crash, 3=CrashSts4_SlightCrash; unit Unitless
  compu method PassAirbLampReq_1: 0=PassAirbLampReq_LampNotCfgd, 1=PassAirbLampReq_LampOn, 2=PassAirbLampReq_LampOff, 3=PassAirbLampReq_Resd; unit Unitless
  compu method OnOffCrit1_1: 0=OnOffCrit1_NotVld1, 1=OnOffCrit1_Off, 2=OnOffCrit1_On, 3=OnOffCrit1_NotVld2; unit Unitless
  compu method Orntn_1: 0=Orntn_OnWheels, 1=Orntn_LeftSide, 2=Orntn_RightSide, 3=Orntn_OnRoof, 4=Orntn_Indeterminate, 5=Orntn_Resd1, 6=Orntn_Resd2, 7=Orntn_Resd3; unit Unitless
  compu method CrashSt_1: 0=CrashSt_NoCrash, 1=CrashSt_CrashImminent, 2=CrashSt_CrashInProgress, 3=CrashSt_CrashEnding; unit Unitless
  compu method RestrntSysLampReq_1: 0=RestrntSysLampReq_LampOff, 1=RestrntSysLampReq_Ukwn, 2=RestrntSysLampReq_LampFlash, 3=RestrntSysLampReq_LampOn; unit Unitless
  compu method PassSeatSts1_1: 0=PassSeatSts1_Empty, 1=PassSeatSts1_Fmale, 2=PassSeatSts1_OccptLrg, 3=PassSeatSts1_Ukwn; unit Unitless
  compu method ReqForHzrdInt_1: 0=ReqForHzrdInt_NoLowerCrash, 1=ReqForHzrdInt_LowerCrash; unit Unitless
  compu method AmbTIndcdUnit_1: 0=AmbTIndcdUnit_Celsius, 1=AmbTIndcdUnit_Fahrenheit, 2=AmbTIndcdUnit_UkwnUnit; unit Unitless
  compu method AsyAutDrvCtrlTyp_4: 0=AsyAutDrvCtrlTyp_Inactive, 1=AsyAutDrvCtrlTyp_ACC, 2=AsyAutDrvCtrlTyp_GPilot, 3=AsyAutDrvCtrlTyp_D2D; unit Unitless
  compu method CllsnMtgtnFctSts_2: 0=CllsnMtgtnFctSts_Reserved1, 1=CllsnMtgtnFctSts_OFF, 2=CllsnMtgtnFctSts_ON, 3=CllsnMtgtnFctSts_TemporaryError, 4=CllsnMtgtnFctSts_PermenentError, 5=CllsnMtgtnFctSts_AEB_PEDNotAvalid, 6=CllsnMtgtnFctSts_Reserved2, 7=CllsnMtgtnFctSts_Reserved3; unit Unitless
  compu method DispOfPrpsnModForEv_2: 0=DispOfPrpsnModForEv_NotReady, 1=DispOfPrpsnModForEv_Charging, 2=DispOfPrpsnModForEv_PureElecAWD, 3=DispOfPrpsnModForEv_OnlyPrpsnMotElecFrnt, 4=DispOfPrpsnModForEv_OnlyPrpsnMotElecRe, 5=DispOfPrpsnModForEv_NoPrpsnMotElec, 6=DispOfPrpsnModForEv_Rgn, 7..12=DispOfPrpsnModForEv_Reserved1..DispOfPrpsnModForEv_Reserved6, 13=DispOfPrpsnModForEv_Abnormal, 14=DispOfPrpsnModForEv_Invalid, 15=DispOfPrpsnModForEv_Reserved7; unit Unitless
  compu method LockSts2_1: 0=LockSts2_LockStsUkwn, 1=LockSts2_Unlckd, 2=LockSts2_Lockd, 3=LockSts2_SafeLockd; unit Unitless
  compu method DrvrCrsCtrlFctSeldTyp_4: 0=DrvrCrsCtrlFctSeldTyp_Off, 1=DrvrCrsCtrlFctSeldTyp_SpdLimFct_Main_Swt, 2=DrvrCrsCtrlFctSeldTyp_SpdLimFct_Resu, 3=DrvrCrsCtrlFctSeldTyp_CrsCtrlFct_Main_Swt, 4=DrvrCrsCtrlFctSeldTyp_CrsCtrlFct_Resu, 5=DrvrCrsCtrlFctSeldTyp_AccFct_Main_Swt, 6=DrvrCrsCtrlFctSeldTyp_AccFct_Resu, 7=DrvrCrsCtrlFctSeldTyp_OffRoadCrsCtrlFc; unit Unitless
  compu method PWarnFlg_2: 0=PWarnFlg_Normal, 1=PWarnFlg_LowPressureWarning, 2=PWarnFlg_HighPressureWarning, 3=PWarnFlg_Reserve; unit Unitless
  compu method PassAirbLampSts1_1: 0=PassAirbLampSts1_Resd1, 1=PassAirbLampSts1_LampStsOk, 2=PassAirbLampSts1_LampStsNotOk, 3=PassAirbLampSts1_Resd2; unit Unitless
  compu method ReqForPassAirbIndcnAckd_1: 0=ReqForPassAirbIndcnAckd_Idle, 1=ReqForPassAirbIndcnAckd_MsgAckd; unit Unitless
  compu method TrsmActrPosn1_1: 0=TrsmActrPosn1_Park, 1=TrsmActrPosn1_ParkRvs, 2=TrsmActrPosn1_Rvs, 3=TrsmActrPosn1_RvsNeut, 4=TrsmActrPosn1_Neut, 5=TrsmActrPosn1_NeutDrv, 6=TrsmActrPosn1_Drv, 7=TrsmActrPosn1_Undefd; unit Unitless
  compu method DispOfPrpsnMod4_3: 0=DispOfPrpsnMod4_NotRdy, 1=DispOfPrpsnMod4_ChrgnWithOnBdChrgr, 2=DispOfPrpsnMod4_PrpsnMotElecAndPrpsnEng, 3=DispOfPrpsnMod4_PrpsnMotElecAndPrpsnEngAndChrgn, 4=DispOfPrpsnMod4_OnlyEngPrpsn, 5=DispOfPrpsnMod4_OnlyEngPrpsnAndChrgn, 6=DispOfPrpsnMod4_OnlyPrpsnMotElec, 7=DispOfPrpsnMod4_NoPrpsnMotElecAndEngOff, 8=DispOfPrpsnMod4_NoPrpsnMotElecAndOnEng, 9=DispOfPrpsnMod4_NoPrpsnMotElecAndOnEngAndChrgn, 10=DispOfPrpsnMod4_BrkgRgnAndEngOff, 11=DispOfPrpsnMod4_BrkgRgnAndOnEng, 12=DispOfPrpsnMod4_BrkgRgnAndEngOnAndChrgn, 13=DispOfPrpsnMod4_Abnormal, 14=DispOfPrpsnMod4_PrpsnMotElecAndEngChrgn, 15=DispOfPrpsnMod4_PrpsnMotElecAndEngOn; unit Unitless
  compu method AfsStsReq_4: 0=AfsStsReq_Inactive, 1=AfsStsReq_AutomaticallySet, 2=AfsStsReq_ManuallySet, 3=AfsStsReq_Fault; unit Unitless
  compu method IndcrTypExt1_1: 0=IndcrTypExt1_Off, 1=IndcrTypExt1_Le, 2=IndcrTypExt1_Ri; unit Unitless
  compu method CllsnFwdWarnReq_1: 0=CllsnFwdWarnReq_NoWarning, 1=CllsnFwdWarnReq_WarningActive, 2=CllsnFwdWarnReq_LatentWarning; unit Unitless
  compu method ObjectClass_2: 0=ObjectClass_Unknown, 1=ObjectClass_Car, 2=ObjectClass_Truck, 3=ObjectClass_Pedestrian, 6=ObjectClass_SensorError; unit Unitless
  compu method NotOkOk_2: 0=NotOkOk_NotOk, 1=NotOkOk_Ok, 2=NotOkOk_Di, 3=NotOkOk_Resd; unit Unitless
  compu method HomePrkgSysSts1_2: 0=HomePrkgSysSts1_Off, 1=HomePrkgSysSts1_Standby, 2=HomePrkgSysSts1_ParkInMapBuilding, 3=HomePrkgSysSts1_Localization, 4=HomePrkgSysSts1_ParkInCruising, 5=HomePrkgSysSts1_ParkOutCrusing, 6=HomePrkgSysSts1_ParkInMapBuildingAPAPreactive, 7=HomePrkgSysSts1_Interrupt, 8=HomePrkgSysSts1_ParkInPreactive, 9=HomePrkgSysSts1_ParkInProcess, 10=HomePrkgSysSts1_ParkInRandomParkingIn, 11=HomePrkgSysSts1_ParkInMapBuildingAPAParking, 12=HomePrkgSysSts1_ParkOutPreactive, 13=HomePrkgSysSts1_ParkOutProcess, 14=HomePrkgSysSts1_Quit, 15=HomePrkgSysSts1_ParkInCompleted, 16=HomePrkgSysSts1_ParkOutCompleted, 17=HomePrkgSysSts1_Abort, 18=HomePrkgSysSts1_Suspend, 19=HomePrkgSysSts1_Initialization, 20=HomePrkgSysSts1_Failure, 21=HomePrkgSysSts1_Ready, 22=HomePrkgSysSts1_ParkOutMapBuilding, 23=HomePrkgSysSts1_ParkInMapBuildingGenerate, 24=HomePrkgSysSts1_ParkOutMapBuildingGenerate, 25=HomePrkgSysSts1_ParkInMapBuildingNamed, 26=HomePrkgSysSts1_ParkOutMapBuildingNamed, 27=HomePrkgSysSts1_Exit, 28=HomePrkgSysSts_ParkOutTakeOver; unit Unitless
  compu method VehSpdIndcdUnit_1: 0=VehSpdIndcdUnit_Kmph, 1=VehSpdIndcdUnit_Mph, 2=VehSpdIndcdUnit_UkwnUnit; unit Unitless
  compu method APATo_1: 0=APATo_Defualt, 1=APATo_Faulted, 2=APATo_Off, 3=APATo_StandBy, 4=APATo_Active, 5=APATo_Reserved1, 6=APATo_Reserved2, 7=APATo_Reserved3; unit Unitless
  compu method AEBSFctSts_1: 0=AEBSFctSts_Default, 1=AEBSFctSts_Faulted, 2=AEBSFctSts_Off, 3=AEBSFctSts_OnButNotEngaged, 4=AEBSFctSts_WarningButNotEngaged, 5=AEBSFctSts_Engaged; unit Unitless
  compu method ACCFctSTs_1: 0=FctSTs_Default, 1=FctSTs_Faulted, 2=FctSTs_Off, 3=FctSTs_StandBy, 4=FctSTs_Active; unit Unitless
  compu method LDWSFctSts_1: 0=LDWSFctSts_Default, 1=LDWSFctSts_Faulted, 2=LDWSFctSts_Off, 3=LDWSFctSts_OnButNotEngaged, 4=LDWSFctSts_WarningLeft, 5=LDWSFctSts_WarningRight; unit Unitless
  compu method CrsCtrlrMsg1_1: 0=CrsCtrlrMsg1_NoMsg, 1=CrsCtrlrMsg1_CrsCtrlrCncl, 2=CrsCtrlrMsg1_OvrdTiMaxExcdd, 3=CrsCtrlrMsg1_CrsCtrlrInhb, 4=CrsCtrlrMsg1_SpdLoLimExcdd, 5=CrsCtrlrMsg1_CrsCtrlrCnclSpdLoLimExcdd, 6=CrsCtrlrMsg1_DrvModSeldNotOk, 7=CrsCtrlrMsg1_BrkOvrheatd; unit Unitless
package /Units
  24 x unit:
    MtrPerSecSqd_1: display-name=m/s^2
    NoUnit_1: display-name=Unitless
    Rpm_1: display-name=rpm
    MtrPerSec_1: display-name=m/s
    Sec_1: display-name=s
    RadPerSec_1: display-name=rad/s
    NwtMtr_1: display-name=Nm
    Nm_1: display-name=NewtonMeter
    Bar_1: display-name=bar
    KiloMtrPerHr_1: display-name=Km/h
    Perc_1: display-name=%
    km_1: display-name=km
    Rad_1: display-name=rad
    DegCgrd_1: display-name=degC
    Volt_1: display-name=Volt
    Yr_1: display-name=Year
    Mth_1: display-name=Month
    Day_1: display-name=Days
    Hr_1: display-name=hours
    Mins_1: display-name=Mins
    MtrPerSecCubd_1: display-name=m/s^3
    RpmPerSec_1: display-name=RpmPerSec
    Deg_1: display-name=Deg
    KiloPa_1: display-name=KiloPa
package /ConstantSpecifications
  156 x constant specification:
    VehMtnSt_10: value-spec=fields=[0 Unitless, 0 Unitless, 0 Unitless]
    VehSpdLgt_15: value-spec=fields=[0 m/s, 1 Unitless, 0 Unitless, 0 Unitless]
    WhlDirRotlFrnt_3: value-spec=fields=[0 Unitless, 0 Unitless, 0 Unitless, 0 Unitless]
    WhlDirRotlRe_9: value-spec=fields=[0 Unitless, 0 Unitless, 0 Unitless, 0 Unitless]
    WhlSpdCircumlFrnt_10: value-spec=fields=[0 m/s, 1 Unitless, 0 m/s, 1 Unitless, 0 Unitless, 0 Unitless]
    WhlSpdCircumlRe_9: value-spec=fields=[0 m/s, 1 Unitless, 0 m/s, 1 Unitless, 0 Unitless, 0 Unitless]
    AbsCtrlActv_9: value-spec=fields=[0 Unitless, 0 Unitless, 0 Unitless]
    AbsSts_6: value-spec=0 Unitless
    BrkAndAbsWarnIndcnReq_7: value-spec=fields=[1 Unitless, 3 Unitless, 0 Unitless, 0 Unitless]
    BrkFricTqTotAtWhlsAct_8: value-spec=fields=[0 NewtonMeter, 0 Unitless, 0 Unitless]
    BrkSysCylPMst_7: value-spec=fields=[0 bar, 1 Unitless, 0 bar, 0 bar, 1 Unitless, 0 Unitless, 0 Unitless]
    BrkTqAtWhlsReq_6: value-spec=0 Nm
    BrkTracCtrlActv_7: value-spec=0 Unitless
    EscCtrlIndcn_8: value-spec=1 Unitless
    EscSt_8: value-spec=fields=[1 Unitless, 0 Unitless, 0 Unitless]
    PostImpctBrkgRdy_5: value-spec=0 Unitless
    EpbSts_5: value-spec=fields=[0 Unitless, 0 Unitless, 0 Unitless]
    BrkPedlPsd_7: value-spec=fields=[0 Unitless, 0 Unitless, 0 Unitless, 0 Unitless, 0 Unitless]
    BrkPedlrRat_5: value-spec=fields=[0 %, 0 Unitless]
    ADataRawSafe_8: value-spec=fields=[0 m/s^2, 1 Unitless, 0 m/s^2, 1 Unitless, 9.8175 m/s^2, 1 Unitless, 255 Unitless, 0 Unitless]
    AccrPedlRat_7: value-spec=fields=[0 %, 0 Unitless, 0 Unitless]
    AgDataRawSafe_6: value-spec=fields=[0 rad/s, 1 Unitless, 0 rad/s, 1 Unitless, 255 Unitless, 0 Unitless]
    GearLvrIndcn_6: value-spec=7 Unitless
    JID_6: value-spec=fields=[255 Unitless, 255 Unitless, 255 Unitless, 255 Unitless, 255 Unitless, 255 Unitless, 255 Unitless, 255 Unitless]
    PinionSteerAgGroup_2: value-spec=fields=[0 rad, 1 Unitless, 0 rad/s, 1 Unitless, 0 NewtonMeter, 1 Unitless, 0 Unitless, 0 Unitless]
    VehModMngtGlbSafe1_7: value-spec=fields=[1 Unitless, 0 Unitless, 0 Unitless, 0 Unitless, 0 Unitless, 0 Unitless, 0 Unitless, 0 Unitless, 0 Unitless, 0 Unitless]
    WhlMotSysSpdAct_5: value-spec=0 rpm
    DoorDrvrSts_5: value-spec=0 Unitless
    AgDataRaw2Safe_5: value-spec=fields=[255 Unitless, 0 Unitless, 1 Unitless, 0 rad/s]
    BrkPedlSts_4: value-spec=0 Unitless
    RecOfPostImpctBrkgCfmd_6: value-spec=fields=[1 Unitless, 1 Unitless, 1 Unitless, 1 Unitless, 1 Unitless, 1 Unitless, 1 Unitless, 1 Unitless, 1 Unitless, 1 Unitless, 1 Unitless, 1 Unitless, 1 Unitless, 255 Unitless, 0 Unitless]
    RecOfPostImpctBrkgSuspc_4: value-spec=fields=[1 Unitless, 255 Unitless, 0 Unitless]
    BltLockStAtDrvr_6: value-spec=fields=[1 Unitless, 0 Unitless]
    VehCfgPrm_5: value-spec=fields=[0 Unitless, 0 Unitless, 0 Unitless, 0 Unitless, 0 Unitless, 0 Unitless, 0 Unitless, 0 Unitless]
    BkpOfDstTrvld_7: value-spec=0 km
    Vin_6: value-spec=fields=[0 Unitless, 0 Unitless, 0 Unitless, 0 Unitless, 0 Unitless, 0 Unitless, 0 Unitless, 0 Unitless]
    CarTiGlb_5: value-spec=0 s
    VehBattU_8: value-spec=fields=[0 Volt, 1 Unitless]
    TiAndDateIndcn_5: value-spec=fields=[0 Year, 1 Month, 1 Days, 0 hours, 0 Mins, 0 s, 0 Unitless]
    VehCfgPrmExt_2: value-spec=fields=[0 Unitless, 0 Unitless, 0 Unitless, 0 Unitless, 0 Unitless, 0 Unitless, 0 Unitless, 0 Unitless]
    VehCfgPrmExt2_1: value-spec=fields=[0 Unitless, 0 Unitless, 0 Unitless, 0 Unitless, 0 Unitless, 0 Unitless, 0 Unitless, 0 Unitless]
    AsyDataWithCmpSafe_5: value-spec=fields=[0 rad/s, 1 Unitless, 0 m/s^2, 1 Unitless, 0 m/s^3, 1 Unitless, 255 Unitless, 0 Unitless]
    CrsCtrlrSts_3: value-spec=1 Unitless
    EngNSafe_7: value-spec=fields=[0 rpm, 0 RpmPerSec, 0 Unitless, 0 Unitless]
    IsgSpdActSgn_8: value-spec=0 rpm
    ThrPos_3: value-spec=0 %
    SftyDecelGroupSafe_5a1: value-spec=fields=[0 Unitless, 0 Unitless, 0 Unitless, 0 m/s^2]
    AsyALgtSts_5: value-spec=fields=[0 Unitless, 0 Unitless, 0 Unitless]
    CrashStsSafe_2: value-spec=fields=[0 Unitless, 255 Unitless, 0 Unitless]
    HVfault_1: value-spec=0 Unitless
    DoorLeReSts_6: value-spec=0 Unitless
    DoorPassSts_5: value-spec=0 Unitless
    DoorRiReSts_6: value-spec=0 Unitless
    VehTiAndData_4: value-spec=fields=[0 Year, 1 Month, 1 Days, 0 hours, 0 Mins, 0 s, 0 Unitless]
    AgDataCmpQuality_3: value-spec=fields=[0 Unitless, 0 Unitless, 0 Unitless]
    BltLockStAtPass_5: value-spec=fields=[1 Unitless, 0 Unitless]
    BltLockStAtRowSecLe_5: value-spec=fields=[0 Unitless, 1 Unitless, 1 Unitless]
    BltLockStAtRowSecMid_5: value-spec=fields=[0 Unitless, 1 Unitless, 1 Unitless]
    BltLockStAtRowSecRi_5: value-spec=fields=[0 Unitless, 1 Unitless, 1 Unitless]
    BltLockStAtRowThrdLe_5: value-spec=fields=[0 Unitless, 1 Unitless, 1 Unitless]
    BltLockStAtRowThrdMid_1: value-spec=fields=[0 Unitless, 1 Unitless, 1 Unitless]
    BltLockStAtRowThrdRi_5: value-spec=fields=[0 Unitless, 1 Unitless, 1 Unitless]
    BltLockStSafeAtDrvr_8: value-spec=fields=[1 Unitless, 0 Unitless, 255 Unitless, 0 Unitless]
    CrashSts2_11: value-spec=0 Unitless
    NotifForEmgyCall_4: value-spec=0 Unitless
    PassAirbLampReq_5: value-spec=fields=[2 Unitless, 2 Unitless, 255 Unitless, 0 Unitless, 0 Unitless]
    PedProtnMsgReqForFlt_4: value-spec=0 Unitless
    PedProtnMsgReqForImpct_4: value-spec=0 Unitless
    RecOfImpct_7: value-spec=fields=[4 Unitless, 0 Unitless, 0 Unitless, 0 Unitless, 0 Unitless, 0 Unitless, 0 Unitless, 0 Unitless, 0 Unitless, 0 Unitless, 0 Unitless, 0 Unitless, 0 Km/h, 0 Km/h, 0 Deg]
    RestrntSysLampReq_4: value-spec=0 Unitless
    RestrntSysMsgReq_4: value-spec=1 Unitless
    SafetyCrashFb_5: value-spec=0 Unitless
    SeatOccptAtRowThrdMid_1: value-spec=0 Unitless
    BltLockStAtPassMid_1: value-spec=fields=[0 Unitless, 1 Unitless, 1 Unitless]
    BltLockStAtRowFrthLe_1: value-spec=fields=[0 Unitless, 1 Unitless, 1 Unitless]
    BltLockStAtRowFrthMid_1: value-spec=fields=[0 Unitless, 1 Unitless, 1 Unitless]
    BltLockStAtRowFrthRi_1: value-spec=fields=[0 Unitless, 1 Unitless, 1 Unitless]
    PassMidSeatSts_1: value-spec=0 Unitless
    SeatOccptAtRowFrthLe_1: value-spec=0 Unitless
    SeatOccptAtRowFrthMid_1: value-spec=0 Unitless
    SeatOccptAtRowFrthRi_1: value-spec=0 Unitless
    RecOfImpct2_2: value-spec=fields=[0 Km/h, 0 Km/h]
    ReqForHzrdInt_1: value-spec=0 Unitless
    VFCVectorSRS_9a1: value-spec=fields=[0 Unitless, 0 Unitless, 0 Unitless, 0 Unitless, 0 Unitless, 0 Unitless, 0 Unitless, 0 Unitless, 0 Unitless, 0 Unitless, 0 Unitless, 0 Unitless, 0 Unitless, 0 Unitless, 0 Unitless, 0 Unitless, 0 Unitless, 0 Unitless, 0 Unitless, 0 Unitless, 0 Unitless, 0 Unitless, 0 Unitless, 0 Unitless, 0 Unitless, 0 Unitless, 0 Unitless, 0 Unitless, 0 Unitless, 0 Unitless, 0 Unitless, 0 Unitless, 0 Unitless, 0 Unitless, 0 Unitless, 0 Unitless, 0 Unitless, 0 Unitless, 0 Unitless, 0 Unitless, 0 Unitless, 0 Unitless, 0 Unitless, 0 Unitless, 0 Unitless, 0 Unitless, 0 Unitless, 0 Unitless, 0 Unitless, 0 Unitless, 0 Unitless, 0 Unitless, 0 Unitless, 0 Unitless, 0 Unitless, 0 Unitless, 0 Unitless, 0 Unitless, 0 Unitless, 0 Unitless, 0 Unitless, 0 Unitless, 0 Unitless]
    WakeUpReasonsforSRS_2: value-spec=0 Unitless
    DstTrvldFromSftyBkp_2: value-spec=0 km
    DstTrvldVldFromSftyBkp_2: value-spec=0 Unitless
    ActvnReqOfRtrctrRvsbLe_2: value-spec=0 Unitless
    ActvnReqOfRtrctrRvsbRi_2: value-spec=0 Unitless
    BltCrashNotif_4: value-spec=fields=[0 Unitless, 0 Unitless]
    PassAirbSts_5: value-spec=1 Unitless
    SRSdevelpsignalgroupTX_3: value-spec=fields=[0 Unitless, 0 Unitless, 0 Unitless, 0 Unitless, 0 Unitless, 0 Unitless, 0 Unitless, 0 Unitless]
    SRSResdSig1ToZCUDMSafety_1: value-spec=fields=[0 Unitless, 0 Unitless, 0 Unitless]
    SRSIntVolt_1: value-spec=0 Volt
    SftyAirbRollovrSuppSts_1: value-spec=0 Unitless
    ReqForAsyDataStorgFromRestrntSys_1: value-spec=0 Unitless
    IntgtIMUDataRawSafe_1: value-spec=fields=[0 m/s^2, 1 Unitless, 0 m/s^2, 1 Unitless, 9.8175 m/s^2, 1 Unitless, 0 rad/s, 1 Unitless, 0 rad/s, 1 Unitless, 0 rad/s, 1 Unitless, 255 Unitless, 0 Unitless]
    PassAirbStsChgNotifReq_1: value-spec=0 Unitless
    AccrpedlSts_6: value-spec=fields=[0 Unitless, 0 Unitless, 0 Unitless]
    AmbTIndcdWithUnit_3: value-spec=fields=[0 Unitless, 0 Unitless, 0 Unitless]
    AsyAutDrvCtrlTyp_7: value-spec=0 Unitless
    CarModCrashSaved_4: value-spec=0 Unitless
    CllsnAidPost_2: value-spec=0 Unitless
    CllsnMtgtnFctSts_4: value-spec=2 Unitless
    CrsCtrlrActvnOk_3: value-spec=0 Unitless
    CrsCtrlrStbOk_2: value-spec=0 Unitless
    DispOfPrpsnModForEv_2: value-spec=0 Unitless
    DoorDrvrLockSts_5: value-spec=0 Unitless
    DoorLeReLockSts_6: value-spec=0 Unitless
    DoorPassLockSts_5: value-spec=0 Unitless
    DoorRiReLockSts_6: value-spec=0 Unitless
    DrvrCrsCtrlFctSeld_8: value-spec=0 Unitless
    DrvrSeatPosPerc_4: value-spec=fields=[1 Unitless, 100 %, 1 Unitless, 100 %, 1 Unitless, 100 %]
    EngN2_4: value-spec=0 rpm
    LeFrntTireMsg_6: value-spec=fields=[0 Unitless, 0 Unitless, 0 Unitless, 0 Unitless, 0 Unitless, 0 Unitless, 0 Unitless, 205 degC, 350.115 KiloPa]
    LeReTireMsg_6: value-spec=fields=[0 Unitless, 0 Unitless, 0 Unitless, 0 Unitless, 0 Unitless, 0 Unitless, 0 Unitless, 205 degC, 350.115 KiloPa]
    PassAirbLampStsRec_5: value-spec=fields=[1 Unitless, 255 Unitless, 0 Unitless]
    PassSeatPosPerc_4: value-spec=fields=[1 Unitless, 100 %, 1 Unitless, 100 %, 1 Unitless, 100 %]
    PosnBrief_3: value-spec=fields=[90 Deg, 180 Deg]
    ReqForPassAirbIndcnAckd_2: value-spec=0 Unitless
    RiFrntTireMsg_5: value-spec=fields=[0 Unitless, 0 Unitless, 0 Unitless, 0 Unitless, 0 Unitless, 0 Unitless, 0 Unitless, 205 degC, 350.115 KiloPa]
    RiReTireMsg_6: value-spec=fields=[0 Unitless, 0 Unitless, 0 Unitless, 0 Unitless, 0 Unitless, 0 Unitless, 0 Unitless, 205 degC, 350.115 KiloPa]
    RlyPwrDistbnCmd1WdIgnRlyCmd_6: value-spec=0 Unitless
    RlyPwrDistbnCmd1WdIgnRlyExtCmd_6: value-spec=0 Unitless
    TrsmActrPosnSafe_6: value-spec=fields=[7 Unitless, 0 Unitless, 0 Unitless]
    PinionSteerAgMax1_5: value-spec=0 rad
    DispOfPrpsnMod_7: value-spec=0 Unitless
    EmgyAsscTrigSts_2: value-spec=0 Unitless
    SwtLiHzrdWarn_2: value-spec=0 Unitless
    SwtIndcr_4: value-spec=fields=[0 Unitless, 1 Unitless, 0 Unitless, 0 Unitless]
    CllsnFwdWarn_2: value-spec=0 Unitless
    ActvnStsOfRtrctrRvsbLe_5: value-spec=0 Unitless
    PreCrashFrontData_5: value-spec=fields=[0 Unitless, 0 Unitless, 1 s, 0 Unitless, 0 m/s, 0 %]
    StsForRtrctrRvsbLe_5: value-spec=0 Unitless
    VehHomePrkgSysSts_4: value-spec=0 Unitless
    Overlap_1: value-spec=0 %
    VehSpdIndcd_3: value-spec=fields=[0 Unitless, 0 Unitless]
    SRSdevelpsignalgroupRX_3: value-spec=fields=[0 Unitless, 0 Unitless, 0 Unitless, 0 Unitless, 0 Unitless, 0 Unitless, 0 Unitless, 0 Unitless]
    PrkgStsToEDR_1: value-spec=fields=[0 Unitless, 0 Unitless, 0 Unitless, 0 Unitless, 0 Unitless, 0 Unitless, 0 Unitless]
    AsySftyFctStsToEDR_1: value-spec=fields=[0 Unitless, 0 Unitless, 0 Unitless, 0 Unitless, 0 Unitless, 0 Unitless, 0 Unitless, 0 Unitless, 0 Unitless, 0 Unitless]
    ZCUDMResdSig1ToSRSSafety_1: value-spec=fields=[0 Unitless, 0 Unitless, 0 Unitless]
    ActvnStsOfRtrctrRvsbRi_6: value-spec=0 Unitless
    StsForRtrctrRvsbRi_6: value-spec=1 Unitless
    SftyAirbRollovrSuppSwt_1: value-spec=0 Unitless
    SumActv_5: value-spec=0 Unitless
    EfuseKL15Req{1..5}_1: value-spec=0 Unitless
    CrsCtrlrMsg_2: value-spec=0 Unitless
    TurnIndcrAndHwlByDrvInt_1: value-spec=0 Unitless
    PassAirbNotiConfirm_1: value-spec=0 Unitless
    PassStuMonSts_1: value-spec=0 Unitless
    DrvrStuMonSts_1: value-spec=0 Unitless
    HoodSts_5: value-spec=0 Unitless
package /BaseTypes
  119 x base type, all with category=FIXED_LENGTH:
    GenQf1_2: base-type-size=2, base-type-encoding=NONE
    UInt8_2: base-type-size=8, base-type-encoding=NONE
    UInt4_2: base-type-size=4, base-type-encoding=NONE
    NoYes1_2: base-type-size=1, base-type-encoding=NONE
    VehMtnSt2_2: base-type-size=3, base-type-encoding=NONE
    Spd1_2: base-type-size=15, base-type-encoding=NONE
    WhlRotlDirStd1_2: base-type-size=2, base-type-encoding=NONE
    DevErrSts2_2: base-type-size=1, base-type-encoding=NONE
    Nr2_3: base-type-size=8, base-type-encoding=NONE
    OnOff1_2: base-type-size=1, base-type-encoding=NONE
    CtrlSts1_2: base-type-size=1, base-type-encoding=NONE
    OnOff2_2: base-type-size=1, base-type-encoding=NONE
    AbsWarnIndcnReq_2: base-type-size=2, base-type-encoding=NONE
    Tq10_2: base-type-size=15, base-type-encoding=NONE
    P33_2: base-type-size=10, base-type-encoding=NONE
    P35_2: base-type-size=10, base-type-encoding=NONE
    Tq32_2: base-type-size=12, base-type-encoding=NONE
    DevSts1_2: base-type-size=2, base-type-encoding=NONE
    EscSt1_2: base-type-size=3, base-type-encoding=NONE
    Tq1_2: base-type-size=14, base-type-encoding=2C
    PostImpctBrkgRdy_2: base-type-size=2, base-type-encoding=NONE
    EpbSts_2: base-type-size=4, base-type-encoding=NONE
    Qf1_2: base-type-size=2, base-type-encoding=NONE
    PsdNotPsd_2: base-type-size=1, base-type-encoding=NONE
    Perc1_2: base-type-size=15, base-type-encoding=NONE
    VFCOnOff_4: base-type-size=1, base-type-encoding=NONE
    BlockID_3: base-type-size=2, base-type-encoding=NONE
    WakeUpReasons_4: base-type-size=16, base-type-encoding=NONE
    Len31_2: base-type-size=21, base-type-encoding=NONE
    InvldVld1_2: base-type-size=1, base-type-encoding=NONE
    Ag4_2: base-type-size=15, base-type-encoding=2C
    Boolean_2: base-type-size=1, base-type-encoding=BOOLEAN
    A38_2: base-type-size=15, base-type-encoding=2C
    AgSpd34_2: base-type-size=16, base-type-encoding=2C
    GearLvrIndcn2_2: base-type-size=3, base-type-encoding=NONE
    AgSpd1_2: base-type-size=14, base-type-encoding=2C
    DoorSts2_2: base-type-size=2, base-type-encoding=NONE
    UsgModSts1_2: base-type-size=4, base-type-encoding=NONE
    CarModSts1_2: base-type-size=3, base-type-encoding=NONE
    Nr5_2: base-type-size=3, base-type-encoding=NONE
    FltEgyCns1_2: base-type-size=1, base-type-encoding=NONE
    MotSpd_1: base-type-size=16, base-type-encoding=NONE
    OkNotOk1_2: base-type-size=1, base-type-encoding=NONE
    PostImpctBrkgNoYes_2: base-type-size=2, base-type-encoding=NONE
    Decel_1: base-type-size=8, base-type-encoding=NONE
    BltLockSt1_2: base-type-size=1, base-type-encoding=NONE
    NoYesCrit1_2: base-type-size=2, base-type-encoding=NONE
    CrsCtrlrSts1_2: base-type-size=3, base-type-encoding=NONE
    CarTiGlb_2: base-type-size=32, base-type-encoding=NONE
    U1_2: base-type-size=8, base-type-encoding=NONE
    Yr1_2: base-type-size=7, base-type-encoding=NONE
    Mth1_2: base-type-size=4, base-type-encoding=NONE
    Day1_2: base-type-size=5, base-type-encoding=NONE
    Hr1_2: base-type-size=5, base-type-encoding=NONE
    Mins1_2: base-type-size=6, base-type-encoding=NONE
    Sec1_2: base-type-size=6, base-type-encoding=NONE
    Jerk1_2: base-type-size=14, base-type-encoding=2C
    N30_2: base-type-size=15, base-type-encoding=NONE
    NGrdt1_2: base-type-size=16, base-type-encoding=2C
    Perc2_2: base-type-size=8, base-type-encoding=NONE
    UInt32_2: base-type-size=32, base-type-encoding=NONE
    OnOffNoReq_2: base-type-size=2, base-type-encoding=NONE
    AsyALgtSts_4: base-type-size=4, base-type-encoding=NONE
    CrashFb_2: base-type-size=2, base-type-encoding=NONE
    UInt2_2: base-type-size=2, base-type-encoding=NONE
    CrashSts2_2: base-type-size=1, base-type-encoding=NONE
    Flt_3: base-type-size=1, base-type-encoding=NONE
    Perc9_2: base-type-size=10, base-type-encoding=NONE
    IndcrSts1_2: base-type-size=2, base-type-encoding=NONE
    CptEquid_2: base-type-size=1, base-type-encoding=NONE
    CrashSts4_1: base-type-size=2, base-type-encoding=NONE
    PassAirbLampReq_2: base-type-size=2, base-type-encoding=NONE
    ReqForDisp_2: base-type-size=1, base-type-encoding=NONE
    OnOffCrit1_2: base-type-size=2, base-type-encoding=NONE
    Orntn_2: base-type-size=3, base-type-encoding=NONE
    CrashSt_2: base-type-size=2, base-type-encoding=NONE
    U8Kmph_1: base-type-size=8, base-type-encoding=NONE
    U8WithRngDeg_1: base-type-size=7, base-type-encoding=NONE
    RestrntSysLampReq_2: base-type-size=2, base-type-encoding=NONE
    PassSeatSts1_2: base-type-size=2, base-type-encoding=NONE
    Spd51_1: base-type-size=9, base-type-encoding=NONE
    ReqForHzrdInt_1: base-type-size=1, base-type-encoding=NONE
    ActvnReqOfRtrctrRvsb1_2: base-type-size=3, base-type-encoding=NONE
    U55_1: base-type-size=8, base-type-encoding=NONE
    AmbTIndcd_2: base-type-size=12, base-type-encoding=NONE
    AmbTIndcdUnit_2: base-type-size=2, base-type-encoding=NONE
    AsyAutDrvCtrlTyp_4: base-type-size=3, base-type-encoding=NONE
    CllsnMtgtnFctSts_2: base-type-size=3, base-type-encoding=NONE
    DispOfPrpsnModForEv_2: base-type-size=4, base-type-encoding=NONE
    LockSts2_2: base-type-size=2, base-type-encoding=NONE
    DrvrCrsCtrlFctSeldTyp_5: base-type-size=3, base-type-encoding=NONE
    PWarnFlg_2: base-type-size=2, base-type-encoding=NONE
    Normalwarning_2: base-type-size=1, base-type-encoding=NONE
    T8_1: base-type-size=8, base-type-encoding=NONE
    Kpa8_1: base-type-size=8, base-type-encoding=NONE
    PassAirbLampSts1_2: base-type-size=2, base-type-encoding=NONE
    PosnLat_2: base-type-size=30, base-type-encoding=2C
    PosnLgt_2: base-type-size=31, base-type-encoding=2C
    ReqForPassAirbIndcnAckd_2: base-type-size=1, base-type-encoding=NONE
    TrsmActrPosn1_2: base-type-size=3, base-type-encoding=NONE
    DispOfPrpsnMod4_3: base-type-size=4, base-type-encoding=NONE
    AfsStsReq_7: base-type-size=2, base-type-encoding=NONE
    IndcrTypExt1_2: base-type-size=2, base-type-encoding=NONE
    CllsnFwdWarnReq_1: base-type-size=3, base-type-encoding=NONE
    Enumeration1_2: base-type-size=1, base-type-encoding=NONE
    TimeToImpact_1: base-type-size=8, base-type-encoding=NONE
    ObjectClass_2: base-type-size=3, base-type-encoding=NONE
    ClosingVelocity_1: base-type-size=8, base-type-encoding=NONE
    PercSign1_2: base-type-size=8, base-type-encoding=NONE
    NotOkOk_2: base-type-size=2, base-type-encoding=NONE
    HomePrkgSysSts1_2: base-type-size=5, base-type-encoding=NONE
    Nr32_2: base-type-size=9, base-type-encoding=NONE
    VehSpdIndcdUnit_2: base-type-size=2, base-type-encoding=NONE
    APATo_1: base-type-size=3, base-type-encoding=NONE
    AEBSFctSts_1: base-type-size=3, base-type-encoding=NONE
    FctSTs_1: base-type-size=3, base-type-encoding=NONE
    LDWSFctSts_1: base-type-size=3, base-type-encoding=NONE
    CrsCtrlrMsg1_2: base-type-size=3, base-type-encoding=NONE
    Onoff3_1: base-type-size=2, base-type-encoding=NONE
package /EndToEnds
  end to end protection set MainEndToEndSet
    16 x end to end protection:
      VehMtnSt_BCM_SRS3: end-to-end-profile={category=PROFILE_G, data-ids=54, data-id-mode=0, max-delta-counter-init=14, crc-offset=0, counter-offset=8}, end-to-end-protection-variable-prototype=receiver=SRS3.TopLevelComposition.VehMtnSt.VehMtnSt
      VehSpdLgt_BCM_SRS3: end-to-end-profile={category=PROFILE_G, data-ids=55, data-id-mode=0, max-delta-counter-init=14, crc-offset=0, counter-offset=8}, end-to-end-protection-variable-prototype=receiver=SRS3.TopLevelComposition.VehSpdLgt.VehSpdLgt
      AgDataRaw2Safe_SRS_XCU: end-to-end-profile={category=PROFILE_G, data-ids=1028, data-id-mode=0, max-delta-counter-init=13, crc-offset=0, counter-offset=8}, end-to-end-protection-variable-prototype=SRS3.TopLevelComposition.AgDataRaw2Safe.AgDataRaw2Safe
      AgDataRawSafe_SRS_BCM8: end-to-end-profile={category=PROFILE_G, data-ids=35, data-id-mode=0, max-delta-counter-init=3, crc-offset=0, counter-offset=8}, end-to-end-protection-variable-prototype=SRS3.TopLevelComposition.AgDataRawSafe.AgDataRawSafe
      AsyDataWithCmpSafe_SRS_SODL5: end-to-end-profile={category=PROFILE_G, data-ids=36, data-id-mode=0, max-delta-counter-init=14, crc-offset=0, counter-offset=8}, end-to-end-protection-variable-prototype=SRS3.TopLevelComposition.AsyDataWithCmpSafe.AsyDataWithCmpSafe
      BltLockStSafeAtDrvr_SRS_ASDM9: end-to-end-profile={category=PROFILE_G, data-ids=1036, data-id-mode=0, max-delta-counter-init=14, crc-offset=0, counter-offset=8}, end-to-end-protection-variable-prototype=SRS3.TopLevelComposition.BltLockStSafeAtDrvr.BltLockStSafeAtDrvr
      CrashStsSafe_SRS_XCU: end-to-end-profile={category=PROFILE_G, data-ids=1035, data-id-mode=0, max-delta-counter-init=14, crc-offset=0, counter-offset=8}, end-to-end-protection-variable-prototype=SRS3.TopLevelComposition.CrashStsSafe.CrashStsSafe
      PassAirbLampReq_SRS_OHC: end-to-end-profile={category=PROFILE_G, data-ids=1141, data-id-mode=0, max-delta-counter-init=14, crc-offset=0, counter-offset=8}, end-to-end-protection-variable-prototype=SRS3.TopLevelComposition.PassAirbLampReq.PassAirbLampReq
      RecOfPostImpctBrkgCfmd_SRS_BCM8: end-to-end-profile={category=PROFILE_G, data-ids=74, data-id-mode=0, max-delta-counter-init=3, crc-offset=0, counter-offset=8}, end-to-end-protection-variable-prototype=SRS3.TopLevelComposition.RecOfPostImpctBrkgCfmd.RecOfPostImpctBrkgCfmd
      RecOfPostImpctBrkgSuspc_SRS_BCM8: end-to-end-profile={category=PROFILE_G, data-ids=25, data-id-mode=0, max-delta-counter-init=3, crc-offset=0, counter-offset=8}, end-to-end-protection-variable-prototype=SRS3.TopLevelComposition.RecOfPostImpctBrkgSuspc.RecOfPostImpctBrkgSuspc
      ADataRawSafe_SRS_BCM8: end-to-end-profile={category=PROFILE_G, data-ids=34, data-id-mode=0, max-delta-counter-init=3, crc-offset=0, counter-offset=8}, end-to-end-protection-variable-prototype=SRS3.TopLevelComposition.ADataRawSafe.ADataRawSafe
      SRSResdSig1ToZCUDMSafety_SRS_ZCUD5: end-to-end-profile={category=PROFILE_G, data-ids=3806, data-id-mode=0, max-delta-counter-init=14, crc-offset=0, counter-offset=8}, end-to-end-protection-variable-prototype=SRS3.TopLevelComposition.SRSResdSig1ToZCUDMSafety.SRSResdSig1ToZCUDMSafety
      IntgtIMUDataRawSafe_SRS_ZCUD5: end-to-end-profile={category=PROFILE_G, data-ids=6915, data-id-mode=0, max-delta-counter-init=3, crc-offset=0, counter-offset=8}, end-to-end-protection-variable-prototype=SRS3.TopLevelComposition.IntgtIMUDataRawSafe.IntgtIMUDataRawSafe
      PreCrashFrontData_ASDM_SRS3: end-to-end-profile={category=PROFILE_G, data-ids=1041, data-id-mode=0, max-delta-counter-init=14, crc-offset=0, counter-offset=8}, end-to-end-protection-variable-prototype=receiver=SRS3.TopLevelComposition.PreCrashFrontData.PreCrashFrontData
      VehModMngtGlbSafe1_ZCUD_SRS3: end-to-end-profile={category=PROFILE_G, data-ids=116, data-id-mode=0, max-delta-counter-init=14, crc-offset=0, counter-offset=8}, end-to-end-protection-variable-prototype=receiver=SRS3.TopLevelComposition.VehModMngtGlbSafe1.VehModMngtGlbSafe1
      PassAirbLampStsRec_OHC_SRS3: end-to-end-profile={category=PROFILE_G, data-ids=1140, data-id-mode=0, max-delta-counter-init=14, crc-offset=0, counter-offset=8}, end-to-end-protection-variable-prototype=receiver=SRS3.TopLevelComposition.PassAirbLampStsRec.PassAirbLampStsRec
