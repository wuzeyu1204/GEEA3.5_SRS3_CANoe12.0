[part 3 of 3: packages /ECUExtractSRS3/VehicleProject to /Communication/TpConfig]
AUTOSAR XML (schema 4-2-2)
package /ECUExtractSRS3/VehicleProject
  system SDB325300: category=ECU_EXTRACT, container-i-pdu-header-byte-order=big-endian, ecu-extract-version=23.07.14;2025/12/15, ECU.Cfg.Ver: 0, pnc-vector-length=4, pnc-vector-offset=2, system-version=23.07.14;2025/12/15, System.Ver: 0
    system mapping System_MAPPING: pnc-mapping{pnc-group=[TxSPG_ZCUD_CANFD3_PNC29, RxSPG_ZCUD_CAN1_PNC29], pnc-identifier=29, short-label=PNC29, vfc=[TopLevelComposition.VehicleModeManagement, TopLevelComposition.Diagnostics, TopLevelComposition.VehicleDriving, TopLevelComposition.SettingsVehicle, TopLevelComposition.GlobalShortDuration, TopLevelComposition.SeatComfortFunctions, TopLevelComposition.Crash, TopLevelComposition.ParkingDrivingClimatization]}
      data-mappings:
        sender-receiver-to-signal-group-mapping={data-element=SRS3.TopLevelComposition.RecOfImpct.RecOfImpct, signal-group=RecOfImpct, type-mapping=sender-rec-record-type-mapping=record-element-mappings=[{application-record-element=VehOri, system-signal=RecOfImpctVehOri}, {application-record-element=CrashState, system-signal=RecOfImpctCrashState}, {application-record-element=CrashFrnt, system-signal=RecOfImpctCrashFrnt}, {application-record-element=CrashSideLe, system-signal=RecOfImpctCrashSideLe}, {application-record-element=CrashSideRi, system-signal=RecOfImpctCrashSideRi}, {application-record-element=CrashRe, system-signal=RecOfImpctCrashRe}, {application-record-element=CrashRollovr, system-signal=RecOfImpctCrashRollovr}, {application-record-element=CrashPed, system-signal=RecOfImpctCrashPed}, {application-record-element=CrashOffroadD, system-signal=RecOfImpctCrashOffroadD}, {application-record-element=CrashOffroadA, system-signal=RecOfImpctCrashOffroadA}, {application-record-element=CrashOffroadRT, system-signal=RecOfImpctCrashOffroadRT}, {application-record-element=CrashOffroadRTsevere, system-signal=RecOfImpctCrashOffroadRTsevere}, {application-record-element=ImpctDvy, system-signal=RecOfImpctImpctDvy}, {application-record-element=ImpctDvx, system-signal=RecOfImpctImpctDvx}, {application-record-element=ImpctRollAg, system-signal=RecOfImpctImpctRollAg}]}
        sender-receiver-to-signal-mapping={data-element=SRS3.TopLevelComposition.HVfault.HVfault, system-signal=HVfault}
        sender-receiver-to-signal-mapping={data-element=SRS3.TopLevelComposition.SRSIntVolt.SRSIntVolt, system-signal=SRSIntVolt}
        sender-receiver-to-signal-group-mapping={data-element=SRS3.TopLevelComposition.ADataRawSafe.ADataRawSafe, signal-group=ADataRawSafe, type-mapping=sender-rec-record-type-mapping=record-element-mappings=[{application-record-element=ALat, system-signal=ADataRawSafeALat}, {application-record-element=ALat1Qf, system-signal=ADataRawSafeALat1Qf}, {application-record-element=ALgt, system-signal=ADataRawSafeALgt}, {application-record-element=ALgt1Qf, system-signal=ADataRawSafeALgt1Qf}, {application-record-element=AVert, system-signal=ADataRawSafeAVert}, {application-record-element=AVertQf, system-signal=ADataRawSafeAVertQf}, {application-record-element=Chks, system-signal=ADataRawSafeChks}, {application-record-element=Cntr, system-signal=ADataRawSafeCntr}]}
        sender-receiver-to-signal-mapping={data-element=SRS3.TopLevelComposition.SftyAirbRollovrSuppSts.SftyAirbRollovrSuppSts, system-signal=SftyAirbRollovrSuppSts}
        sender-receiver-to-signal-group-mapping={data-element=SRS3.TopLevelComposition.BltLockStAtRowFrthMid.BltLockStAtRowFrthMid, signal-group=BltLockStAtRowFrthMid, type-mapping=sender-rec-record-type-mapping=record-element-mappings=[{application-record-element=BltLockSt1, system-signal=BltLockStAtRowFrthMidBltLockSt1}, {application-record-element=BltLockSts, system-signal=BltLockStAtRowFrthMidBltLockSts}, {application-record-element=BltLockEquid, system-signal=BltLockStAtRowFrthMidBltLockEquid}]}
        sender-receiver-to-signal-mapping={data-element=SRS3.TopLevelComposition.ReqForHzrdInt.ReqForHzrdInt, system-signal=ReqForHzrdInt}
        sender-receiver-to-signal-group-mapping={data-element=SRS3.TopLevelComposition.AgDataCmpQuality.AgDataCmpQuality, signal-group=AgDataCmpQuality, type-mapping=sender-rec-record-type-mapping=record-element-mappings=[{application-record-element=YawRateCmpQuality, system-signal=AgDataCmpQualityYawRateCmpQuality}, {application-record-element=RollRateCmpQuality, system-signal=AgDataCmpQualityRollRateCmpQuality}, {application-record-element=PitchRateCmpQuality, system-signal=AgDataCmpQualityPitchRateCmpQuality}]}
        sender-receiver-to-signal-group-mapping={data-element=SRS3.TopLevelComposition.BltLockStAtPass.BltLockStAtPass, signal-group=BltLockStAtPass, type-mapping=sender-rec-record-type-mapping=record-element-mappings=[{application-record-element=BltLockSt1, system-signal=BltLockStAtPassBltLockSt1}, {application-record-element=BltLockSts, system-signal=BltLockStAtPassBltLockSts}]}
        sender-receiver-to-signal-mapping={data-element=SRS3.TopLevelComposition.RestrntSysMsgReq.RestrntSysMsgReq, system-signal=RestrntSysMsgReq}
        sender-receiver-to-signal-group-mapping={data-element=SRS3.TopLevelComposition.BltLockStAtRowThrdMid.BltLockStAtRowThrdMid, signal-group=BltLockStAtRowThrdMid, type-mapping=sender-rec-record-type-mapping=record-element-mappings=[{application-record-element=BltLockSt1, system-signal=BltLockStAtRowThrdMidBltLockSt1}, {application-record-element=BltLockSts, system-signal=BltLockStAtRowThrdMidBltLockSts}, {application-record-element=BltLockEquid, system-signal=BltLockStAtRowThrdMidBltLockEquid}]}
        sender-receiver-to-signal-group-mapping={data-element=SRS3.TopLevelComposition.AgDataRawSafe.AgDataRawSafe, signal-group=AgDataRawSafe, type-mapping=sender-rec-record-type-mapping=record-element-mappings=[{application-record-element=RollRate, system-signal=AgDataRawSafeRollRate}, {application-record-element=RollRateQf, system-signal=AgDataRawSafeRollRateQf}, {application-record-element=YawRate, system-signal=AgDataRawSafeYawRate}, {application-record-element=YawRateQf, system-signal=AgDataRawSafeYawRateQf}, {application-record-element=Chks, system-signal=AgDataRawSafeChks}, {application-record-element=Cntr, system-signal=AgDataRawSafeCntr}]}
        sender-receiver-to-signal-group-mapping={data-element=SRS3.TopLevelComposition.BltLockStAtRowThrdRi.BltLockStAtRowThrdRi, signal-group=BltLockStAtRowThrdRi, type-mapping=sender-rec-record-type-mapping=record-element-mappings=[{application-record-element=BltLockSt1, system-signal=BltLockStAtRowThrdRiBltLockSt1}, {application-record-element=BltLockSts, system-signal=BltLockStAtRowThrdRiBltLockSts}, {application-record-element=BltLockEquid, system-signal=BltLockStAtRowThrdRiBltLockEquid}]}
        sender-receiver-to-signal-mapping={data-element=SRS3.TopLevelComposition.CrashSts2.CrashSts2, system-signal=CrashSts2}
        sender-receiver-to-signal-group-mapping={data-element=SRS3.TopLevelComposition.RecOfPostImpctBrkgSuspc.RecOfPostImpctBrkgSuspc, signal-group=RecOfPostImpctBrkgSuspc, type-mapping=sender-rec-record-type-mapping=record-element-mappings=[{application-record-element=SuspcPostImpctBrkg, system-signal=RecOfPostImpctBrkgSuspcSuspcPostImpctBrkg}, {application-record-element=Chks, system-signal=RecOfPostImpctBrkgSuspcChks}, {application-record-element=Cntr, system-signal=RecOfPostImpctBrkgSuspcCntr}]}
        sender-receiver-to-signal-group-mapping={data-element=SRS3.TopLevelComposition.BltLockStAtRowSecRi.BltLockStAtRowSecRi, signal-group=BltLockStAtRowSecRi, type-mapping=sender-rec-record-type-mapping=record-element-mappings=[{application-record-element=BltLockSt1, system-signal=BltLockStAtRowSecRiBltLockSt1}, {application-record-element=BltLockSts, system-signal=BltLockStAtRowSecRiBltLockSts}, {application-record-element=BltLockEquid, system-signal=BltLockStAtRowSecRiBltLockEquid}]}
        sender-receiver-to-signal-group-mapping={data-element=SRS3.TopLevelComposition.BltLockStAtRowSecMid.BltLockStAtRowSecMid, signal-group=BltLockStAtRowSecMid, type-mapping=sender-rec-record-type-mapping=record-element-mappings=[{application-record-element=BltLockSt1, system-signal=BltLockStAtRowSecMidBltLockSt1}, {application-record-element=BltLockSts, system-signal=BltLockStAtRowSecMidBltLockSts}, {application-record-element=BltLockEquid, system-signal=BltLockStAtRowSecMidBltLockEquid}]}
        sender-receiver-to-signal-group-mapping={data-element=SRS3.TopLevelComposition.SRSdevelpsignalgroupTX.SRSdevelpsignalgroupTX, signal-group=SRSdevelpsignalgroupTX, type-mapping=sender-rec-record-type-mapping=record-element-mappings=[{application-record-element=Functiondevpsignalgroup1, system-signal=SRSdevelpsignalgroupTXFunctiondevpsignalgroup1}, {application-record-element=Functiondevpsignalgroup2, system-signal=SRSdevelpsignalgroupTXFunctiondevpsignalgroup2}, {application-record-element=Functiondevpsignalgroup3, system-signal=SRSdevelpsignalgroupTXFunctiondevpsignalgroup3}, {application-record-element=Functiondevpsignalgroup4, system-signal=SRSdevelpsignalgroupTXFunctiondevpsignalgroup4}, {application-record-element=Functiondevpsignalgroup5, system-signal=SRSdevelpsignalgroupTXFunctiondevpsignalgroup5}, {application-record-element=Functiondevpsignalgroup6, system-signal=SRSdevelpsignalgroupTXFunctiondevpsignalgroup6}, {application-record-element=Functiondevpsignalgroup7, system-signal=SRSdevelpsignalgroupTXFunctiondevpsignalgroup7}, {application-record-element=Functiondevpsignalgroup8, system-signal=SRSdevelpsignalgroupTXFunctiondevpsignalgroup8}]}
        sender-receiver-to-signal-group-mapping={data-element=SRS3.TopLevelComposition.AgDataRaw2Safe.AgDataRaw2Safe, signal-group=AgDataRaw2Safe, type-mapping=sender-rec-record-type-mapping=record-element-mappings=[{application-record-element=Chks, system-signal=AgDataRaw2SafeChks}, {application-record-element=Cntr, system-signal=AgDataRaw2SafeCntr}, {application-record-element=PitchRateQf, system-signal=AgDataRaw2SafePitchRateQf}, {application-record-element=PitchRate, system-signal=AgDataRaw2SafePitchRate}]}
        sender-receiver-to-signal-mapping={data-element=SRS3.TopLevelComposition.PassMidSeatSts.PassMidSeatSts, system-signal=PassMidSeatSts}
        sender-receiver-to-signal-mapping={data-element=SRS3.TopLevelComposition.SeatOccptAtRowFrthLe.SeatOccptAtRowFrthLe, system-signal=SeatOccptAtRowFrthLe}
        sender-receiver-to-signal-group-mapping={data-element=SRS3.TopLevelComposition.BltCrashNotif.BltCrashNotif, signal-group=BltCrashNotif, type-mapping=sender-rec-record-type-mapping=record-element-mappings=[{application-record-element=BltCrashNotifDrvr, system-signal=BltCrashNotifDrvr}, {application-record-element=BltCrashNotifPass, system-signal=BltCrashNotifPass}]}
        sender-receiver-to-signal-group-mapping={data-element=SRS3.TopLevelComposition.VFCVectorSRS.VFCVectorSRS, signal-group=VFCVectorSRS, type-mapping=sender-rec-record-type-mapping=record-element-mappings=[{application-record-element=VFCid1, system-signal=VFCVectorSRSVFCid1}, {application-record-element=VFCid2, system-signal=VFCVectorSRSVFCid2}, {application-record-element=VFCid3, system-signal=VFCVectorSRSVFCid3}, {application-record-element=VFCid4, system-signal=VFCVectorSRSVFCid4}, {application-record-element=VFCid5, system-signal=VFCVectorSRSVFCid5}, {application-record-element=VFCid6, system-signal=VFCVectorSRSVFCid6}, {application-record-element=VFCid7, system-signal=VFCVectorSRSVFCid7}, {application-record-element=VFCid8, system-signal=VFCVectorSRSVFCid8}, {application-record-element=VFCid9, system-signal=VFCVectorSRSVFCid9}, {application-record-element=VFCid10, system-signal=VFCVectorSRSVFCid10}, {application-record-element=VFCid11, system-signal=VFCVectorSRSVFCid11}, {application-record-element=VFCid12, system-signal=VFCVectorSRSVFCid12}, {application-record-element=VFCid13, system-signal=VFCVectorSRSVFCid13}, {application-record-element=VFCid14, system-signal=VFCVectorSRSVFCid14}, {application-record-element=VFCid15, system-signal=VFCVectorSRSVFCid15}, {application-record-element=VFCid16, system-signal=VFCVectorSRSVFCid16}, {application-record-element=VFCid17, system-signal=VFCVectorSRSVFCid17}, {application-record-element=VFCid18, system-signal=VFCVectorSRSVFCid18}, {application-record-element=VFCid19, system-signal=VFCVectorSRSVFCid19}, {application-record-element=VFCid20, system-signal=VFCVectorSRSVFCid20}, {application-record-element=VFCid21, system-signal=VFCVectorSRSVFCid21}, {application-record-element=VFCid22, system-signal=VFCVectorSRSVFCid22}, {application-record-element=VFCid23, system-signal=VFCVectorSRSVFCid23}, {application-record-element=VFCid24, system-signal=VFCVectorSRSVFCid24}, {application-record-element=VFCid25, system-signal=VFCVectorSRSVFCid25}, {application-record-element=VFCid26, system-signal=VFCVectorSRSVFCid26}, {application-record-element=VFCid27, system-signal=VFCVectorSRSVFCid27}, {application-record-element=VFCid28, system-signal=VFCVectorSRSVFCid28}, {application-record-element=VFCid29, system-signal=VFCVectorSRSVFCid29}, {application-record-element=VFCid30, system-signal=VFCVectorSRSVFCid30}, {application-record-element=VFCid31, system-signal=VFCVectorSRSVFCid31}, {application-record-element=VFCid32, system-signal=VFCVectorSRSVFCid32}, {application-record-element=VFCid33, system-signal=VFCVectorSRSVFCid33}, {application-record-element=VFCid34, system-signal=VFCVectorSRSVFCid34}, {application-record-element=VFCid35, system-signal=VFCVectorSRSVFCid35}, {application-record-element=VFCid36, system-signal=VFCVectorSRSVFCid36}, {application-record-element=VFCid37, system-signal=VFCVectorSRSVFCid37}, {application-record-element=VFCid38, system-signal=VFCVectorSRSVFCid38}, {application-record-element=VFCid39, system-signal=VFCVectorSRSVFCid39}, {application-record-element=VFCid40, system-signal=VFCVectorSRSVFCid40}, {application-record-element=VFCid41, system-signal=VFCVectorSRSVFCid41}, {application-record-element=VFCid42, system-signal=VFCVectorSRSVFCid42}, {application-record-element=VFCid43, system-signal=VFCVectorSRSVFCid43}, {application-record-element=VFCid44, system-signal=VFCVectorSRSVFCid44}, {application-record-element=VFCid45, system-signal=VFCVectorSRSVFCid45}, {application-record-element=VFCid46, system-signal=VFCVectorSRSVFCid46}, {application-record-element=VFCid47, system-signal=VFCVectorSRSVFCid47}, {application-record-element=VFCid48, system-signal=VFCVectorSRSVFCid48}, {application-record-element=VFCid49, system-signal=VFCVectorSRSVFCid49}, {application-record-element=VFCid50, system-signal=VFCVectorSRSVFCid50}, {application-record-element=VFCid51, system-signal=VFCVectorSRSVFCid51}, {application-record-element=VFCid52, system-signal=VFCVectorSRSVFCid52}, {application-record-element=VFCid53, system-signal=VFCVectorSRSVFCid53}, {application-record-element=VFCid54, system-signal=VFCVectorSRSVFCid54}, {application-record-element=VFCid55, system-signal=VFCVectorSRSVFCid55}, {application-record-element=VFCid56, system-signal=VFCVectorSRSVFCid56}, {application-record-element=VFCid57, system-signal=VFCVectorSRSVFCid57}, {application-record-element=VFCid58, system-signal=VFCVectorSRSVFCid58}, {application-record-element=VFCid59, system-signal=VFCVectorSRSVFCid59}, {application-record-element=VFCid60, system-signal=VFCVectorSRSVFCid60}, {application-record-element=VFCid61, system-signal=VFCVectorSRSVFCid61}, {application-record-element=VFCid0, system-signal=VFCVectorSRSVFCid0}, {application-record-element=BlockID, system-signal=VFCVectorSRSBlockID}]}
        sender-receiver-to-signal-group-mapping={data-element=SRS3.TopLevelComposition.AsyDataWithCmpSafe.AsyDataWithCmpSafe, signal-group=AsyDataWithCmpSafe, type-mapping=sender-rec-record-type-mapping=record-element-mappings=[{application-record-element=YawRateWithCmp, system-signal=AsyDataWithCmpSafeYawRateWithCmp}, {application-record-element=YawRateQf, system-signal=AsyDataWithCmpSafeYawRateQf}, {application-record-element=ALatWithCmp, system-signal=AsyDataWithCmpSafeALatWithCmp}, {application-record-element=ALat1Qf, system-signal=AsyDataWithCmpSafeALat1Qf}, {application-record-element=GrdtOfALgt, system-signal=AsyDataWithCmpSafeGrdtOfALgt}, {application-record-element=ALgt1Qf, system-signal=AsyDataWithCmpSafeALgt1Qf}, {application-record-element=Chks, system-signal=AsyDataWithCmpSafeChks}, {application-record-element=Cntr, system-signal=AsyDataWithCmpSafeCntr}]}
        sender-receiver-to-signal-mapping={data-element=SRS3.TopLevelComposition.SeatOccptAtRowThrdMid.SeatOccptAtRowThrdMid, system-signal=SeatOccptAtRowThrdMid}
        sender-receiver-to-signal-group-mapping={data-element=SRS3.TopLevelComposition.BltLockStAtDrvr.BltLockStAtDrvr, signal-group=BltLockStAtDrvr, type-mapping=sender-rec-record-type-mapping=record-element-mappings=[{application-record-element=BltLockSt1, system-signal=BltLockStAtDrvrBltLockSt1}, {application-record-element=BltLockSts, system-signal=BltLockStAtDrvrBltLockSts}]}
        sender-receiver-to-signal-mapping={data-element=SRS3.TopLevelComposition.SeatOccptAtRowFrthRi.SeatOccptAtRowFrthRi, system-signal=SeatOccptAtRowFrthRi}
        sender-receiver-to-signal-group-mapping={data-element=SRS3.TopLevelComposition.BltLockStAtRowThrdLe.BltLockStAtRowThrdLe, signal-group=BltLockStAtRowThrdLe, type-mapping=sender-rec-record-type-mapping=record-element-mappings=[{application-record-element=BltLockSt1, system-signal=BltLockStAtRowThrdLeBltLockSt1}, {application-record-element=BltLockSts, system-signal=BltLockStAtRowThrdLeBltLockSts}, {application-record-element=BltLockEquid, system-signal=BltLockStAtRowThrdLeBltLockEquid}]}
        sender-receiver-to-signal-group-mapping={data-element=SRS3.TopLevelComposition.BltLockStAtRowFrthLe.BltLockStAtRowFrthLe, signal-group=BltLockStAtRowFrthLe, type-mapping=sender-rec-record-type-mapping=record-element-mappings=[{application-record-element=BltLockSt1, system-signal=BltLockStAtRowFrthLeBltLockSt1}, {application-record-element=BltLockSts, system-signal=BltLockStAtRowFrthLeBltLockSts}, {application-record-element=BltLockEquid, system-signal=BltLockStAtRowFrthLeBltLockEquid}]}
        sender-receiver-to-signal-mapping={data-element=SRS3.TopLevelComposition.SeatOccptAtRowFrthMid.SeatOccptAtRowFrthMid, system-signal=SeatOccptAtRowFrthMid}
        sender-receiver-to-signal-group-mapping={data-element=SRS3.TopLevelComposition.CrashStsSafe.CrashStsSafe, signal-group=CrashStsSafe, type-mapping=sender-rec-record-type-mapping=record-element-mappings=[{application-record-element=Sts, system-signal=CrashStsSafeSts}, {application-record-element=Chks, system-signal=CrashStsSafeChks}, {application-record-element=Cntr, system-signal=CrashStsSafeCntr}]}
        sender-receiver-to-signal-group-mapping={data-element=SRS3.TopLevelComposition.RecOfPostImpctBrkgCfmd.RecOfPostImpctBrkgCfmd, signal-group=RecOfPostImpctBrkgCfmd, type-mapping=sender-rec-record-type-mapping=record-element-mappings=[{application-record-element=PostImpctBrkgCfmd, system-signal=RecOfPostImpctBrkgCfmdPostImpctBrkgCfmd}, {application-record-element=CrashFrnt, system-signal=RecOfPostImpctBrkgCfmdCrashFrnt}, {application-record-element=CrashSideLe, system-signal=RecOfPostImpctBrkgCfmdCrashSideLe}, {application-record-element=CrashSideRi, system-signal=RecOfPostImpctBrkgCfmdCrashSideRi}, {application-record-element=CrashRe, system-signal=RecOfPostImpctBrkgCfmdCrashRe}, {application-record-element=CrashRollovr, system-signal=RecOfPostImpctBrkgCfmdCrashRollovr}, {application-record-element=CrashPed, system-signal=RecOfPostImpctBrkgCfmdCrashPed}, {application-record-element=CrashOz, system-signal=RecOfPostImpctBrkgCfmdCrashOz}, {application-record-element=CrashOffroadD, system-signal=RecOfPostImpctBrkgCfmdCrashOffroadD}, {application-record-element=CrashOffroadA, system-signal=RecOfPostImpctBrkgCfmdCrashOffroadA}, {application-record-element=CrashOffroadRT, system-signal=RecOfPostImpctBrkgCfmdCrashOffroadRT}, {application-record-element=CrashOffroadRTsevere, system-signal=RecOfPostImpctBrkgCfmdCrashOffroadRTsevere}, {application-record-element=CrashLargeAnimal, system-signal=RecOfPostImpctBrkgCfmdCrashLargeAnimal}, {application-record-element=Chks, system-signal=RecOfPostImpctBrkgCfmdChks}, {application-record-element=Cntr, system-signal=RecOfPostImpctBrkgCfmdCntr}]}
        sender-receiver-to-signal-mapping={data-element=SRS3.TopLevelComposition.DstTrvldVldFromSftyBkp.DstTrvldVldFromSftyBkp, system-signal=DstTrvldVldFromSftyBkp}
        sender-receiver-to-signal-group-mapping={data-element=SRS3.TopLevelComposition.IntgtIMUDataRawSafe.IntgtIMUDataRawSafe, signal-group=IntgtIMUDataRawSafe, type-mapping=sender-rec-record-type-mapping=record-element-mappings=[{application-record-element=ALat, system-signal=IntgtIMUDataRawSafeALat}, {application-record-element=ALat1Qf, system-signal=IntgtIMUDataRawSafeALat1Qf}, {application-record-element=ALgt, system-signal=IntgtIMUDataRawSafeALgt}, {application-record-element=ALgt1Qf, system-signal=IntgtIMUDataRawSafeALgt1Qf}, {application-record-element=Avert, system-signal=IntgtIMUDataRawSafeAvert}, {application-record-element=AVertQf, system-signal=IntgtIMUDataRawSafeAVertQf}, {application-record-element=YawRate, system-signal=IntgtIMUDataRawSafeYawRate}, {application-record-element=YawRateQf, system-signal=IntgtIMUDataRawSafeYawRateQf}, {application-record-element=RollRate, system-signal=IntgtIMUDataRawSafeRollRate}, {application-record-element=RollRateQf, system-signal=IntgtIMUDataRawSafeRollRateQf}, {application-record-element=PitchRate, system-signal=IntgtIMUDataRawSafePitchRate}, {application-record-element=PitchRateQf, system-signal=IntgtIMUDataRawSafePitchRateQf}, {application-record-element=Chks, system-signal=IntgtIMUDataRawSafeChks}, {application-record-element=Cntr, system-signal=IntgtIMUDataRawSafeCntr}]}
        sender-receiver-to-signal-group-mapping={data-element=SRS3.TopLevelComposition.BltLockStAtPassMid.BltLockStAtPassMid, signal-group=BltLockStAtPassMid, type-mapping=sender-rec-record-type-mapping=record-element-mappings=[{application-record-element=BltLockSt1, system-signal=BltLockStAtPassMidBltLockSt1}, {application-record-element=BltLockSts, system-signal=BltLockStAtPassMidBltLockSts}, {application-record-element=BltLockEquid, system-signal=BltLockStAtPassMidBltLockEquid}]}
        sender-receiver-to-signal-mapping={data-element=SRS3.TopLevelComposition.PassAirbStsChgNotifReq.PassAirbStsChgNotifReq, system-signal=PassAirbStsChgNotifReq}
        sender-receiver-to-signal-mapping={data-element=SRS3.TopLevelComposition.RestrntSysLampReq.RestrntSysLampReq, system-signal=RestrntSysLampReq}
        sender-receiver-to-signal-mapping={data-element=SRS3.TopLevelComposition.PassAirbSts.PassAirbSts, system-signal=PassAirbSts}
        sender-receiver-to-signal-mapping={data-element=SRS3.TopLevelComposition.NotifForEmgyCall.NotifForEmgyCall, system-signal=NotifForEmgyCall}
        sender-receiver-to-signal-group-mapping={data-element=SRS3.TopLevelComposition.BltLockStAtRowFrthRi.BltLockStAtRowFrthRi, signal-group=BltLockStAtRowFrthRi, type-mapping=sender-rec-record-type-mapping=record-element-mappings=[{application-record-element=BltLockSt1, system-signal=BltLockStAtRowFrthRiBltLockSt1}, {application-record-element=BltLockSts, system-signal=BltLockStAtRowFrthRiBltLockSts}, {application-record-element=BltLockEquid, system-signal=BltLockStAtRowFrthRiBltLockEquid}]}
        sender-receiver-to-signal-mapping={data-element=SRS3.TopLevelComposition.ActvnReqOfRtrctrRvsbRi.ActvnReqOfRtrctrRvsbRi, system-signal=ActvnReqOfRtrctrRvsbRi}
        sender-receiver-to-signal-group-mapping={data-element=SRS3.TopLevelComposition.BltLockStAtRowSecLe.BltLockStAtRowSecLe, signal-group=BltLockStAtRowSecLe, type-mapping=sender-rec-record-type-mapping=record-element-mappings=[{application-record-element=BltLockSt1, system-signal=BltLockStAtRowSecLeBltLockSt1}, {application-record-element=BltLockSts, system-signal=BltLockStAtRowSecLeBltLockSts}, {application-record-element=BltLockEquid, system-signal=BltLockStAtRowSecLeBltLockEquid}]}
        sender-receiver-to-signal-group-mapping={data-element=SRS3.TopLevelComposition.RecOfImpct2.RecOfImpct2, signal-group=RecOfImpct2, type-mapping=sender-rec-record-type-mapping=record-element-mappings=[{application-record-element=ImpctDvxSigned, system-signal=RecOfImpct2ImpctDvxSigned}, {application-record-element=ImpctDvySigned, system-signal=RecOfImpct2ImpctDvySigned}]}
        sender-receiver-to-signal-mapping={data-element=SRS3.TopLevelComposition.WakeUpReasonsforSRS.WakeUpReasonsforSRS, system-signal=WakeUpReasonsforSRS}
        sender-receiver-to-signal-mapping={data-element=SRS3.TopLevelComposition.ActvnReqOfRtrctrRvsbLe.ActvnReqOfRtrctrRvsbLe, system-signal=ActvnReqOfRtrctrRvsbLe}
        sender-receiver-to-signal-group-mapping={data-element=SRS3.TopLevelComposition.JID.JID, signal-group=JID, type-mapping=sender-rec-record-type-mapping=record-element-mappings=[{application-record-element=Byte0, system-signal=JIDByte0}, {application-record-element=Byte1, system-signal=JIDByte1}, {application-record-element=Byte2, system-signal=JIDByte2}, {application-record-element=Byte3, system-signal=JIDByte3}, {application-record-element=Byte4, system-signal=JIDByte4}, {application-record-element=Byte5, system-signal=JIDByte5}, {application-record-element=Byte6, system-signal=JIDByte6}, {application-record-element=Byte7, system-signal=JIDByte7}]}
        sender-receiver-to-signal-group-mapping={data-element=SRS3.TopLevelComposition.BltLockStSafeAtDrvr.BltLockStSafeAtDrvr, signal-group=BltLockStSafeAtDrvr, type-mapping=sender-rec-record-type-mapping=record-element-mappings=[{application-record-element=BltLockSt1, system-signal=BltLockStSafeAtDrvrBltLockSt1}, {application-record-element=BltLockStErrSts, system-signal=BltLockStSafeAtDrvrBltLockStErrSts}, {application-record-element=Chks, system-signal=BltLockStSafeAtDrvrChks}, {application-record-element=Cntr, system-signal=BltLockStSafeAtDrvrCntr}]}
        sender-receiver-to-signal-mapping={data-element=SRS3.TopLevelComposition.PedProtnMsgReqForImpct.PedProtnMsgReqForImpct, system-signal=PedProtnMsgReqForImpct}
        sender-receiver-to-signal-mapping={data-element=SRS3.TopLevelComposition.BrkPedlSts.BrkPedlSts, system-signal=BrkPedlSts}
        sender-receiver-to-signal-mapping={data-element=SRS3.TopLevelComposition.ReqForAsyDataStorgFromRestrntSys.ReqForAsyDataStorgFromRestrntSys, system-signal=ReqForAsyDataStorgFromRestrntSys}
        sender-receiver-to-signal-mapping={data-element=SRS3.TopLevelComposition.PedProtnMsgReqForFlt.PedProtnMsgReqForFlt, system-signal=PedProtnMsgReqForFlt}
        sender-receiver-to-signal-mapping={data-element=SRS3.TopLevelComposition.SafetyCrashFb.SafetyCrashFb, system-signal=SafetyCrashFb}
        sender-receiver-to-signal-group-mapping={data-element=SRS3.TopLevelComposition.PassAirbLampReq.PassAirbLampReq, signal-group=PassAirbLampReq, type-mapping=sender-rec-record-type-mapping=record-element-mappings=[{application-record-element=PassAirbLampDiReq, system-signal=PassAirbLampReqPassAirbLampDiReq}, {application-record-element=PassAirbLampEnaReq, system-signal=PassAirbLampReqPassAirbLampEnaReq}, {application-record-element=PassAirbLampReqChks, system-signal=PassAirbLampReqChks}, {application-record-element=PassAirbLampReqCntr, system-signal=PassAirbLampReqCntr}, {application-record-element=ChgOfPassAirbSts, system-signal=PassAirbLampReqChgOfPassAirbSts}]}
        sender-receiver-to-signal-mapping={data-element=SRS3.TopLevelComposition.DstTrvldFromSftyBkp.DstTrvldFromSftyBkp, system-signal=DstTrvldFromSftyBkp}
        sender-receiver-to-signal-group-mapping={data-element=SRS3.TopLevelComposition.SRSResdSig1ToZCUDMSafety.SRSResdSig1ToZCUDMSafety, signal-group=SRSResdSig1ToZCUDMSafety, type-mapping=sender-rec-record-type-mapping=record-element-mappings=[{application-record-element=Chks, system-signal=SRSResdSig1ToZCUDMSafetyChks}, {application-record-element=Cntr, system-signal=SRSResdSig1ToZCUDMSafetyCntr}, {application-record-element=UInt32, system-signal=SRSResdSig1ToZCUDMSafetyUInt32}]}
        sender-receiver-to-signal-mapping={data-element=SRS3.TopLevelComposition.HoodSts.HoodSts, system-signal=HoodSts}
        sender-receiver-to-signal-group-mapping={data-element=SRS3.TopLevelComposition.VehSpdIndcd.VehSpdIndcd, signal-group=VehSpdIndcd, type-mapping=sender-rec-record-type-mapping=record-element-mappings=[{application-record-element=VehSpdIndcd, system-signal=VehSpdIndcdVehSpdIndcd}, {application-record-element=VeSpdIndcdUnit, system-signal=VehSpdIndcdVeSpdIndcdUnit}]}
        sender-receiver-to-signal-group-mapping={data-element=SRS3.TopLevelComposition.VehBattU.VehBattU, signal-group=VehBattU, type-mapping=sender-rec-record-type-mapping=record-element-mappings=[{application-record-element=SysU, system-signal=VehBattUSysU}, {application-record-element=SysUQf, system-signal=VehBattUSysUQf}]}
        sender-receiver-to-signal-group-mapping={data-element=SRS3.TopLevelComposition.PreCrashFrontData.PreCrashFrontData, signal-group=PreCrashFrontData, type-mapping=sender-rec-record-type-mapping=record-element-mappings=[{application-record-element=Chks, system-signal=PreCrashFrontDataChks}, {application-record-element=Cntr, system-signal=PreCrashFrontDataCntr}, {application-record-element=TimeToImpact, system-signal=PreCrashFrontDataTimeToImpact}, {application-record-element=ObjectClass, system-signal=PreCrashFrontDataObjectClass}, {application-record-element=ClosingVelocity, system-signal=PreCrashFrontDataClosingVelocity}, {application-record-element=OverLap, system-signal=PreCrashFrontDataOverLap}]}
        sender-receiver-to-signal-mapping={data-element=SRS3.TopLevelComposition.EfuseKL15Req3.EfuseKL15Req3, system-signal=EfuseKL15Req3}
        sender-receiver-to-signal-mapping={data-element=SRS3.TopLevelComposition.PassStuMonSts.PassStuMonSts, system-signal=PassStuMonSts}
        sender-receiver-to-signal-group-mapping={data-element=SRS3.TopLevelComposition.VehCfgPrm.VehCfgPrm, signal-group=VehCfgPrm, type-mapping=sender-rec-record-type-mapping=record-element-mappings=[{application-record-element=BlkIDBytePosn1, system-signal=VehCfgPrmBlkIDBytePosn1}, {application-record-element=CCPBytePosn2, system-signal=VehCfgPrmCCPBytePosn2}, {application-record-element=CCPBytePosn3, system-signal=VehCfgPrmCCPBytePosn3}, {application-record-element=CCPBytePosn4, system-signal=VehCfgPrmCCPBytePosn4}, {application-record-element=CCPBytePosn5, system-signal=VehCfgPrmCCPBytePosn5}, {application-record-element=CCPBytePosn6, system-signal=VehCfgPrmCCPBytePosn6}, {application-record-element=CCPBytePosn7, system-signal=VehCfgPrmCCPBytePosn7}, {application-record-element=CCPBytePosn8, system-signal=VehCfgPrmCCPBytePosn8}]}
        sender-receiver-to-signal-mapping={data-element=SRS3.TopLevelComposition.PinionSteerAgMax1.PinionSteerAgMax1, system-signal=PinionSteerAgMax1}
        sender-receiver-to-signal-mapping={data-element=SRS3.TopLevelComposition.EfuseKL15Req5.EfuseKL15Req5, system-signal=EfuseKL15Req5}
        sender-receiver-to-signal-mapping={data-element=SRS3.TopLevelComposition.CarModCrashSaved.CarModCrashSaved, system-signal=CarModCrashSaved}
        sender-receiver-to-signal-group-mapping={data-element=SRS3.TopLevelComposition.AsyALgtSts.AsyALgtSts, signal-group=AsyALgtSts, type-mapping=sender-rec-record-type-mapping=record-element-mappings=[{application-record-element=AsyALgtSts, system-signal=AsyALgtStsAsyALgtSts}, {application-record-element=Cntr, system-signal=AsyALgtStsCntr}, {application-record-element=Chks, system-signal=AsyALgtStsChks}]}
        sender-receiver-to-signal-group-mapping={data-element=SRS3.TopLevelComposition.AsySftyFctStsToEDR.AsySftyFctStsToEDR, signal-group=AsySftyFctStsToEDR, type-mapping=sender-rec-record-type-mapping=record-element-mappings=[{application-record-element=AEBSFctSts, system-signal=AsySftyFctStsToEDRAEBSFctSts}, {application-record-element=ACCFctSTs, system-signal=AsySftyFctStsToEDRACCFctSTs}, {application-record-element=LDWSFctSts, system-signal=AsySftyFctStsToEDRLDWSFctSts}, {application-record-element=CSFFctSts, system-signal=AsySftyFctStsToEDRCSFFctSts}, {application-record-element=ESFFctSts, system-signal=AsySftyFctStsToEDRESFFctSts}, {application-record-element=ACSFB1FctSts, system-signal=AsySftyFctStsToEDRACSFB1FctSts}, {application-record-element=ACSFB2FctSts, system-signal=AsySftyFctStsToEDRACSFB2FctSts}, {application-record-element=ACSFCFctSts, system-signal=AsySftyFctStsToEDRACSFCFctSts}, {application-record-element=ACSFDFctSts, system-signal=AsySftyFctStsToEDRACSFDFctSts}, {application-record-element=ACSFEFctSts, system-signal=AsySftyFctStsToEDRACSFEFctSts}]}
        sender-receiver-to-signal-mapping={data-element=SRS3.TopLevelComposition.AsyAutDrvCtrlTyp.AsyAutDrvCtrlTyp, system-signal=AsyAutDrvCtrlTyp}
        sender-receiver-to-signal-group-mapping={data-element=SRS3.TopLevelComposition.SwtIndcr.SwtIndcr, signal-group=SwtIndcr, type-mapping=sender-rec-record-type-mapping=record-element-mappings=[{application-record-element=IndcrTypExtReq, system-signal=SwtIndcrIndcrTypExtReq}, {application-record-element=IndcrTypExtReqToUpdQf, system-signal=SwtIndcrIndcrTypExtReqToUpdQf}, {application-record-element=IndcrTypExtReqCntr, system-signal=SwtIndcrIndcrTypExtReqCntr}, {application-record-element=IndcrTypExtReqChks, system-signal=SwtIndcrIndcrTypExtReqChks}]}
        sender-receiver-to-signal-group-mapping={data-element=SRS3.TopLevelComposition.SRSdevelpsignalgroupRX.SRSdevelpsignalgroupRX, signal-group=SRSdevelpsignalgroupRX, type-mapping=sender-rec-record-type-mapping=record-element-mappings=[{application-record-element=Functiondevpsignalgroup1, system-signal=SRSdevelpsignalgroupRXFunctiondevpsignalgroup1}, {application-record-element=Functiondevpsignalgroup2, system-signal=SRSdevelpsignalgroupRXFunctiondevpsignalgroup2}, {application-record-element=Functiondevpsignalgroup3, system-signal=SRSdevelpsignalgroupRXFunctiondevpsignalgroup3}, {application-record-element=Functiondevpsignalgroup4, system-signal=SRSdevelpsignalgroupRXFunctiondevpsignalgroup4}, {application-record-element=Functiondevpsignalgroup5, system-signal=SRSdevelpsignalgroupRXFunctiondevpsignalgroup5}, {application-record-element=Functiondevpsignalgroup6, system-signal=SRSdevelpsignalgroupRXFunctiondevpsignalgroup6}, {application-record-element=Functiondevpsignalgroup7, system-signal=SRSdevelpsignalgroupRXFunctiondevpsignalgroup7}, {application-record-element=Functiondevpsignalgroup8, system-signal=SRSdevelpsignalgroupRXFunctiondevpsignalgroup8}]}
        sender-receiver-to-signal-mapping={data-element=SRS3.TopLevelComposition.DrvrCrsCtrlFctSeld.DrvrCrsCtrlFctSeld, system-signal=DrvrCrsCtrlFctSeld}
        sender-receiver-to-signal-mapping={data-element=SRS3.TopLevelComposition.PostImpctBrkgRdy.PostImpctBrkgRdy, system-signal=PostImpctBrkgRdy}
        sender-receiver-to-signal-mapping={data-element=SRS3.TopLevelComposition.GearLvrIndcn.GearLvrIndcn, system-signal=GearLvrIndcn}
        sender-receiver-to-signal-mapping={data-element=SRS3.TopLevelComposition.BrkTracCtrlActv.BrkTracCtrlActv, system-signal=BrkTracCtrlActv}
        sender-receiver-to-signal-group-mapping={data-element=SRS3.TopLevelComposition.EscSt.EscSt, signal-group=EscSt, type-mapping=sender-rec-record-type-mapping=record-element-mappings=[{application-record-element=EscSt, system-signal=EscStEscSt}, {application-record-element=EscStChks, system-signal=EscStChks}, {application-record-element=EscStCntr, system-signal=EscStCntr}]}
        sender-receiver-to-signal-mapping={data-element=SRS3.TopLevelComposition.DoorPassLockSts.DoorPassLockSts, system-signal=DoorPassLockSts}
        sender-receiver-to-signal-mapping={data-element=SRS3.TopLevelComposition.BrkTqAtWhlsReq.BrkTqAtWhlsReq, system-signal=BrkTqAtWhlsReq}
        sender-receiver-to-signal-mapping={data-element=SRS3.TopLevelComposition.ReqForPassAirbIndcnAckd.ReqForPassAirbIndcnAckd, system-signal=ReqForPassAirbIndcnAckd}
        sender-receiver-to-signal-mapping={data-element=SRS3.TopLevelComposition.CllsnFwdWarn.CllsnFwdWarn, system-signal=CllsnFwdWarn}
        sender-receiver-to-signal-group-mapping={data-element=SRS3.TopLevelComposition.SftyDecelGroupSafe.SftyDecelGroupSafe, signal-group=SftyDecelGroupSafe, type-mapping=sender-rec-record-type-mapping=record-element-mappings=[{application-record-element=AsySftyEnaDecel, system-signal=SftyDecelGroupSafeAsySftyEnaDecel}, {application-record-element=SftyDecelGroupSafeChks, system-signal=SftyDecelGroupSafeChks}, {application-record-element=SftyDecelGroupSafeCntr, system-signal=SftyDecelGroupSafeCntr}, {application-record-element=AsySftyDecelReq, system-signal=SftyDecelGroupSafeAsySftyDecelReq}]}
        sender-receiver-to-signal-group-mapping={data-element=SRS3.TopLevelComposition.WhlSpdCircumlRe.WhlSpdCircumlRe, signal-group=WhlSpdCircumlRe, type-mapping=sender-rec-record-type-mapping=record-element-mappings=[{application-record-element=WhlSpdCircumlReLe, system-signal=WhlSpdCircumlReLe}, {application-record-element=WhlSpdCircumlReLeQf, system-signal=WhlSpdCircumlReLeQf}, {application-record-element=WhlSpdCircumlReRi, system-signal=WhlSpdCircumlReRi}, {application-record-element=WhlSpdCircumlReRiQf, system-signal=WhlSpdCircumlReRiQf}, {application-record-element=WhlSpdCircumlReChks, system-signal=WhlSpdCircumlReChks}, {application-record-element=WhlSpdCircumlReCntr, system-signal=WhlSpdCircumlReCntr}]}
        sender-receiver-to-signal-mapping={data-element=SRS3.TopLevelComposition.CrsCtrlrSts.CrsCtrlrSts, system-signal=CrsCtrlrSts}
        sender-receiver-to-signal-group-mapping={data-element=SRS3.TopLevelComposition.VehMtnSt.VehMtnSt, signal-group=VehMtnSt, type-mapping=sender-rec-record-type-mapping=record-element-mappings=[{application-record-element=VehMtnSt, system-signal=VehMtnStVehMtnSt}, {application-record-element=VehMtnStChks, system-signal=VehMtnStChks}, {application-record-element=VehMtnStCntr, system-signal=VehMtnStCntr}]}
        sender-receiver-to-signal-mapping={data-element=SRS3.TopLevelComposition.DoorLeReSts.DoorLeReSts, system-signal=DoorLeReSts}
        sender-receiver-to-signal-group-mapping={data-element=SRS3.TopLevelComposition.EngNSafe.EngNSafe, signal-group=EngNSafe, type-mapping=sender-rec-record-type-mapping=record-element-mappings=[{application-record-element=EngN, system-signal=EngNSafeEngN}, {application-record-element=EngNGrdt, system-signal=EngNSafeEngNGrdt}, {application-record-element=EngNChks, system-signal=EngNSafeEngNChks}, {application-record-element=EngNCntr, system-signal=EngNSafeEngNCntr}]}
        sender-receiver-to-signal-mapping={data-element=SRS3.TopLevelComposition.EngN2.EngN2, system-signal=EngN2}
        sender-receiver-to-signal-mapping={data-element=SRS3.TopLevelComposition.SwtLiHzrdWarn.SwtLiHzrdWarn, system-signal=SwtLiHzrdWarn}
        sender-receiver-to-signal-mapping={data-element=SRS3.TopLevelComposition.AbsSts.AbsSts, system-signal=AbsSts}
        sender-receiver-to-signal-mapping={data-element=SRS3.TopLevelComposition.DoorPassSts.DoorPassSts, system-signal=DoorPassSts}
        sender-receiver-to-signal-mapping={data-element=SRS3.TopLevelComposition.CrsCtrlrMsg.CrsCtrlrMsg, system-signal=CrsCtrlrMsg}
        sender-receiver-to-signal-mapping={data-element=SRS3.TopLevelComposition.RlyPwrDistbnCmd1WdIgnRlyExtCmd.RlyPwrDistbnCmd1WdIgnRlyExtCmd, system-signal=RlyPwrDistbnCmd1WdIgnRlyExtCmd}
        sender-receiver-to-signal-group-mapping={data-element=SRS3.TopLevelComposition.LeFrntTireMsg.LeFrntTireMsg, signal-group=LeFrntTireMsg, type-mapping=sender-rec-record-type-mapping=record-element-mappings=[{application-record-element=PWarnFlg, system-signal=LeFrntTireMsgPWarnFlg}, {application-record-element=TWarnFlg, system-signal=LeFrntTireMsgTWarnFlg}, {application-record-element=SysWarnFlg, system-signal=LeFrntTireMsgSysWarnFlg}, {application-record-element=FastLoseWarnFlg, system-signal=LeFrntTireMsgFastLoseWarnFlg}, {application-record-element=BattLoSt, system-signal=LeFrntTireMsgBattLoSt}, {application-record-element=MsgOldFlg, system-signal=LeFrntTireMsgMsgOldFlg}, {application-record-element=TireFillgAssiPSts, system-signal=LeFrntTireMsgTireFillgAssiPSts}, {application-record-element=T, system-signal=LeFrntTireMsgT}, {application-record-element=P, system-signal=LeFrntTireMsgP}]}
        sender-receiver-to-signal-group-mapping={data-element=SRS3.TopLevelComposition.PrkgStsToEDR.PrkgStsToEDR, signal-group=PrkgStsToEDR, type-mapping=sender-rec-record-type-mapping=record-element-mappings=[{application-record-element=APATo, system-signal=PrkgStsToEDRAPATo}, {application-record-element=RPATo, system-signal=PrkgStsToEDRRPATo}, {application-record-element=HPATo, system-signal=PrkgStsToEDRHPATo}, {application-record-element=LSDAandTBATo, system-signal=PrkgStsToEDRLSDAandTBATo}, {application-record-element=reserved1, system-signal=PrkgStsToEDRreserved1}, {application-record-element=reserved2, system-signal=PrkgStsToEDRreserved2}, {application-record-element=reserved3, system-signal=PrkgStsToEDRreserved3}]}
        sender-receiver-to-signal-group-mapping={data-element=SRS3.TopLevelComposition.PassSeatPosPerc.PassSeatPosPerc, signal-group=PassSeatPosPerc, type-mapping=sender-rec-record-type-mapping=record-element-mappings=[{application-record-element=SeatPosSldQF, system-signal=PassSeatPosPercSeatPosSldQF}, {application-record-element=SeatPosSldPerc, system-signal=PassSeatPosPercSeatPosSldPerc}, {application-record-element=SeatPosHeiQF, system-signal=PassSeatPosPercSeatPosHeiQF}, {application-record-element=SeatPosHeiPerc, system-signal=PassSeatPosPercSeatPosHeiPerc}, {application-record-element=SeatPosFrntHeiQF, system-signal=PassSeatPosPercSeatPosFrntHeiQF}, {application-record-element=SeatPosFrntHeiPerc, system-signal=PassSeatPosPercSeatPosFrntHeiPerc}]}
        sender-receiver-to-signal-mapping={data-element=SRS3.TopLevelComposition.StsForRtrctrRvsbLe.StsForRtrctrRvsbLe, system-signal=StsForRtrctrRvsbLe}
        sender-receiver-to-signal-mapping={data-element=SRS3.TopLevelComposition.IsgSpdActSgn.IsgSpdActSgn, system-signal=IsgSpdActSgn}
        sender-receiver-to-signal-mapping={data-element=SRS3.TopLevelComposition.EfuseKL15Req4.EfuseKL15Req4, system-signal=EfuseKL15Req4}
        sender-receiver-to-signal-mapping={data-element=SRS3.TopLevelComposition.BkpOfDstTrvld.BkpOfDstTrvld, system-signal=BkpOfDstTrvld}
        sender-receiver-to-signal-group-mapping={data-element=SRS3.TopLevelComposition.AccrPedlRat.AccrPedlRat, signal-group=AccrPedlRat, type-mapping=sender-rec-record-type-mapping=record-element-mappings=[{application-record-element=AccrPedlRat, system-signal=AccrPedlRatAccrPedlRat}, {application-record-element=Cntr, system-signal=AccrPedlRatCntr}, {application-record-element=Chks, system-signal=AccrPedlRatChks}]}
        sender-receiver-to-signal-mapping={data-element=SRS3.TopLevelComposition.TurnIndcrAndHwlByDrvInt.TurnIndcrAndHwlByDrvInt, system-signal=TurnIndcrAndHwlByDrvInt}
        sender-receiver-to-signal-group-mapping={data-element=SRS3.TopLevelComposition.TrsmActrPosnSafe.TrsmActrPosnSafe, signal-group=TrsmActrPosnSafe, type-mapping=sender-rec-record-type-mapping=record-element-mappings=[{application-record-element=TrsmActrPosn, system-signal=TrsmActrPosnSafeTrsmActrPosn}, {application-record-element=TrsmActrPosnChks, system-signal=TrsmActrPosnSafeTrsmActrPosnChks}, {application-record-element=TrsmActrPosnCntr, system-signal=TrsmActrPosnSafeTrsmActrPosnCntr}]}
        sender-receiver-to-signal-mapping={data-element=SRS3.TopLevelComposition.WhlMotSysSpdAct.WhlMotSysSpdAct, system-signal=WhlMotSysSpdAct}
        sender-receiver-to-signal-mapping={data-element=SRS3.TopLevelComposition.EfuseKL15Req1.EfuseKL15Req1, system-signal=EfuseKL15Req1}
        sender-receiver-to-signal-group-mapping={data-element=SRS3.TopLevelComposition.EpbSts.EpbSts, signal-group=EpbSts, type-mapping=sender-rec-record-type-mapping=record-element-mappings=[{application-record-element=EpbSts, system-signal=EpbStsEpbSts}, {application-record-element=EpbStsChks, system-signal=EpbStsChks}, {application-record-element=EpbStsCntr, system-signal=EpbStsCntr}]}
        sender-receiver-to-signal-group-mapping={data-element=SRS3.TopLevelComposition.VehCfgPrmExt.VehCfgPrmExt, signal-group=VehCfgPrmExt, type-mapping=sender-rec-record-type-mapping=record-element-mappings=[{application-record-element=BlkIDBytePosn1, system-signal=VehCfgPrmExtBlkIDBytePosn1}, {application-record-element=CCPBytePosn2, system-signal=VehCfgPrmExtCCPBytePosn2}, {application-record-element=CCPBytePosn3, system-signal=VehCfgPrmExtCCPBytePosn3}, {application-record-element=CCPBytePosn4, system-signal=VehCfgPrmExtCCPBytePosn4}, {application-record-element=CCPBytePosn5, system-signal=VehCfgPrmExtCCPBytePosn5}, {application-record-element=CCPBytePosn6, system-signal=VehCfgPrmExtCCPBytePosn6}, {application-record-element=CCPBytePosn7, system-signal=VehCfgPrmExtCCPBytePosn7}, {application-record-element=CCPBytePosn8, system-signal=VehCfgPrmExtCCPBytePosn8}]}
        sender-receiver-to-signal-mapping={data-element=SRS3.TopLevelComposition.DoorLeReLockSts.DoorLeReLockSts, system-signal=DoorLeReLockSts}
        sender-receiver-to-signal-mapping={data-element=SRS3.TopLevelComposition.CllsnAidPost.CllsnAidPost, system-signal=CllsnAidPost}
        sender-receiver-to-signal-group-mapping={data-element=SRS3.TopLevelComposition.BrkSysCylPMst.BrkSysCylPMst, signal-group=BrkSysCylPMst, type-mapping=sender-rec-record-type-mapping=record-element-mappings=[{application-record-element=Act, system-signal=BrkSysCylPMstAct}, {application-record-element=ActQf, system-signal=BrkSysCylPMstActQf}, {application-record-element=Tar, system-signal=BrkSysCylPMstTar}, {application-record-element=Virt, system-signal=BrkSysCylPMstVirt}, {application-record-element=VirtQf, system-signal=BrkSysCylPMstVirtQf}, {application-record-element=Chks, system-signal=BrkSysCylPMstChks}, {application-record-element=Cntr, system-signal=BrkSysCylPMstCntr}]}
        sender-receiver-to-signal-group-mapping={data-element=SRS3.TopLevelComposition.RiReTireMsg.RiReTireMsg, signal-group=RiReTireMsg, type-mapping=sender-rec-record-type-mapping=record-element-mappings=[{application-record-element=PWarnFlg, system-signal=RiReTireMsgPWarnFlg}, {application-record-element=TWarnFlg, system-signal=RiReTireMsgTWarnFlg}, {application-record-element=SysWarnFlg, system-signal=RiReTireMsgSysWarnFlg}, {application-record-element=FastLoseWarnFlg, system-signal=RiReTireMsgFastLoseWarnFlg}, {application-record-element=BattLoSt, system-signal=RiReTireMsgBattLoSt}, {application-record-element=MsgOldFlg, system-signal=RiReTireMsgMsgOldFlg}, {application-record-element=TireFillgAssiPSts, system-signal=RiReTireMsgTireFillgAssiPSts}, {application-record-element=T, system-signal=RiReTireMsgT}, {application-record-element=P, system-signal=RiReTireMsgP}]}
        sender-receiver-to-signal-mapping={data-element=SRS3.TopLevelComposition.EmgyAsscTrigSts.EmgyAsscTrigSts, system-signal=EmgyAsscTrigSts}
        sender-receiver-to-signal-group-mapping={data-element=SRS3.TopLevelComposition.RiFrntTireMsg.RiFrntTireMsg, signal-group=RiFrntTireMsg, type-mapping=sender-rec-record-type-mapping=record-element-mappings=[{application-record-element=PWarnFlg, system-signal=RiFrntTireMsgPWarnFlg}, {application-record-element=TWarnFlg, system-signal=RiFrntTireMsgTWarnFlg}, {application-record-element=SysWarnFlg, system-signal=RiFrntTireMsgSysWarnFlg}, {application-record-element=FastLoseWarnFlg, system-signal=RiFrntTireMsgFastLoseWarnFlg}, {application-record-element=BattLoSt, system-signal=RiFrntTireMsgBattLoSt}, {application-record-element=MsgOldFlg, system-signal=RiFrntTireMsgMsgOldFlg}, {application-record-element=TireFillgAssiPSts, system-signal=RiFrntTireMsgTireFillgAssiPSts}, {application-record-element=T, system-signal=RiFrntTireMsgT}, {application-record-element=P, system-signal=RiFrntTireMsgP}]}
        sender-receiver-to-signal-mapping={data-element=SRS3.TopLevelComposition.DrvrStuMonSts.DrvrStuMonSts, system-signal=DrvrStuMonSts}
        sender-receiver-to-signal-mapping={data-element=SRS3.TopLevelComposition.VehHomePrkgSysSts.VehHomePrkgSysSts, system-signal=VehHomePrkgSysSts}
        sender-receiver-to-signal-group-mapping={data-element=SRS3.TopLevelComposition.ZCUDMResdSig1ToSRSSafety.ZCUDMResdSig1ToSRSSafety, signal-group=ZCUDMResdSig1ToSRSSafety, type-mapping=sender-rec-record-type-mapping=record-element-mappings=[{application-record-element=Chks, system-signal=ZCUDMResdSig1ToSRSSafetyChks}, {application-record-element=Cntr, system-signal=ZCUDMResdSig1ToSRSSafetyCntr}, {application-record-element=UInt32, system-signal=ZCUDMResdSig1ToSRSSafetyUInt32}]}
        sender-receiver-to-signal-mapping={data-element=SRS3.TopLevelComposition.CrsCtrlrStbOk.CrsCtrlrStbOk, system-signal=CrsCtrlrStbOk}
        sender-receiver-to-signal-group-mapping={data-element=SRS3.TopLevelComposition.WhlDirRotlFrnt.WhlDirRotlFrnt, signal-group=WhlDirRotlFrnt, type-mapping=sender-rec-record-type-mapping=record-element-mappings=[{application-record-element=Le, system-signal=WhlDirRotlFrntLe}, {application-record-element=Ri, system-signal=WhlDirRotlFrntRi}, {application-record-element=Chks, system-signal=WhlDirRotlFrntChks}, {application-record-element=Cntr, system-signal=WhlDirRotlFrntCntr}]}
        sender-receiver-to-signal-mapping={data-element=SRS3.TopLevelComposition.DoorDrvrLockSts.DoorDrvrLockSts, system-signal=DoorDrvrLockSts}
        sender-receiver-to-signal-mapping={data-element=SRS3.TopLevelComposition.SftyAirbRollovrSuppSwt.SftyAirbRollovrSuppSwt, system-signal=SftyAirbRollovrSuppSwt}
        sender-receiver-to-signal-mapping={data-element=SRS3.TopLevelComposition.RlyPwrDistbnCmd1WdIgnRlyCmd.RlyPwrDistbnCmd1WdIgnRlyCmd, system-signal=RlyPwrDistbnCmd1WdIgnRlyCmd}
        sender-receiver-to-signal-group-mapping={data-element=SRS3.TopLevelComposition.VehSpdLgt.VehSpdLgt, signal-group=VehSpdLgt, type-mapping=sender-rec-record-type-mapping=record-element-mappings=[{application-record-element=VehSpdLgtA, system-signal=VehSpdLgtA}, {application-record-element=VehSpdLgtQf, system-signal=VehSpdLgtQf}, {application-record-element=VehSpdLgtCntr, system-signal=VehSpdLgtCntr}, {application-record-element=VehSpdLgtChks, system-signal=VehSpdLgtChks}]}
        sender-receiver-to-signal-mapping={data-element=SRS3.TopLevelComposition.CarTiGlb.CarTiGlb, system-signal=CarTiGlb}
        sender-receiver-to-signal-group-mapping={data-element=SRS3.TopLevelComposition.AmbTIndcdWithUnit.AmbTIndcdWithUnit, signal-group=AmbTIndcdWithUnit, type-mapping=sender-rec-record-type-mapping=record-element-mappings=[{application-record-element=AmbTIndcd, system-signal=AmbTIndcdWithUnitAmbTIndcd}, {application-record-element=AmbTIndcdUnit, system-signal=AmbTIndcdWithUnitAmbTIndcdUnit}, {application-record-element=QF, system-signal=AmbTIndcdWithUnitQF}]}
        sender-receiver-to-signal-mapping={data-element=SRS3.TopLevelComposition.SumActv.SumActv, system-signal=SumActv}
        sender-receiver-to-signal-group-mapping={data-element=SRS3.TopLevelComposition.BrkPedlrRat.BrkPedlrRat, signal-group=BrkPedlrRat, type-mapping=sender-rec-record-type-mapping=record-element-mappings=[{application-record-element=BrkPedlrRatPerc, system-signal=BrkPedlrRatPerc}, {application-record-element=BrkPedlrRatQf, system-signal=BrkPedlrRatQf}]}
        sender-receiver-to-signal-mapping={data-element=SRS3.TopLevelComposition.Overlap.Overlap, system-signal=Overlap}
        sender-receiver-to-signal-mapping={data-element=SRS3.TopLevelComposition.ThrPos.ThrPos, system-signal=ThrPos}
        sender-receiver-to-signal-mapping={data-element=SRS3.TopLevelComposition.StsForRtrctrRvsbRi.StsForRtrctrRvsbRi, system-signal=StsForRtrctrRvsbRi}
        sender-receiver-to-signal-group-mapping={data-element=SRS3.TopLevelComposition.WhlDirRotlRe.WhlDirRotlRe, signal-group=WhlDirRotlRe, type-mapping=sender-rec-record-type-mapping=record-element-mappings=[{application-record-element=Le, system-signal=WhlDirRotlReLe}, {application-record-element=Ri, system-signal=WhlDirRotlReRi}, {application-record-element=Chks, system-signal=WhlDirRotlReChks}, {application-record-element=Cntr, system-signal=WhlDirRotlReCntr}]}
        sender-receiver-to-signal-group-mapping={data-element=SRS3.TopLevelComposition.VehTiAndData.VehTiAndData, signal-group=VehTiAndData, type-mapping=sender-rec-record-type-mapping=record-element-mappings=[{application-record-element=Yr1, system-signal=VehTiAndDataYr1}, {application-record-element=Mth1, system-signal=VehTiAndDataMth1}, {application-record-element=Day, system-signal=VehTiAndDataDay}, {application-record-element=Hr1, system-signal=VehTiAndDataHr1}, {application-record-element=Mins1, system-signal=VehTiAndDataMins1}, {application-record-element=Sec1, system-signal=VehTiAndDataSec1}, {application-record-element=DataValid, system-signal=VehTiAndDataDataValid}]}
        sender-receiver-to-signal-mapping={data-element=SRS3.TopLevelComposition.DispOfPrpsnModForEv.DispOfPrpsnModForEv, system-signal=DispOfPrpsnModForEv}
        sender-receiver-to-signal-mapping={data-element=SRS3.TopLevelComposition.DoorRiReLockSts.DoorRiReLockSts, system-signal=DoorRiReLockSts}
        sender-receiver-to-signal-mapping={data-element=SRS3.TopLevelComposition.EfuseKL15Req2.EfuseKL15Req2, system-signal=EfuseKL15Req2}
        sender-receiver-to-signal-mapping={data-element=SRS3.TopLevelComposition.DoorRiReSts.DoorRiReSts, system-signal=DoorRiReSts}
        sender-receiver-to-signal-group-mapping={data-element=SRS3.TopLevelComposition.WhlSpdCircumlFrnt.WhlSpdCircumlFrnt, signal-group=WhlSpdCircumlFrnt, type-mapping=sender-rec-record-type-mapping=record-element-mappings=[{application-record-element=WhlSpdCircumlFrntLe, system-signal=WhlSpdCircumlFrntLe}, {application-record-element=WhlSpdCircumlFrntLeQf, system-signal=WhlSpdCircumlFrntLeQf}, {application-record-element=WhlSpdCircumlFrntWhlSpdCircumlFrntRi, system-signal=WhlSpdCircumlFrntWhlSpdCircumlFrntRi}, {application-record-element=WhlSpdCircumlFrntRiQf, system-signal=WhlSpdCircumlFrntRiQf}, {application-record-element=WhlSpdCircumlFrntChks, system-signal=WhlSpdCircumlFrntChks}, {application-record-element=WhlSpdCircumlFrntCntr, system-signal=WhlSpdCircumlFrntCntr}]}
        sender-receiver-to-signal-mapping={data-element=SRS3.TopLevelComposition.DoorDrvrSts.DoorDrvrSts, system-signal=DoorDrvrSts}
        sender-receiver-to-signal-mapping={data-element=SRS3.TopLevelComposition.CllsnMtgtnFctSts.CllsnMtgtnFctSts, system-signal=CllsnMtgtnFctSts}
        sender-receiver-to-signal-group-mapping={data-element=SRS3.TopLevelComposition.AbsCtrlActv.AbsCtrlActv, signal-group=AbsCtrlActv, type-mapping=sender-rec-record-type-mapping=record-element-mappings=[{application-record-element=CtrlSts1, system-signal=AbsCtrlActvCtrlSts1}, {application-record-element=Chks, system-signal=AbsCtrlActvChks}, {application-record-element=Cntr, system-signal=AbsCtrlActvCntr}]}
        sender-receiver-to-signal-mapping={data-element=SRS3.TopLevelComposition.EscCtrlIndcn.EscCtrlIndcn, system-signal=EscCtrlIndcn}
        sender-receiver-to-signal-group-mapping={data-element=SRS3.TopLevelComposition.VehCfgPrmExt2.VehCfgPrmExt2, signal-group=VehCfgPrmExt2, type-mapping=sender-rec-record-type-mapping=record-element-mappings=[{application-record-element=BlkIDBytePosn1, system-signal=VehCfgPrmExt2BlkIDBytePosn1}, {application-record-element=CCPBytePosn2, system-signal=VehCfgPrmExt2CCPBytePosn2}, {application-record-element=CCPBytePosn3, system-signal=VehCfgPrmExt2CCPBytePosn3}, {application-record-element=CCPBytePosn4, system-signal=VehCfgPrmExt2CCPBytePosn4}, {application-record-element=CCPBytePosn5, system-signal=VehCfgPrmExt2CCPBytePosn5}, {application-record-element=CCPBytePosn6, system-signal=VehCfgPrmExt2CCPBytePosn6}, {application-record-element=CCPBytePosn7, system-signal=VehCfgPrmExt2CCPBytePosn7}, {application-record-element=CCPBytePosn8, system-signal=VehCfgPrmExt2CCPBytePosn8}]}
        sender-receiver-to-signal-group-mapping={data-element=SRS3.TopLevelComposition.BrkAndAbsWarnIndcnReq.BrkAndAbsWarnIndcnReq, signal-group=BrkAndAbsWarnIndcnReq, type-mapping=sender-rec-record-type-mapping=record-element-mappings=[{application-record-element=BrkWarnIndcnReq, system-signal=BrkAndAbsWarnIndcnReqBrkWarnIndcnReq}, {application-record-element=AbsWarnIndcnReq, system-signal=BrkAndAbsWarnIndcnReqAbsWarnIndcnReq}, {application-record-element=BrkAndAbsWarnIndcnReqChks, system-signal=BrkAndAbsWarnIndcnReqChks}, {application-record-element=BrkAndAbsWarnIndcnReqCntr, system-signal=BrkAndAbsWarnIndcnReqCntr}]}
        sender-receiver-to-signal-mapping={data-element=SRS3.TopLevelComposition.ActvnStsOfRtrctrRvsbRi.ActvnStsOfRtrctrRvsbRi, system-signal=ActvnStsOfRtrctrRvsbRi}
        sender-receiver-to-signal-group-mapping={data-element=SRS3.TopLevelComposition.Vin.Vin, signal-group=Vin, type-mapping=sender-rec-record-type-mapping=record-element-mappings=[{application-record-element=BlockNr, system-signal=VinBlockNr}, {application-record-element=VINSignalPos1, system-signal=VinVINSignalPos1}, {application-record-element=VINSignalPos2, system-signal=VinVINSignalPos2}, {application-record-element=VINSignalPos3, system-signal=VinVINSignalPos3}, {application-record-element=VINSignalPos4, system-signal=VinVINSignalPos4}, {application-record-element=VINSignalPos5, system-signal=VinVINSignalPos5}, {application-record-element=VINSignalPos6, system-signal=VinVINSignalPos6}, {application-record-element=VINSignalPos7, system-signal=VinVINSignalPos7}]}
        sender-receiver-to-signal-group-mapping={data-element=SRS3.TopLevelComposition.AccrpedlSts.AccrpedlSts, signal-group=AccrpedlSts, type-mapping=sender-rec-record-type-mapping=record-element-mappings=[{application-record-element=FltSts, system-signal=AccrpedlStsFltSts}, {application-record-element=Chks, system-signal=AccrpedlStsChks}, {application-record-element=Cntr, system-signal=AccrpedlStsCntr}]}
        sender-receiver-to-signal-group-mapping={data-element=SRS3.TopLevelComposition.BrkFricTqTotAtWhlsAct.BrkFricTqTotAtWhlsAct, signal-group=BrkFricTqTotAtWhlsAct, type-mapping=sender-rec-record-type-mapping=record-element-mappings=[{application-record-element=BrkFricTqTotAtWhlsAct, system-signal=BrkFricTqTotAtWhlsActBrkFricTqTotAtWhlsAct}, {application-record-element=BrkFricTqTotAtWhlsActChks, system-signal=BrkFricTqTotAtWhlsActChks}, {application-record-element=BrkFricTqTotAtWhlsActCntr, system-signal=BrkFricTqTotAtWhlsActCntr}]}
        sender-receiver-to-signal-mapping={data-element=SRS3.TopLevelComposition.CrsCtrlrActvnOk.CrsCtrlrActvnOk, system-signal=CrsCtrlrActvnOk}
        sender-receiver-to-signal-group-mapping={data-element=SRS3.TopLevelComposition.PinionSteerAgGroup.PinionSteerAgGroup, signal-group=PinionSteerAgGroup, type-mapping=sender-rec-record-type-mapping=record-element-mappings=[{application-record-element=PinionSteerAg1, system-signal=PinionSteerAgGroupPinionSteerAg1}, {application-record-element=PinionSteerAg1Qf, system-signal=PinionSteerAgGroupPinionSteerAg1Qf}, {application-record-element=PinionSteerAgSpd1, system-signal=PinionSteerAgGroupPinionSteerAgSpd1}, {application-record-element=PinionSteerAgSpd1Qf, system-signal=PinionSteerAgGroupPinionSteerAgSpd1Qf}, {application-record-element=SteerWhlTq, system-signal=PinionSteerAgGroupSteerWhlTq}, {application-record-element=SteerWhlTqQf, system-signal=PinionSteerAgGroupSteerWhlTqQf}, {application-record-element=Cntr, system-signal=PinionSteerAgGroupCntr}, {application-record-element=Chks, system-signal=PinionSteerAgGroupChks}]}
        sender-receiver-to-signal-mapping={data-element=SRS3.TopLevelComposition.PassAirbNotiConfirm.PassAirbNotiConfirm, system-signal=PassAirbNotiConfirm}
        sender-receiver-to-signal-group-mapping={data-element=SRS3.TopLevelComposition.PosnBrief.PosnBrief, signal-group=PosnBrief, type-mapping=sender-rec-record-type-mapping=record-element-mappings=[{application-record-element=PosnLat, system-signal=PosnBriefPosnLat}, {application-record-element=PosnLgt, system-signal=PosnBriefPosnLgt}]}
        sender-receiver-to-signal-mapping={data-element=SRS3.TopLevelComposition.ActvnStsOfRtrctrRvsbLe.ActvnStsOfRtrctrRvsbLe, system-signal=ActvnStsOfRtrctrRvsbLe}
        sender-receiver-to-signal-group-mapping={data-element=SRS3.TopLevelComposition.LeReTireMsg.LeReTireMsg, signal-group=LeReTireMsg, type-mapping=sender-rec-record-type-mapping=record-element-mappings=[{application-record-element=PWarnFlg, system-signal=LeReTireMsgPWarnFlg}, {application-record-element=TWarnFlg, system-signal=LeReTireMsgTWarnFlg}, {application-record-element=SysWarnFlg, system-signal=LeReTireMsgSysWarnFlg}, {application-record-element=FastLoseWarnFlg, system-signal=LeReTireMsgFastLoseWarnFlg}, {application-record-element=BattLoSt, system-signal=LeReTireMsgBattLoSt}, {application-record-element=MsgOldFlg, system-signal=LeReTireMsgMsgOldFlg}, {application-record-element=TireFillgAssiPSts, system-signal=LeReTireMsgTireFillgAssiPSts}, {application-record-element=T, system-signal=LeReTireMsgT}, {application-record-element=P, system-signal=LeReTireMsgP}]}
        sender-receiver-to-signal-mapping={data-element=SRS3.TopLevelComposition.DispOfPrpsnMod.DispOfPrpsnMod, system-signal=DispOfPrpsnMod}
        sender-receiver-to-signal-group-mapping={data-element=SRS3.TopLevelComposition.DrvrSeatPosPerc.DrvrSeatPosPerc, signal-group=DrvrSeatPosPerc, type-mapping=sender-rec-record-type-mapping=record-element-mappings=[{application-record-element=SeatPosSldQF, system-signal=DrvrSeatPosPercSeatPosSldQF}, {application-record-element=SeatPosSldPerc, system-signal=DrvrSeatPosPercSeatPosSldPerc}, {application-record-element=SeatPosHeiQF, system-signal=DrvrSeatPosPercSeatPosHeiQF}, {application-record-element=SeatPosHeiPerc, system-signal=DrvrSeatPosPercSeatPosHeiPerc}, {application-record-element=SeatPosFrntHeiQF, system-signal=DrvrSeatPosPercSeatPosFrntHeiQF}, {application-record-element=SeatPosFrntHeiPerc, system-signal=DrvrSeatPosPercSeatPosFrntHeiPerc}]}
        sender-receiver-to-signal-group-mapping={data-element=SRS3.TopLevelComposition.BrkPedlPsd.BrkPedlPsd, signal-group=BrkPedlPsd, type-mapping=sender-rec-record-type-mapping=record-element-mappings=[{application-record-element=BrkPedlPsd, system-signal=BrkPedlPsdBrkPedlPsd}, {application-record-element=BrkPedlPsdQf, system-signal=BrkPedlPsdQf}, {application-record-element=BrkPedlPsdCntr, system-signal=BrkPedlPsdCntr}, {application-record-element=BrkPedlPsdChks, system-signal=BrkPedlPsdChks}, {application-record-element=BrkPedlNotPsdSafe, system-signal=BrkPedlPsdBrkPedlNotPsdSafe}]}
        sender-receiver-to-signal-group-mapping={data-element=SRS3.TopLevelComposition.PassAirbLampStsRec.PassAirbLampStsRec, signal-group=PassAirbLampStsRec, type-mapping=sender-rec-record-type-mapping=record-element-mappings=[{application-record-element=PassAirbLampSts, system-signal=PassAirbLampStsRecPassAirbLampSts}, {application-record-element=PassAirbLampStsChks, system-signal=PassAirbLampStsRecPassAirbLampStsChks}, {application-record-element=PassAirbLampStsCntr, system-signal=PassAirbLampStsRecPassAirbLampStsCntr}]}
        sender-receiver-to-signal-group-mapping={data-element=SRS3.TopLevelComposition.TiAndDateIndcn.TiAndDateIndcn, signal-group=TiAndDateIndcn, type-mapping=sender-rec-record-type-mapping=record-element-mappings=[{application-record-element=Yr1, system-signal=TiAndDateIndcnYr1}, {application-record-element=Mth1, system-signal=TiAndDateIndcnMth1}, {application-record-element=Day, system-signal=TiAndDateIndcnDay}, {application-record-element=Hr1, system-signal=TiAndDateIndcnHr1}, {application-record-element=Mins1, system-signal=TiAndDateIndcnMins1}, {application-record-element=Sec1, system-signal=TiAndDateIndcnSec1}, {application-record-element=DataValid, system-signal=TiAndDateIndcnDataValid}]}
        sender-receiver-to-signal-group-mapping={data-element=SRS3.TopLevelComposition.VehModMngtGlbSafe1.VehModMngtGlbSafe1, signal-group=VehModMngtGlbSafe1, type-mapping=sender-rec-record-type-mapping=record-element-mappings=[{application-record-element=UsgModSts, system-signal=VehModMngtGlbSafe1UsgModSts}, {application-record-element=CarModSts1, system-signal=VehModMngtGlbSafe1CarModSts1}, {application-record-element=CarModSubtypWdCarModSubtyp, system-signal=VehModMngtGlbSafe1CarModSubtypWdCarModSubtyp}, {application-record-element=EgyLvlElecMai, system-signal=VehModMngtGlbSafe1EgyLvlElecMai}, {application-record-element=EgyLvlElecSubtyp, system-signal=VehModMngtGlbSafe1EgyLvlElecSubtyp}, {application-record-element=PwrLvlElecMai, system-signal=VehModMngtGlbSafe1PwrLvlElecMai}, {application-record-element=PwrLvlElecSubtyp, system-signal=VehModMngtGlbSafe1PwrLvlElecSubtyp}, {application-record-element=FltEgyCnsWdSts, system-signal=VehModMngtGlbSafe1FltEgyCnsWdSts}, {application-record-element=Chks, system-signal=VehModMngtGlbSafe1Chks}, {application-record-element=Cntr, system-signal=VehModMngtGlbSafe1Cntr}]}
      sw-mappings:
        swc to ecu mapping SRS3SRS3: component=TopLevelComposition.SRS3, ecu-instance=SRS3
    root-software-compositions:
      root sw composition prototype TopLevelComposition: software-composition=TopLevelComposition
package /Communication/NmConfig
  nm config CanNmConfig_ZcudCANFD3_XCM: can-nm-cluster-coupling{coupled-cluster=ZCUDCANFD3CanNmCluster_XCM, nm-busload-reduction-enabled=false, nm-immediate-restart-enabled=false}
    can nm cluster ZCUDCANFD3CanNmCluster_XCM:
      communication-cluster=ZCUD_CANFD3
      nm-channel-id=33
      nm-channel-sleep-master=false
      nm-synchronizing-network=false
      nm-busload-reduction-active=false
      nm-cbv-position=1
      nm-channel-active=false
      nm-immediate-nm-cycle-time=0.02
      nm-immediate-nm-transmissions=20
      nm-message-timeout-time=0.5
      nm-msg-cycle-time=1.0
      nm-network-timeout=4.0
      nm-nid-position=0
      nm-remote-sleep-indication-time=0.0
      nm-repeat-message-time=1.0
      nm-user-data-length=6
      nm-wait-bus-sleep-time=4.0
      can nm node SrsZCUDCANFD3CanNmEcu: controller=ZCUD_CANFD3, nm-if-ecu=CanNmConfig_ZcudCANFD3_XCM/SrsNmEcu, nm-node-id=6, nm-passive-mode-enabled=false, rx-nm-pdu=SumZCUDCANFD3NmPdu1, tx-nm-pdu=SrsZCUDCANFD3NmPdu1, nm-msg-cycle-offset=0.1, nm-msg-reduced-time=0.5, nm-range-config={lower-can-id=1280, upper-can-id=1343}
    nm-if-ecus:
      nm ecu SrsNmEcu:
        bus-specific-nm-ecu=can-nm-ecu=nm-repeat-msg-indication-enabled=false
        ecu-instance=SRS3
        nm-bus-synchronization-enabled=false
        nm-com-control-enabled=false
        nm-cycletime-main-function=0.005
        nm-node-detection-enabled=true
        nm-node-id-enabled=true
        nm-passive-mode-enabled=false
        nm-pdu-rx-indication-enabled=true
        nm-remote-sleep-ind-enabled=false
        nm-repeat-msg-ind-enabled=false
        nm-state-change-ind-enabled=false
        nm-user-data-enabled=true
  nm config NmConfig_ZCUD_MAX: can-nm-cluster-coupling{coupled-cluster=ZCUD_CAN1CanNmCluster, nm-busload-reduction-enabled=false, nm-immediate-restart-enabled=false}
    can nm cluster ZCUD_CAN1CanNmCluster:
      communication-cluster=ZCUD_CAN1
      nm-channel-id=17
      nm-channel-sleep-master=false
      nm-synchronizing-network=false
      nm-busload-reduction-active=false
      nm-car-wake-up-rx-enabled=false
      nm-cbv-position=1
      nm-channel-active=true
      nm-immediate-nm-cycle-time=0.02
      nm-immediate-nm-transmissions=20
      nm-message-timeout-time=0.5
      nm-msg-cycle-time=1.0
      nm-network-timeout=4.0
      nm-nid-position=0
      nm-remote-sleep-indication-time=0.0
      nm-repeat-message-time=1.0
      nm-user-data-length=6
      nm-wait-bus-sleep-time=4.0
      can nm node SrsZCUDCAN1NmEcu: controller=ZCUD_CAN1, nm-if-ecu=NmConfig_ZCUD_MAX/SrsNmEcu, nm-node-id=27, rx-nm-pdu=TcmbZCUDCAN1NmPdu1, tx-nm-pdu=SrsZCUDCAN1NmPdu1, nm-msg-cycle-offset=0.1, nm-msg-reduced-time=0.5, nm-range-config={lower-can-id=1280, upper-can-id=1343}
    nm-if-ecus:
      nm ecu SrsNmEcu:
        bus-specific-nm-ecu=can-nm-ecu=nm-repeat-msg-indication-enabled=false
        ecu-instance=SRS3
        nm-bus-synchronization-enabled=false
        nm-com-control-enabled=false
        nm-cycletime-main-function=0.005
        nm-node-detection-enabled=true
        nm-node-id-enabled=true
        nm-passive-mode-enabled=false
        nm-pdu-rx-indication-enabled=true
        nm-remote-sleep-ind-enabled=false
        nm-repeat-msg-ind-enabled=false
        nm-state-change-ind-enabled=false
        nm-user-data-enabled=true
package /Communication/Pdu
  dcm i pdu EtcToSrsISO26021DiagDcmIpdu11: length=4000, diag-pdu-type=DIAG-REQUEST
  dcm i pdu DhuToAllFuncDiagDcmIpdu: length=6, diag-pdu-type=DIAG-REQUEST
  dcm i pdu DhuToSrsDiagDcmIpdu: length=4000, diag-pdu-type=DIAG-REQUEST
  dcm i pdu SrsToEtcISO26021DiagDcmIpdu11: length=4000, diag-pdu-type=DIAG-RESPONSE
  dcm i pdu SrsToDhuDiagDcmIpdu: length=4000, diag-pdu-type=DIAG-RESPONSE
package /Communication/ISignalGroup
  81 x i signal group:
    igSRSdevelpsignalgroupTX: i-signal=[isSRSdevelpsignalgroupTXFunctiondevpsignalgroup8, isSRSdevelpsignalgroupTXFunctiondevpsignalgroup7, isSRSdevelpsignalgroupTXFunctiondevpsignalgroup2, isSRSdevelpsignalgroupTXFunctiondevpsignalgroup4, isSRSdevelpsignalgroupTXFunctiondevpsignalgroup1, isSRSdevelpsignalgroupTXFunctiondevpsignalgroup3, isSRSdevelpsignalgroupTXFunctiondevpsignalgroup5, isSRSdevelpsignalgroupTXFunctiondevpsignalgroup6], system-signal-group=SRSdevelpsignalgroupTX
    igAgDataRawSafe_0: i-signal=[isAgDataRawSafeYawRate_0, isAgDataRawSafeRollRateQf_0, isAgDataRawSafeCntr_0, isAgDataRawSafeChks_0, isAgDataRawSafeYawRateQf_0, isAgDataRawSafeRollRate_0], system-signal-group=AgDataRawSafe
    igBltLockStAtDrvr: i-signal=[isBltLockStAtDrvrBltLockSt1, isBltLockStAtDrvrBltLockSts], system-signal-group=BltLockStAtDrvr
    igBltLockStAtPass: i-signal=[isBltLockStAtPassBltLockSt1, isBltLockStAtPassBltLockSts], system-signal-group=BltLockStAtPass
    igBltLockStSafeAtDrvr: i-signal=[isBltLockStSafeAtDrvrBltLockStErrSts, isBltLockStSafeAtDrvrCntr, isBltLockStSafeAtDrvrChks, isBltLockStSafeAtDrvrBltLockSt1], system-signal-group=BltLockStSafeAtDrvr
    igAgDataRaw2Safe: i-signal=[isAgDataRaw2SafeCntr, isAgDataRaw2SafeChks, isAgDataRaw2SafePitchRate, isAgDataRaw2SafePitchRateQf], system-signal-group=AgDataRaw2Safe
    igPassAirbLampReq: i-signal=[isPassAirbLampReqPassAirbLampEnaReq, isPassAirbLampReqChgOfPassAirbSts, isPassAirbLampReqChks, isPassAirbLampReqPassAirbLampDiReq, isPassAirbLampReqCntr], system-signal-group=PassAirbLampReq
    igVFCVectorSRS_0: i-signal=[isVFCVectorSRSVFCid53_0, isVFCVectorSRSVFCid60_0, isVFCVectorSRSVFCid9_0, isVFCVectorSRSVFCid54_0, isVFCVectorSRSVFCid57_0, isVFCVectorSRSVFCid41_0, isVFCVectorSRSVFCid10_0, isVFCVectorSRSVFCid35_0, isVFCVectorSRSVFCid34_0, isVFCVectorSRSVFCid1_0, isVFCVectorSRSVFCid28_0, isVFCVectorSRSVFCid27_0, isVFCVectorSRSVFCid19_0, isVFCVectorSRSVFCid20_0, isVFCVectorSRSVFCid5_0, isVFCVectorSRSVFCid29_0, isVFCVectorSRSVFCid30_0, isVFCVectorSRSVFCid0_0, isVFCVectorSRSVFCid18_0, isVFCVectorSRSVFCid56_0, isVFCVectorSRSVFCid21_0, isVFCVectorSRSVFCid3_0, isVFCVectorSRSVFCid17_0, isVFCVectorSRSVFCid6_0, isVFCVectorSRSVFCid44_0, isVFCVectorSRSVFCid26_0, isVFCVectorSRSVFCid43_0, isVFCVectorSRSVFCid61_0, isVFCVectorSRSVFCid7_0, isVFCVectorSRSVFCid45_0, isVFCVectorSRSVFCid38_0, isVFCVectorSRSVFCid42_0, isVFCVectorSRSVFCid37_0, isVFCVectorSRSVFCid32_0, isVFCVectorSRSBlockID_0, isVFCVectorSRSVFCid46_0, isVFCVectorSRSVFCid23_0, isVFCVectorSRSVFCid39_0, isVFCVectorSRSVFCid2_0, isVFCVectorSRSVFCid11_0, isVFCVectorSRSVFCid4_0, isVFCVectorSRSVFCid24_0, isVFCVectorSRSVFCid33_0, isVFCVectorSRSVFCid22_0, isVFCVectorSRSVFCid8_0, isVFCVectorSRSVFCid47_0, isVFCVectorSRSVFCid14_0, isVFCVectorSRSVFCid58_0, isVFCVectorSRSVFCid13_0, isVFCVectorSRSVFCid50_0, isVFCVectorSRSVFCid25_0, isVFCVectorSRSVFCid40_0, isVFCVectorSRSVFCid48_0, isVFCVectorSRSVFCid49_0, isVFCVectorSRSVFCid31_0, isVFCVectorSRSVFCid52_0, isVFCVectorSRSVFCid15_0, isVFCVectorSRSVFCid59_0, isVFCVectorSRSVFCid51_0, isVFCVectorSRSVFCid16_0, isVFCVectorSRSVFCid12_0, isVFCVectorSRSVFCid55_0, isVFCVectorSRSVFCid36_0], system-signal-group=VFCVectorSRS
    igADataRawSafe_0: i-signal=[isADataRawSafeALgt_0, isADataRawSafeALgt1Qf_0, isADataRawSafeALat_0, isADataRawSafeAVert_0, isADataRawSafeALat1Qf_0, isADataRawSafeChks_0, isADataRawSafeAVertQf_0, isADataRawSafeCntr_0], system-signal-group=ADataRawSafe
    igBltLockStAtPassMid: i-signal=[isBltLockStAtPassMidBltLockEquid, isBltLockStAtPassMidBltLockSt1, isBltLockStAtPassMidBltLockSts], system-signal-group=BltLockStAtPassMid
    igBltLockStAtRowFrthLe: i-signal=[isBltLockStAtRowFrthLeBltLockSts, isBltLockStAtRowFrthLeBltLockEquid, isBltLockStAtRowFrthLeBltLockSt1], system-signal-group=BltLockStAtRowFrthLe
    igBltLockStAtRowFrthMid: i-signal=[isBltLockStAtRowFrthMidBltLockSts, isBltLockStAtRowFrthMidBltLockSt1, isBltLockStAtRowFrthMidBltLockEquid], system-signal-group=BltLockStAtRowFrthMid
    igBltLockStAtRowFrthRi: i-signal=[isBltLockStAtRowFrthRiBltLockSts, isBltLockStAtRowFrthRiBltLockSt1, isBltLockStAtRowFrthRiBltLockEquid], system-signal-group=BltLockStAtRowFrthRi
    igBltLockStAtRowThrdMid: i-signal=[isBltLockStAtRowThrdMidBltLockEquid, isBltLockStAtRowThrdMidBltLockSts, isBltLockStAtRowThrdMidBltLockSt1], system-signal-group=BltLockStAtRowThrdMid
    igJID: i-signal=[isJIDByte3, isJIDByte0, isJIDByte7, isJIDByte2, isJIDByte6, isJIDByte4, isJIDByte5, isJIDByte1], system-signal-group=JID
    igSRSResdSig1ToZCUDMSafety: i-signal=[isSRSResdSig1ToZCUDMSafetyCntr, isSRSResdSig1ToZCUDMSafetyUInt32, isSRSResdSig1ToZCUDMSafetyChks], system-signal-group=SRSResdSig1ToZCUDMSafety
    igBltCrashNotif: i-signal=[isBltCrashNotifDrvr, isBltCrashNotifPass], system-signal-group=BltCrashNotif
    igRecOfImpct: i-signal=[isRecOfImpctVehOri, isRecOfImpctImpctRollAg, isRecOfImpctCrashOffroadA, isRecOfImpctCrashOffroadRTsevere, isRecOfImpctCrashSideRi, isRecOfImpctImpctDvy, isRecOfImpctCrashState, isRecOfImpctCrashFrnt, isRecOfImpctCrashSideLe, isRecOfImpctCrashRollovr, isRecOfImpctCrashRe, isRecOfImpctCrashOffroadD, isRecOfImpctCrashOffroadRT, isRecOfImpctCrashPed, isRecOfImpctImpctDvx], system-signal-group=RecOfImpct
    igAgDataCmpQuality_0: i-signal=[isAgDataCmpQualityYawRateCmpQuality_0, isAgDataCmpQualityRollRateCmpQuality_0, isAgDataCmpQualityPitchRateCmpQuality_0], system-signal-group=AgDataCmpQuality
    igRecOfImpct2: i-signal=[isRecOfImpct2ImpctDvySigned, isRecOfImpct2ImpctDvxSigned], system-signal-group=RecOfImpct2
    igRecOfPostImpctBrkgCfmd: i-signal=[isRecOfPostImpctBrkgCfmdCrashRollovr, isRecOfPostImpctBrkgCfmdCrashOz, isRecOfPostImpctBrkgCfmdCrashSideRi, isRecOfPostImpctBrkgCfmdCrashOffroadRTsevere, isRecOfPostImpctBrkgCfmdCrashFrnt, isRecOfPostImpctBrkgCfmdCrashSideLe, isRecOfPostImpctBrkgCfmdCrashLargeAnimal, isRecOfPostImpctBrkgCfmdCrashRe, isRecOfPostImpctBrkgCfmdPostImpctBrkgCfmd, isRecOfPostImpctBrkgCfmdCrashOffroadD, isRecOfPostImpctBrkgCfmdCrashOffroadA, isRecOfPostImpctBrkgCfmdCntr, isRecOfPostImpctBrkgCfmdChks, isRecOfPostImpctBrkgCfmdCrashOffroadRT, isRecOfPostImpctBrkgCfmdCrashPed], system-signal-group=RecOfPostImpctBrkgCfmd
    igBltLockStAtRowSecLe: i-signal=[isBltLockStAtRowSecLeBltLockEquid, isBltLockStAtRowSecLeBltLockSts, isBltLockStAtRowSecLeBltLockSt1], system-signal-group=BltLockStAtRowSecLe
    igBltLockStAtRowSecMid: i-signal=[isBltLockStAtRowSecMidBltLockEquid, isBltLockStAtRowSecMidBltLockSts, isBltLockStAtRowSecMidBltLockSt1], system-signal-group=BltLockStAtRowSecMid
    igBltLockStAtRowSecRi: i-signal=[isBltLockStAtRowSecRiBltLockSt1, isBltLockStAtRowSecRiBltLockEquid, isBltLockStAtRowSecRiBltLockSts], system-signal-group=BltLockStAtRowSecRi
    igBltLockStAtRowThrdLe: i-signal=[isBltLockStAtRowThrdLeBltLockSt1, isBltLockStAtRowThrdLeBltLockEquid, isBltLockStAtRowThrdLeBltLockSts], system-signal-group=BltLockStAtRowThrdLe
    igBltLockStAtRowThrdRi: i-signal=[isBltLockStAtRowThrdRiBltLockSts, isBltLockStAtRowThrdRiBltLockEquid, isBltLockStAtRowThrdRiBltLockSt1], system-signal-group=BltLockStAtRowThrdRi
    igRecOfPostImpctBrkgSuspc: i-signal=[isRecOfPostImpctBrkgSuspcChks, isRecOfPostImpctBrkgSuspcCntr, isRecOfPostImpctBrkgSuspcSuspcPostImpctBrkg], system-signal-group=RecOfPostImpctBrkgSuspc
    igAsyDataWithCmpSafe_0: i-signal=[isAsyDataWithCmpSafeALat1Qf_0, isAsyDataWithCmpSafeChks_0, isAsyDataWithCmpSafeYawRateWithCmp_0, isAsyDataWithCmpSafeALatWithCmp_0, isAsyDataWithCmpSafeGrdtOfALgt_0, isAsyDataWithCmpSafeYawRateQf_0, isAsyDataWithCmpSafeCntr_0, isAsyDataWithCmpSafeALgt1Qf_0], system-signal-group=AsyDataWithCmpSafe
    igCrashStsSafe_0: i-signal=[isCrashStsSafeChks_0, isCrashStsSafeSts_0, isCrashStsSafeCntr_0], system-signal-group=CrashStsSafe
    igCrashStsSafe_1: i-signal=[isCrashStsSafeChks_1, isCrashStsSafeSts_1, isCrashStsSafeCntr_1], system-signal-group=CrashStsSafe
    igVFCVectorSRS_1: i-signal=[isVFCVectorSRSVFCid53_1, isVFCVectorSRSVFCid60_1, isVFCVectorSRSVFCid9_1, isVFCVectorSRSVFCid54_1, isVFCVectorSRSVFCid57_1, isVFCVectorSRSVFCid41_1, isVFCVectorSRSVFCid10_1, isVFCVectorSRSVFCid35_1, isVFCVectorSRSVFCid34_1, isVFCVectorSRSVFCid1_1, isVFCVectorSRSVFCid28_1, isVFCVectorSRSVFCid27_1, isVFCVectorSRSVFCid19_1, isVFCVectorSRSVFCid20_1, isVFCVectorSRSVFCid5_1, isVFCVectorSRSVFCid29_1, isVFCVectorSRSVFCid30_1, isVFCVectorSRSVFCid0_1, isVFCVectorSRSVFCid18_1, isVFCVectorSRSVFCid56_1, isVFCVectorSRSVFCid21_1, isVFCVectorSRSVFCid3_1, isVFCVectorSRSVFCid17_1, isVFCVectorSRSVFCid6_1, isVFCVectorSRSVFCid44_1, isVFCVectorSRSVFCid26_1, isVFCVectorSRSVFCid43_1, isVFCVectorSRSVFCid61_1, isVFCVectorSRSVFCid7_1, isVFCVectorSRSVFCid45_1, isVFCVectorSRSVFCid38_1, isVFCVectorSRSVFCid42_1, isVFCVectorSRSVFCid37_1, isVFCVectorSRSVFCid32_1, isVFCVectorSRSBlockID_1, isVFCVectorSRSVFCid46_1, isVFCVectorSRSVFCid23_1, isVFCVectorSRSVFCid39_1, isVFCVectorSRSVFCid2_1, isVFCVectorSRSVFCid11_1, isVFCVectorSRSVFCid4_1, isVFCVectorSRSVFCid24_1, isVFCVectorSRSVFCid33_1, isVFCVectorSRSVFCid22_1, isVFCVectorSRSVFCid8_1, isVFCVectorSRSVFCid47_1, isVFCVectorSRSVFCid14_1, isVFCVectorSRSVFCid58_1, isVFCVectorSRSVFCid13_1, isVFCVectorSRSVFCid50_1, isVFCVectorSRSVFCid25_1, isVFCVectorSRSVFCid40_1, isVFCVectorSRSVFCid48_1, isVFCVectorSRSVFCid49_1, isVFCVectorSRSVFCid31_1, isVFCVectorSRSVFCid52_1, isVFCVectorSRSVFCid15_1, isVFCVectorSRSVFCid59_1, isVFCVectorSRSVFCid51_1, isVFCVectorSRSVFCid16_1, isVFCVectorSRSVFCid12_1, isVFCVectorSRSVFCid55_1, isVFCVectorSRSVFCid36_1], system-signal-group=VFCVectorSRS
    igADataRawSafe_1: i-signal=[isADataRawSafeALgt_1, isADataRawSafeALgt1Qf_1, isADataRawSafeALat_1, isADataRawSafeAVert_1, isADataRawSafeALat1Qf_1, isADataRawSafeChks_1, isADataRawSafeAVertQf_1, isADataRawSafeCntr_1], system-signal-group=ADataRawSafe
    igAgDataRawSafe_1: i-signal=[isAgDataRawSafeYawRate_1, isAgDataRawSafeRollRateQf_1, isAgDataRawSafeCntr_1, isAgDataRawSafeChks_1, isAgDataRawSafeYawRateQf_1, isAgDataRawSafeRollRate_1], system-signal-group=AgDataRawSafe
    igAsyDataWithCmpSafe_1: i-signal=[isAsyDataWithCmpSafeALat1Qf_1, isAsyDataWithCmpSafeChks_1, isAsyDataWithCmpSafeYawRateWithCmp_1, isAsyDataWithCmpSafeALatWithCmp_1, isAsyDataWithCmpSafeGrdtOfALgt_1, isAsyDataWithCmpSafeYawRateQf_1, isAsyDataWithCmpSafeCntr_1, isAsyDataWithCmpSafeALgt1Qf_1], system-signal-group=AsyDataWithCmpSafe
    igIntgtIMUDataRawSafe: i-signal=[isIntgtIMUDataRawSafeAvert, isIntgtIMUDataRawSafeAVertQf, isIntgtIMUDataRawSafeALat1Qf, isIntgtIMUDataRawSafeALgt, isIntgtIMUDataRawSafePitchRate, isIntgtIMUDataRawSafeYawRate, isIntgtIMUDataRawSafeRollRate, isIntgtIMUDataRawSafeALat, isIntgtIMUDataRawSafeChks, isIntgtIMUDataRawSafeCntr, isIntgtIMUDataRawSafeYawRateQf, isIntgtIMUDataRawSafePitchRateQf, isIntgtIMUDataRawSafeALgt1Qf, isIntgtIMUDataRawSafeRollRateQf], system-signal-group=IntgtIMUDataRawSafe
    igAgDataCmpQuality_1: i-signal=[isAgDataCmpQualityYawRateCmpQuality_1, isAgDataCmpQualityRollRateCmpQuality_1, isAgDataCmpQualityPitchRateCmpQuality_1], system-signal-group=AgDataCmpQuality
    igPassSeatPosPerc: i-signal=[isPassSeatPosPercSeatPosFrntHeiPerc, isPassSeatPosPercSeatPosHeiPerc, isPassSeatPosPercSeatPosSldQF, isPassSeatPosPercSeatPosFrntHeiQF, isPassSeatPosPercSeatPosSldPerc, isPassSeatPosPercSeatPosHeiQF], system-signal-group=PassSeatPosPerc
    igWhlSpdCircumlRe: i-signal=[isWhlSpdCircumlReCntr, isWhlSpdCircumlReChks, isWhlSpdCircumlReRiQf, isWhlSpdCircumlReLeQf, isWhlSpdCircumlReLe, isWhlSpdCircumlReRi], system-signal-group=WhlSpdCircumlRe
    igPinionSteerAgGroup: i-signal=[isPinionSteerAgGroupPinionSteerAg1Qf, isPinionSteerAgGroupCntr, isPinionSteerAgGroupSteerWhlTq, isPinionSteerAgGroupPinionSteerAg1, isPinionSteerAgGroupPinionSteerAgSpd1, isPinionSteerAgGroupSteerWhlTqQf, isPinionSteerAgGroupPinionSteerAgSpd1Qf, isPinionSteerAgGroupChks], system-signal-group=PinionSteerAgGroup
    igWhlDirRotlRe: i-signal=[isWhlDirRotlReLe, isWhlDirRotlReCntr, isWhlDirRotlReChks, isWhlDirRotlReRi], system-signal-group=WhlDirRotlRe
    igDrvrSeatPosPerc: i-signal=[isDrvrSeatPosPercSeatPosFrntHeiQF, isDrvrSeatPosPercSeatPosSldQF, isDrvrSeatPosPercSeatPosFrntHeiPerc, isDrvrSeatPosPercSeatPosHeiPerc, isDrvrSeatPosPercSeatPosSldPerc, isDrvrSeatPosPercSeatPosHeiQF], system-signal-group=DrvrSeatPosPerc
    igPassAirbLampStsRec: i-signal=[isPassAirbLampStsRecPassAirbLampStsCntr, isPassAirbLampStsRecPassAirbLampStsChks, isPassAirbLampStsRecPassAirbLampSts], system-signal-group=PassAirbLampStsRec
    igEngNSafe: i-signal=[isEngNSafeEngNGrdt, isEngNSafeEngN, isEngNSafeEngNCntr, isEngNSafeEngNChks], system-signal-group=EngNSafe
    igBrkPedlrRat: i-signal=[isBrkPedlrRatPerc, isBrkPedlrRatQf], system-signal-group=BrkPedlrRat
    igEscSt: i-signal=[isEscStChks, isEscStEscSt, isEscStCntr], system-signal-group=EscSt
    igAccrpedlSts: i-signal=[isAccrpedlStsChks, isAccrpedlStsCntr, isAccrpedlStsFltSts], system-signal-group=AccrpedlSts
    igAbsCtrlActv: i-signal=[isAbsCtrlActvCtrlSts1, isAbsCtrlActvChks, isAbsCtrlActvCntr], system-signal-group=AbsCtrlActv
    igPreCrashFrontData: i-signal=[isPreCrashFrontDataCntr, isPreCrashFrontDataClosingVelocity, isPreCrashFrontDataOverLap, isPreCrashFrontDataTimeToImpact, isPreCrashFrontDataChks, isPreCrashFrontDataObjectClass], system-signal-group=PreCrashFrontData
    igZCUDMResdSig1ToSRSSafety: i-signal=[isZCUDMResdSig1ToSRSSafetyChks, isZCUDMResdSig1ToSRSSafetyCntr, isZCUDMResdSig1ToSRSSafetyUInt32], system-signal-group=ZCUDMResdSig1ToSRSSafety
    igAsySftyFctStsToEDR: i-signal=[isAsySftyFctStsToEDRACSFCFctSts, isAsySftyFctStsToEDRACSFB1FctSts, isAsySftyFctStsToEDRCSFFctSts, isAsySftyFctStsToEDRACSFB2FctSts, isAsySftyFctStsToEDRACSFEFctSts, isAsySftyFctStsToEDRLDWSFctSts, isAsySftyFctStsToEDRACCFctSTs, isAsySftyFctStsToEDRESFFctSts, isAsySftyFctStsToEDRAEBSFctSts, isAsySftyFctStsToEDRACSFDFctSts], system-signal-group=AsySftyFctStsToEDR
    igVehMtnSt: i-signal=[isVehMtnStCntr, isVehMtnStVehMtnSt, isVehMtnStChks], system-signal-group=VehMtnSt
    igPosnBrief: i-signal=[isPosnBriefPosnLat, isPosnBriefPosnLgt], system-signal-group=PosnBrief
    igSftyDecelGroupSafe: i-signal=[isSftyDecelGroupSafeCntr, isSftyDecelGroupSafeAsySftyDecelReq, isSftyDecelGroupSafeAsySftyEnaDecel, isSftyDecelGroupSafeChks], system-signal-group=SftyDecelGroupSafe
    igBrkPedlPsd: i-signal=[isBrkPedlPsdBrkPedlPsd, isBrkPedlPsdCntr, isBrkPedlPsdChks, isBrkPedlPsdQf, isBrkPedlPsdBrkPedlNotPsdSafe], system-signal-group=BrkPedlPsd
    igVehCfgPrm: i-signal=[isVehCfgPrmCCPBytePosn2, isVehCfgPrmCCPBytePosn7, isVehCfgPrmCCPBytePosn3, isVehCfgPrmCCPBytePosn4, isVehCfgPrmCCPBytePosn8, isVehCfgPrmCCPBytePosn5, isVehCfgPrmBlkIDBytePosn1, isVehCfgPrmCCPBytePosn6], system-signal-group=VehCfgPrm
    igVehCfgPrmExt: i-signal=[isVehCfgPrmExtCCPBytePosn8, isVehCfgPrmExtCCPBytePosn6, isVehCfgPrmExtCCPBytePosn4, isVehCfgPrmExtCCPBytePosn3, isVehCfgPrmExtCCPBytePosn2, isVehCfgPrmExtBlkIDBytePosn1, isVehCfgPrmExtCCPBytePosn5, isVehCfgPrmExtCCPBytePosn7], system-signal-group=VehCfgPrmExt
    igBrkAndAbsWarnIndcnReq: i-signal=[isBrkAndAbsWarnIndcnReqCntr, isBrkAndAbsWarnIndcnReqBrkWarnIndcnReq, isBrkAndAbsWarnIndcnReqAbsWarnIndcnReq, isBrkAndAbsWarnIndcnReqChks], system-signal-group=BrkAndAbsWarnIndcnReq
    igAccrPedlRat: i-signal=[isAccrPedlRatCntr, isAccrPedlRatChks, isAccrPedlRatAccrPedlRat], system-signal-group=AccrPedlRat
    igBrkSysCylPMst: i-signal=[isBrkSysCylPMstChks, isBrkSysCylPMstCntr, isBrkSysCylPMstAct, isBrkSysCylPMstTar, isBrkSysCylPMstActQf, isBrkSysCylPMstVirt, isBrkSysCylPMstVirtQf], system-signal-group=BrkSysCylPMst
    igPrkgStsToEDR: i-signal=[isPrkgStsToEDRHPATo, isPrkgStsToEDRAPATo, isPrkgStsToEDRreserved3, isPrkgStsToEDRRPATo, isPrkgStsToEDRreserved1, isPrkgStsToEDRLSDAandTBATo, isPrkgStsToEDRreserved2], system-signal-group=PrkgStsToEDR
    igVehSpdLgt: i-signal=[isVehSpdLgtCntr, isVehSpdLgtA, isVehSpdLgtQf, isVehSpdLgtChks], system-signal-group=VehSpdLgt
    igWhlSpdCircumlFrnt: i-signal=[isWhlSpdCircumlFrntCntr, isWhlSpdCircumlFrntWhlSpdCircumlFrntRi, isWhlSpdCircumlFrntLe, isWhlSpdCircumlFrntRiQf, isWhlSpdCircumlFrntChks, isWhlSpdCircumlFrntLeQf], system-signal-group=WhlSpdCircumlFrnt
    igWhlDirRotlFrnt: i-signal=[isWhlDirRotlFrntLe, isWhlDirRotlFrntCntr, isWhlDirRotlFrntRi, isWhlDirRotlFrntChks], system-signal-group=WhlDirRotlFrnt
    igVehBattU: i-signal=[isVehBattUSysU, isVehBattUSysUQf], system-signal-group=VehBattU
    igTiAndDateIndcn: i-signal=[isTiAndDateIndcnDataValid, isTiAndDateIndcnYr1, isTiAndDateIndcnSec1, isTiAndDateIndcnHr1, isTiAndDateIndcnMins1, isTiAndDateIndcnMth1, isTiAndDateIndcnDay], system-signal-group=TiAndDateIndcn
    igAmbTIndcdWithUnit: i-signal=[isAmbTIndcdWithUnitAmbTIndcdUnit, isAmbTIndcdWithUnitAmbTIndcd, isAmbTIndcdWithUnitQF], system-signal-group=AmbTIndcdWithUnit
    igBrkFricTqTotAtWhlsAct: i-signal=[isBrkFricTqTotAtWhlsActBrkFricTqTotAtWhlsAct, isBrkFricTqTotAtWhlsActChks, isBrkFricTqTotAtWhlsActCntr], system-signal-group=BrkFricTqTotAtWhlsAct
    igSRSdevelpsignalgroupRX: i-signal=[isSRSdevelpsignalgroupRXFunctiondevpsignalgroup5, isSRSdevelpsignalgroupRXFunctiondevpsignalgroup6, isSRSdevelpsignalgroupRXFunctiondevpsignalgroup2, isSRSdevelpsignalgroupRXFunctiondevpsignalgroup1, isSRSdevelpsignalgroupRXFunctiondevpsignalgroup7, isSRSdevelpsignalgroupRXFunctiondevpsignalgroup8, isSRSdevelpsignalgroupRXFunctiondevpsignalgroup4, isSRSdevelpsignalgroupRXFunctiondevpsignalgroup3], system-signal-group=SRSdevelpsignalgroupRX
    igAsyALgtSts: i-signal=[isAsyALgtStsAsyALgtSts, isAsyALgtStsCntr, isAsyALgtStsChks], system-signal-group=AsyALgtSts
    igVehCfgPrmExt2: i-signal=[isVehCfgPrmExt2BlkIDBytePosn1, isVehCfgPrmExt2CCPBytePosn2, isVehCfgPrmExt2CCPBytePosn6, isVehCfgPrmExt2CCPBytePosn4, isVehCfgPrmExt2CCPBytePosn5, isVehCfgPrmExt2CCPBytePosn3, isVehCfgPrmExt2CCPBytePosn7, isVehCfgPrmExt2CCPBytePosn8], system-signal-group=VehCfgPrmExt2
    igLeFrntTireMsg: i-signal=[isLeFrntTireMsgMsgOldFlg, isLeFrntTireMsgTireFillgAssiPSts, isLeFrntTireMsgFastLoseWarnFlg, isLeFrntTireMsgT, isLeFrntTireMsgPWarnFlg, isLeFrntTireMsgBattLoSt, isLeFrntTireMsgP, isLeFrntTireMsgSysWarnFlg, isLeFrntTireMsgTWarnFlg], system-signal-group=LeFrntTireMsg
    igLeReTireMsg: i-signal=[isLeReTireMsgPWarnFlg, isLeReTireMsgTireFillgAssiPSts, isLeReTireMsgBattLoSt, isLeReTireMsgP, isLeReTireMsgFastLoseWarnFlg, isLeReTireMsgMsgOldFlg, isLeReTireMsgT, isLeReTireMsgTWarnFlg, isLeReTireMsgSysWarnFlg], system-signal-group=LeReTireMsg
    igVehSpdIndcd: i-signal=[isVehSpdIndcdVeSpdIndcdUnit, isVehSpdIndcdVehSpdIndcd], system-signal-group=VehSpdIndcd
    igEpbSts: i-signal=[isEpbStsCntr, isEpbStsChks, isEpbStsEpbSts], system-signal-group=EpbSts
    igSwtIndcr: i-signal=[isSwtIndcrIndcrTypExtReq, isSwtIndcrIndcrTypExtReqChks, isSwtIndcrIndcrTypExtReqCntr, isSwtIndcrIndcrTypExtReqToUpdQf], system-signal-group=SwtIndcr
    igRiFrntTireMsg: i-signal=[isRiFrntTireMsgPWarnFlg, isRiFrntTireMsgT, isRiFrntTireMsgSysWarnFlg, isRiFrntTireMsgMsgOldFlg, isRiFrntTireMsgBattLoSt, isRiFrntTireMsgFastLoseWarnFlg, isRiFrntTireMsgTireFillgAssiPSts, isRiFrntTireMsgTWarnFlg, isRiFrntTireMsgP], system-signal-group=RiFrntTireMsg
    igRiReTireMsg: i-signal=[isRiReTireMsgBattLoSt, isRiReTireMsgP, isRiReTireMsgPWarnFlg, isRiReTireMsgTWarnFlg, isRiReTireMsgMsgOldFlg, isRiReTireMsgTireFillgAssiPSts, isRiReTireMsgSysWarnFlg, isRiReTireMsgFastLoseWarnFlg, isRiReTireMsgT], system-signal-group=RiReTireMsg
    igVehModMngtGlbSafe1: i-signal=[isVehModMngtGlbSafe1PwrLvlElecSubtyp, isVehModMngtGlbSafe1FltEgyCnsWdSts, isVehModMngtGlbSafe1EgyLvlElecMai, isVehModMngtGlbSafe1EgyLvlElecSubtyp, isVehModMngtGlbSafe1Cntr, isVehModMngtGlbSafe1Chks, isVehModMngtGlbSafe1CarModSts1, isVehModMngtGlbSafe1UsgModSts, isVehModMngtGlbSafe1PwrLvlElecMai, isVehModMngtGlbSafe1CarModSubtypWdCarModSubtyp], system-signal-group=VehModMngtGlbSafe1
    igVin: i-signal=[isVinBlockNr, isVinVINSignalPos4, isVinVINSignalPos1, isVinVINSignalPos3, isVinVINSignalPos7, isVinVINSignalPos6, isVinVINSignalPos5, isVinVINSignalPos2], system-signal-group=Vin
    igVehTiAndData: i-signal=[isVehTiAndDataMins1, isVehTiAndDataDataValid, isVehTiAndDataSec1, isVehTiAndDataYr1, isVehTiAndDataMth1, isVehTiAndDataDay, isVehTiAndDataHr1], system-signal-group=VehTiAndData
    igTrsmActrPosnSafe: i-signal=[isTrsmActrPosnSafeTrsmActrPosnChks, isTrsmActrPosnSafeTrsmActrPosnCntr, isTrsmActrPosnSafeTrsmActrPosn], system-signal-group=TrsmActrPosnSafe
package /Communication/ISignalPduGroup
  8 x i signal i pdu group:
    RxMPG_ZCUD_CAN1: communication-direction=IN, communication-mode=rx, contained-i-signal-i-pdu-group=[RxSPG_ZCUD_CAN1, RxSPG_ZCUD_CAN1_PNC29]
    RxSPG_ZCUD_CAN1: communication-direction=IN, communication-mode=rx
      i-signal-i-pdus:
        ZCUDZCUDCAN1SignalIPdu81
        ZCUDZCUDCAN1SignalIPdu80
        ZCUDZCUDCAN1SignalIPDU60
        ZCUDZCUDCAN1SignalIPDU43
        ZCUDZCUDCAN1SignalIPDU34
        ZCUDZCUDCAN1SignalIPDU33
        ZCUDZCUDCAN1SignalIPDU05
        ZCUDZCUDCAN1SignalIPDU04
        ZCUDZCUDCAN1SignalIPDU02
        ETCZCUDCAN1DevSignalPdu01
    RxSPG_ZCUD_CAN1_PNC29: communication-direction=IN, communication-mode=rx
      i-signal-i-pdus:
        ZCUDZCUDCAN1SignalIPdu97
        ZCUDZCUDCAN1SignalIPdu96
        ZCUDZCUDCAN1SignalIPDU76
        ZCUDZCUDCAN1SignalIPDU70
        ZCUDZCUDCAN1SignalIPDU69
        ZCUDZCUDCAN1SignalIPDU57
        ZCUDZCUDCAN1SignalIPDU56
        ZCUDZCUDCAN1SignalIPDU50
        ZCUDZCUDCAN1SignalIPDU49
        ZCUDZCUDCAN1SignalIPDU48
        ZCUDZCUDCAN1SignalIPDU47
        ZCUDZCUDCAN1SignalIPDU46
        ZCUDZCUDCAN1SignalIPDU45
        ZCUDZCUDCAN1SignalIPDU40
        ZCUDZCUDCAN1SignalIPDU39
        ZCUDZCUDCAN1SignalIPDU37
        ZCUDZCUDCAN1SignalIPDU36
        ZCUDZCUDCAN1SignalIPDU32
        ZCUDZCUDCAN1SignalIPDU31
        ZCUDZCUDCAN1SignalIPDU30
        ZCUDZCUDCAN1SignalIPDU29
        ZCUDZCUDCAN1SignalIPDU27
        ZCUDZCUDCAN1SignalIPDU26
        ZCUDZCUDCAN1SignalIPDU25
        ZCUDZCUDCAN1SignalIPDU24
        ZCUDZCUDCAN1SignalIPDU23
        ZCUDZCUDCAN1SignalIPDU22
        ZCUDZCUDCAN1SignalIPDU21
        ZCUDZCUDCAN1SignalIPDU20
        ZCUDZCUDCAN1SignalIPDU19
        ZCUDZCUDCAN1SignalIPDU18
        ZCUDZCUDCAN1SignalIPDU14
        ZCUDZCUDCAN1SignalIPDU13
        ZCUDZCUDCAN1SignalIPDU12
        ZCUDZCUDCAN1SignalIPDU11
        ZCUDZCUDCAN1SignalIPDU10
        ZCUDZCUDCAN1SignalIPDU09
        ZCUDZCUDCAN1SignalIPDU06
        ZCUDZCUDCAN1SignalIPDU03
        ZCUDZCUDCAN1SignalIPDU01
        RmrZcudCAN1SignalIPdu01
        RmlZcudCAN1SignalIPdu01
    TxMPG_ZCUD_CAN1: communication-direction=OUT, communication-mode=tx, contained-i-signal-i-pdu-group=TxSPG_ZCUD_CAN1
    TxSPG_ZCUD_CAN1: communication-direction=OUT, communication-mode=tx
      i-signal-i-pdus:
        SrsZCUDCAN1VFCVectorSignalIPdu
        SrsZCUDCAN1SignalPdu14
        SrsZCUDCAN1SignalPdu12
        SrsZCUDCAN1SignalPdu11
        SrsZCUDCAN1SignalPdu10
        SrsZCUDCAN1SignalPdu09
        SrsZCUDCAN1SignalPdu08
        SrsZCUDCAN1SignalPdu07
        SrsZCUDCAN1SignalPdu06
        SrsZCUDCAN1SignalPdu05
        SrsZCUDCAN1SignalPdu04
        SrsZCUDCAN1SignalPdu03
        SrsZCUDCAN1SignalPdu02
        SrsZCUDCAN1SignalPdu01
        SrsZCUDCAN1SignalIPdu15
        SrsZCUDCAN1DevSignalPdu01
    TxMPG_ZCUD_CANFD3: communication-direction=OUT, communication-mode=tx, contained-i-signal-i-pdu-group=[TxSPG_ZCUD_CANFD3, TxSPG_ZCUD_CANFD3_PNC29]
    TxSPG_ZCUD_CANFD3: communication-direction=OUT, communication-mode=tx, i-signal-i-pdus=[SrsZCUDCANFD3VFCVectorSignalIPdu, SrsZCUDCANFD3SignalIPdu03, SrsZCUDCANFD3SignalIPdu01]
    TxSPG_ZCUD_CANFD3_PNC29: communication-direction=OUT, communication-mode=tx, i-signal-i-pdus=SrsZCUDCANFD3SignalIPdu02
package /Communication/TpConfig
  can tp config ISO26021ZCUDCan1TpConfig1: communication-cluster=ZCUD_CAN1, can-tp-ecu{cycle-time-main-function=0.005, ecu-instance=SRS3}
    can tp address ZcudISO26021ZCUDCAN1TpAddr: tp-address=128
    can tp address SrsISO26021ZCUDCan1TpAddr: tp-address=241
    can tp channel ZcudToSrsISO26021ZCUDCAN1Cha: channel-id=0, channel-mode=HALF-DUPLEX-MODE
    tp-connections:
      addressing-format=STANDARD, can-tp-channel=ZcudToSrsISO26021ZCUDCAN1Cha, cancellation=false, data-pdu=ZcudToSrsISO26021ZCUDCan1ReqNpdu11, flow-control-pdu=SrsToZcudISO26021ZCUDCan1ResNpdu11, max-block-size=0, padding-activation=true, receiver=SrsISO26021ZCUDCan1TpNode, ta-type=PHYSICAL, timeout-br=1.0, timeout-bs=1.0, timeout-cr=1.0, timeout-cs=0.02, tp-sdu=EtcToSrsISO26021DiagDcmIpdu11, transmit-cancellation=false, transmitter=ZcudISO26021ZCUDCan1TpNode
      addressing-format=STANDARD, can-tp-channel=ZcudToSrsISO26021ZCUDCAN1Cha, cancellation=false, data-pdu=SrsToZcudISO26021ZCUDCan1ResNpdu11, flow-control-pdu=ZcudToSrsISO26021ZCUDCan1ReqNpdu11, max-block-size=0, padding-activation=true, receiver=ZcudISO26021ZCUDCan1TpNode, ta-type=PHYSICAL, timeout-br=1.0, timeout-bs=1.0, timeout-cr=1.0, timeout-cs=0.02, tp-sdu=SrsToEtcISO26021DiagDcmIpdu11, transmit-cancellation=false, transmitter=SrsISO26021ZCUDCan1TpNode
    can tp node SrsISO26021ZCUDCan1TpNode: connector=ZCUD_CAN1_SRS3, max-fc-wait=255, st-min=0.005, timeout-ar=1.0, timeout-as=1.0, tp-address=SrsISO26021ZCUDCan1TpAddr
    can tp node ZcudISO26021ZCUDCan1TpNode: max-fc-wait=255, st-min=0.005, timeout-ar=1.0, timeout-as=1.0, tp-address=ZcudISO26021ZCUDCAN1TpAddr
  can tp config ZcudCan1TpConfig: communication-cluster=ZCUD_CAN1, can-tp-ecu{cycle-time-main-function=0.005, ecu-instance=SRS3}
    20 x can tp address:
      SdlZCUDCan1TpAddr: tp-address=35
      SdrZCUDCan1TpAddr: tp-address=36
      SrsZCUDCan1TpAddr: tp-address=57
      RmrZCUDCan1TpAddr: tp-address=17
      CmdZCUDCan1TpAddr: tp-address=28
      HrmZCUDCan1TpAddr: tp-address=48
      EtcZCUDCan1TpAddr: tp-address=128
      RmlZCUDCan1TpAddr: tp-address=16
      CrpmZCUDCan1TpAddr: tp-address=38
      PotZCUDCan1TpAddr: tp-address=21
      WprlZCUDCan1TpAddr: tp-address=54
      SmbrZCUDCan1TpAddr: tp-address=50
      WpcZCUDCan1TpAddr: tp-address=43
      OGMZCUDCan1TpAddr: tp-address=60
      ZcudToAllZCUDCan1TpAddr: tp-address=255
      TrmZCUDCan1TpAddr: tp-address=23
      SmbZCUDCan1TpAddr: tp-address=41
      SmblZCUDCan1TpAddr: tp-address=49
      TcmbZCUDCan1TpAddr: tp-address=42
      WprrZCUDCan1TpAddr: tp-address=55
    can tp channel ZcudToAllFuncZcudCan1DiagCha: channel-id=255, channel-mode=HALF-DUPLEX-MODE
    can tp channel ZcudSrsZCUDCan1DiagCha: channel-id=1, channel-mode=HALF-DUPLEX-MODE
    tp-connections:
      addressing-format=STANDARD, can-tp-channel=ZcudToAllFuncZcudCan1DiagCha, cancellation=false, data-pdu=ZcudToAllFuncZcudCAN1DiagReqNpdu, max-block-size=0, multicast=ZcudToAllZCUDCan1TpAddr, padding-activation=true, receiver=[PotZCUDCan1TpNode, WprrZCUDCan1TpNode, RmrZCUDCan1TpNode, TrmZCUDCan1TpNode, CmdZCUDCan1TpNode, SrsZCUDCan1TpNode, HrmZCUDCan1TpNode, CrpmZCUDCan1TpNode, OGMZCUDCan1TpNode, SdrZCUDCan1TpNode, RmlZCUDCan1TpNode, SmblZCUDCan1TpNode, WprlZCUDCan1TpNode, SmbrZCUDCan1TpNode, SdlZCUDCan1TpNode, WpcZCUDCan1TpNode, TcmbZCUDCan1TpNode, SmbZCUDCan1TpNode], ta-type=FUNCTIONAL, timeout-br=0.02, timeout-bs=1.0, timeout-cr=1.0, timeout-cs=0.02, tp-sdu=DhuToAllFuncDiagDcmIpdu, transmit-cancellation=false, transmitter=ZcudZCUDCan1TpNode
      addressing-format=STANDARD, can-tp-channel=ZcudSrsZCUDCan1DiagCha, cancellation=false, data-pdu=SrsToZcudZCUDCan1DiagResNpdu, flow-control-pdu=ZcudToSrsZCUDCan1DiagReqNpdu, max-block-size=0, padding-activation=true, receiver=ZcudZCUDCan1TpNode, ta-type=PHYSICAL, timeout-br=0.02, timeout-bs=1.0, timeout-cr=1.0, timeout-cs=0.02, tp-sdu=SrsToDhuDiagDcmIpdu, transmit-cancellation=false, transmitter=SrsZCUDCan1TpNode
      addressing-format=STANDARD, can-tp-channel=ZcudSrsZCUDCan1DiagCha, cancellation=false, data-pdu=ZcudToSrsZCUDCan1DiagReqNpdu, flow-control-pdu=SrsToZcudZCUDCan1DiagResNpdu, max-block-size=0, padding-activation=true, receiver=SrsZCUDCan1TpNode, ta-type=PHYSICAL, timeout-br=0.02, timeout-bs=1.0, timeout-cr=1.0, timeout-cs=0.02, tp-sdu=DhuToSrsDiagDcmIpdu, transmit-cancellation=false, transmitter=ZcudZCUDCan1TpNode
    19 x can tp node, all with max-fc-wait=255, st-min=0.005, timeout-ar=1.0, timeout-as=1.0:
      PotZCUDCan1TpNode: tp-address=PotZCUDCan1TpAddr
      WprrZCUDCan1TpNode: tp-address=WprrZCUDCan1TpAddr
      RmrZCUDCan1TpNode: tp-address=RmrZCUDCan1TpAddr
      TrmZCUDCan1TpNode: tp-address=TrmZCUDCan1TpAddr
      CmdZCUDCan1TpNode: tp-address=CmdZCUDCan1TpAddr
      SrsZCUDCan1TpNode: connector=ZCUD_CAN1_SRS3, tp-address=SrsZCUDCan1TpAddr
      HrmZCUDCan1TpNode: tp-address=HrmZCUDCan1TpAddr
      CrpmZCUDCan1TpNode: tp-address=CrpmZCUDCan1TpAddr
      OGMZCUDCan1TpNode: tp-address=OGMZCUDCan1TpAddr
      SdrZCUDCan1TpNode: tp-address=SdrZCUDCan1TpAddr
      RmlZCUDCan1TpNode: tp-address=RmlZCUDCan1TpAddr
      SmblZCUDCan1TpNode: tp-address=SmblZCUDCan1TpAddr
      WprlZCUDCan1TpNode: tp-address=WprlZCUDCan1TpAddr
      SmbrZCUDCan1TpNode: tp-address=SmbrZCUDCan1TpAddr
      SdlZCUDCan1TpNode: tp-address=SdlZCUDCan1TpAddr
      WpcZCUDCan1TpNode: tp-address=WpcZCUDCan1TpAddr
      TcmbZCUDCan1TpNode: tp-address=TcmbZCUDCan1TpAddr
      SmbZCUDCan1TpNode: tp-address=SmbZCUDCan1TpAddr
      ZcudZCUDCan1TpNode: tp-address=EtcZCUDCan1TpAddr
