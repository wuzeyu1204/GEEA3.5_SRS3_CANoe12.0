/*@!Encoding:1252*/

/*
 * Initial generated-rule framework derived from Config/E2E_Rules_Manifest.json.
 * Do not add application behavior to this file.
 */

variables
{
  const int E2E_TX_PDU_COUNT = 5;

  const int E2E_TX_VEH_MTN_ST = 0;
  const int E2E_TX_PRE_CRASH_FRONT_DATA = 1;
  const int E2E_TX_VEH_SPD_LGT = 2;
  const int E2E_TX_VEH_MOD_MNGT_GLB_SAFE1 = 3;
  const int E2E_TX_PASS_AIRB_LAMP_STS_REC = 4;

  byte gE2E_TxCounter[5] = {0, 0, 0, 0, 0};
}

int E2E_RuleStringEquals(char left[], char right[])
{
  int index;

  index = 0;
  while (1)
  {
    if (left[index] != right[index])
    {
      return 0;
    }
    if (left[index] == 0)
    {
      return 1;
    }
    index++;
  }
}

int E2E_FindTxPdu(char pduName[])
{
  if (E2E_RuleStringEquals(pduName, "ZCUDZCUDCAN1SignalIPDU01")) return E2E_TX_VEH_MTN_ST;
  if (E2E_RuleStringEquals(pduName, "ZCUDZCUDCAN1SignalIPDU47")) return E2E_TX_PRE_CRASH_FRONT_DATA;
  if (E2E_RuleStringEquals(pduName, "ZCUDZCUDCAN1SignalIPDU37")) return E2E_TX_VEH_SPD_LGT;
  if (E2E_RuleStringEquals(pduName, "ZCUDZCUDCAN1SignalIPDU04")) return E2E_TX_VEH_MOD_MNGT_GLB_SAFE1;
  if (E2E_RuleStringEquals(pduName, "ZCUDZCUDCAN1SignalIPDU10")) return E2E_TX_PASS_AIRB_LAMP_STS_REC;
  return -1;
}

dword E2E_GetTxDataId(int pduIndex)
{
  switch (pduIndex)
  {
    case E2E_TX_VEH_MTN_ST: return 0x0036;
    case E2E_TX_PRE_CRASH_FRONT_DATA: return 0x0411;
    case E2E_TX_VEH_SPD_LGT: return 0x0037;
    case E2E_TX_VEH_MOD_MNGT_GLB_SAFE1: return 0x0074;
    case E2E_TX_PASS_AIRB_LAMP_STS_REC: return 0x0474;
  }

  return 0;
}

int E2E_GetTxDlc(int pduIndex)
{
  if ((pduIndex >= 0) && (pduIndex < E2E_TX_PDU_COUNT))
  {
    return 8;
  }
  return 0;
}

int E2E_GetTxSignalCount(int pduIndex)
{
  switch (pduIndex)
  {
    case E2E_TX_VEH_MTN_ST: return 1;
    case E2E_TX_PRE_CRASH_FRONT_DATA: return 4;
    case E2E_TX_VEH_SPD_LGT: return 2;
    case E2E_TX_VEH_MOD_MNGT_GLB_SAFE1: return 8;
    case E2E_TX_PASS_AIRB_LAMP_STS_REC: return 1;
  }
  return 0;
}

int E2E_GetTxSignalStartBit(int pduIndex, int signalIndex)
{
  if (pduIndex == E2E_TX_VEH_MTN_ST)
  {
    if (signalIndex == 0) return 2;
  }
  else if (pduIndex == E2E_TX_PRE_CRASH_FRONT_DATA)
  {
    if (signalIndex == 0) return 31;
    if (signalIndex == 1) return 43;
    if (signalIndex == 2) return 15;
    if (signalIndex == 3) return 39;
  }
  else if (pduIndex == E2E_TX_VEH_SPD_LGT)
  {
    if (signalIndex == 0) return 22;
    if (signalIndex == 1) return 43;
  }
  else if (pduIndex == E2E_TX_VEH_MOD_MNGT_GLB_SAFE1)
  {
    if (signalIndex == 0) return 2;
    if (signalIndex == 1) return 5;
    if (signalIndex == 2) return 27;
    if (signalIndex == 3) return 31;
    if (signalIndex == 4) return 6;
    if (signalIndex == 5) return 19;
    if (signalIndex == 6) return 23;
    if (signalIndex == 7) return 11;
  }
  else if (pduIndex == E2E_TX_PASS_AIRB_LAMP_STS_REC)
  {
    if (signalIndex == 0) return 45;
  }
  return -1;
}

int E2E_GetTxSignalBitLength(int pduIndex, int signalIndex)
{
  if (pduIndex == E2E_TX_VEH_MTN_ST)
  {
    if (signalIndex == 0) return 3;
    return 0;
  }
  if (pduIndex == E2E_TX_PRE_CRASH_FRONT_DATA)
  {
    if (signalIndex == 0) return 8;
    if (signalIndex == 1) return 3;
    if (signalIndex == 2) return 8;
    if (signalIndex == 3) return 8;
  }
  if (pduIndex == E2E_TX_VEH_SPD_LGT)
  {
    if (signalIndex == 0) return 15;
    if (signalIndex == 1) return 2;
  }
  if (pduIndex == E2E_TX_VEH_MOD_MNGT_GLB_SAFE1)
  {
    if ((signalIndex >= 0) && (signalIndex < 8))
    {
      if (signalIndex == 0) return 3;
      if (signalIndex == 1) return 3;
      if (signalIndex == 4) return 1;
      return 4;
    }
  }
  if (pduIndex == E2E_TX_PASS_AIRB_LAMP_STS_REC)
  {
    if (signalIndex == 0) return 2;
    return 0;
  }
  return 0;
}

int E2E_GetTxCrcStartBit(int pduIndex)
{
  switch (pduIndex)
  {
    case E2E_TX_VEH_MTN_ST: return 15;
    case E2E_TX_PRE_CRASH_FRONT_DATA: return 23;
    case E2E_TX_VEH_SPD_LGT: return 39;
    case E2E_TX_VEH_MOD_MNGT_GLB_SAFE1: return 39;
    case E2E_TX_PASS_AIRB_LAMP_STS_REC: return 55;
  }
  return -1;
}

int E2E_GetTxCounterStartBit(int pduIndex)
{
  switch (pduIndex)
  {
    case E2E_TX_VEH_MTN_ST: return 6;
    case E2E_TX_PRE_CRASH_FRONT_DATA: return 47;
    case E2E_TX_VEH_SPD_LGT: return 47;
    case E2E_TX_VEH_MOD_MNGT_GLB_SAFE1: return 15;
    case E2E_TX_PASS_AIRB_LAMP_STS_REC: return 43;
  }
  return -1;
}

int E2E_GetTxUbStartBit(int pduIndex)
{
  switch (pduIndex)
  {
    case E2E_TX_VEH_MTN_ST: return 7;
    case E2E_TX_PRE_CRASH_FRONT_DATA: return 40;
    case E2E_TX_VEH_SPD_LGT: return 23;
    case E2E_TX_VEH_MOD_MNGT_GLB_SAFE1: return 7;
    case E2E_TX_PASS_AIRB_LAMP_STS_REC: return 63;
  }
  return -1;
}

void E2E_ResetTxCounters()
{
  int pduIndex;

  for (pduIndex = 0; pduIndex < E2E_TX_PDU_COUNT; pduIndex++)
  {
    gE2E_TxCounter[pduIndex] = 0;
  }
}
