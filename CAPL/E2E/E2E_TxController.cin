/*@!Encoding:1252*/

/* PDU-IL TxPending in-place adapter for five protected SRS3 PDUs.
 * PDU IG is the only producer and scheduler. This module never creates a Tx
 * event: it either updates the pending payload and returns 1, or suppresses
 * that same event and returns 0. */

variables
{
  const int E2E_TX_B_PROTOCOL = 0;
  const int E2E_TX_B_SELECTED_PDU = 1;
  const int E2E_TX_B_UB_COMMAND = 3;
  const int E2E_TX_B_PROTECT_COMMAND = 4;
  const int E2E_TX_B_CONFIG_COMMAND = 6;
  const int E2E_TX_B_STATE = 8;
  const int E2E_TX_B_COUNTER = 9;
  const int E2E_TX_B_DATA_ID = 10;
  const int E2E_TX_B_CRC_CALC = 11;
  const int E2E_TX_B_CRC_TX = 12;
  const int E2E_TX_B_UB = 13;
  const int E2E_TX_B_INPUT_RAW = 14;
  const int E2E_TX_B_FINAL_RAW = 22;
  const int E2E_TX_B_PROTECTED_FRAMES = 30;
  const int E2E_TX_B_BRIDGE_ACTIVE = 31;
  const int E2E_TX_B_PROTECT_BASE = 32;
  const int E2E_TX_B_UB_BASE = 37;
  const int E2E_TX_B_STATE_BASE = 42;
  const int E2E_TX_B_COUNT_BASE = 47;

  int gE2E_PanelUbMode[5] = {0, 0, 0, 0, 0};
  int gE2E_PanelProtectMode[5] = {1, 1, 1, 1, 1};
  int gE2E_LastState[5] = {0, 0, 0, 0, 0};
  int gE2E_LastCounter[5] = {0, 0, 0, 0, 0};
  int gE2E_LastCrcCalc[5] = {0, 0, 0, 0, 0};
  int gE2E_LastCrcTx[5] = {0, 0, 0, 0, 0};
  int gE2E_LastUb[5] = {0, 0, 0, 0, 0};
  dword gE2E_ProtectedFrames[5] = {0, 0, 0, 0, 0};
  dword gE2E_InputPayload[40];
  dword gE2E_FinalPayload[40];
  int gE2E_BridgeActive = 0;
  int gE2E_LastSelectedPdu = -1;
}

int E2E_BridgeSelectedPdu()
{
  int pduIndex;

  pduIndex = @sysvar::SRS3_E2E::WpfBridge::PanelBridge[E2E_TX_B_SELECTED_PDU];
  if ((pduIndex < 0) || (pduIndex >= E2E_TX_PDU_COUNT)) return 0;
  return pduIndex;
}

void E2E_BridgePublishControlState()
{
  int pduIndex;

  @sysvar::SRS3_E2E::WpfBridge::PanelBridge[E2E_TX_B_PROTOCOL] = 2;
  @sysvar::SRS3_E2E::WpfBridge::PanelBridge[E2E_TX_B_BRIDGE_ACTIVE] = gE2E_BridgeActive;
  for (pduIndex = 0; pduIndex < E2E_TX_PDU_COUNT; pduIndex++)
  {
    @sysvar::SRS3_E2E::WpfBridge::PanelBridge[E2E_TX_B_PROTECT_BASE + pduIndex] = gE2E_PanelProtectMode[pduIndex];
    @sysvar::SRS3_E2E::WpfBridge::PanelBridge[E2E_TX_B_UB_BASE + pduIndex] = gE2E_PanelUbMode[pduIndex];
    @sysvar::SRS3_E2E::WpfBridge::PanelBridge[E2E_TX_B_STATE_BASE + pduIndex] = gE2E_LastState[pduIndex];
    @sysvar::SRS3_E2E::WpfBridge::PanelBridge[E2E_TX_B_COUNT_BASE + pduIndex] = gE2E_ProtectedFrames[pduIndex];
  }
}

void E2E_BridgePublishSelectedTelemetry(int pduIndex)
{
  int byteIndex;

  if ((pduIndex < 0) || (pduIndex >= E2E_TX_PDU_COUNT)) return;
  @sysvar::SRS3_E2E::WpfBridge::PanelBridge[E2E_TX_B_STATE] = gE2E_LastState[pduIndex];
  @sysvar::SRS3_E2E::WpfBridge::PanelBridge[E2E_TX_B_COUNTER] = gE2E_LastCounter[pduIndex];
  @sysvar::SRS3_E2E::WpfBridge::PanelBridge[E2E_TX_B_DATA_ID] = E2E_GetTxDataId(pduIndex);
  @sysvar::SRS3_E2E::WpfBridge::PanelBridge[E2E_TX_B_CRC_CALC] = gE2E_LastCrcCalc[pduIndex];
  @sysvar::SRS3_E2E::WpfBridge::PanelBridge[E2E_TX_B_CRC_TX] = gE2E_LastCrcTx[pduIndex];
  @sysvar::SRS3_E2E::WpfBridge::PanelBridge[E2E_TX_B_UB] = gE2E_LastUb[pduIndex];
  @sysvar::SRS3_E2E::WpfBridge::PanelBridge[E2E_TX_B_PROTECTED_FRAMES] = gE2E_ProtectedFrames[pduIndex];
  for (byteIndex = 0; byteIndex < 8; byteIndex++)
  {
    @sysvar::SRS3_E2E::WpfBridge::PanelBridge[E2E_TX_B_INPUT_RAW + byteIndex] = gE2E_InputPayload[(pduIndex * 8) + byteIndex];
    @sysvar::SRS3_E2E::WpfBridge::PanelBridge[E2E_TX_B_FINAL_RAW + byteIndex] = gE2E_FinalPayload[(pduIndex * 8) + byteIndex];
  }
}

void E2E_BridgeSynchronizeSelection()
{
  int pduIndex;

  pduIndex = E2E_BridgeSelectedPdu();
  if (pduIndex == gE2E_LastSelectedPdu) return;
  gE2E_LastSelectedPdu = pduIndex;
  E2E_BridgePublishSelectedTelemetry(pduIndex);
  E2E_FaultPublishState();
}

void E2E_BridgePollConfiguration()
{
  int command;
  int pduIndex;
  int ubMode;

  E2E_BridgeSynchronizeSelection();
  command = @sysvar::SRS3_E2E::WpfBridge::PanelBridge[E2E_TX_B_CONFIG_COMMAND];
  if (command != 1)
  {
    E2E_BridgePublishControlState();
    return;
  }

  pduIndex = E2E_BridgeSelectedPdu();
  ubMode = @sysvar::SRS3_E2E::WpfBridge::PanelBridge[E2E_TX_B_UB_COMMAND];
  if ((ubMode >= 0) && (ubMode <= 2))
  {
    gE2E_PanelUbMode[pduIndex] = ubMode;
    gE2E_PanelProtectMode[pduIndex] =
      @sysvar::SRS3_E2E::WpfBridge::PanelBridge[E2E_TX_B_PROTECT_COMMAND] != 0;
    gE2E_LastState[pduIndex] = 0;
  }
  @sysvar::SRS3_E2E::WpfBridge::PanelBridge[E2E_TX_B_CONFIG_COMMAND] = 0;
  E2E_BridgePublishControlState();
  E2E_BridgePublishSelectedTelemetry(pduIndex);
}

void E2E_StoreInputPayload(int pduIndex, byte data[])
{
  int byteIndex;

  for (byteIndex = 0; byteIndex < 8; byteIndex++)
  {
    gE2E_InputPayload[(pduIndex * 8) + byteIndex] = data[byteIndex];
  }
}

void E2E_StoreFinalPayload(int pduIndex, byte data[])
{
  int byteIndex;

  for (byteIndex = 0; byteIndex < 8; byteIndex++)
  {
    gE2E_FinalPayload[(pduIndex * 8) + byteIndex] = data[byteIndex];
  }
}

void E2E_RecordFrame(int pduIndex, int state, int counter, int crcCalc, int crcTx, int ub, byte data[])
{
  gE2E_LastState[pduIndex] = state;
  gE2E_LastCounter[pduIndex] = counter;
  gE2E_LastCrcCalc[pduIndex] = crcCalc;
  gE2E_LastCrcTx[pduIndex] = crcTx;
  gE2E_LastUb[pduIndex] = ub;
  E2E_StoreFinalPayload(pduIndex, data);
  E2E_BridgePublishControlState();
  if (pduIndex == E2E_BridgeSelectedPdu()) E2E_BridgePublishSelectedTelemetry(pduIndex);
}

int E2E_ReadApplicationRaw(int pduIndex, byte data[], int payloadLength, dword rawValues[])
{
  int signalIndex;

  for (signalIndex = 0; signalIndex < E2E_GetTxSignalCount(pduIndex); signalIndex++)
  {
    if (!E2E_GetMotorolaRaw(data, payloadLength,
      E2E_GetTxSignalStartBit(pduIndex, signalIndex),
      E2E_GetTxSignalBitLength(pduIndex, signalIndex), rawValues[signalIndex])) return 0;
  }
  return 1;
}

int E2E_BuildLogicalApplicationData(int pduIndex, dword rawValues[], byte applicationData[])
{
  int signalIndex;
  int byteIndex;
  int byteCount;
  int outputIndex;
  dword rawValue;

  outputIndex = 0;
  for (signalIndex = 0; signalIndex < E2E_GetTxSignalCount(pduIndex); signalIndex++)
  {
    rawValue = rawValues[signalIndex];
    byteCount = (E2E_GetTxSignalBitLength(pduIndex, signalIndex) + 7) / 8;
    for (byteIndex = 0; byteIndex < byteCount; byteIndex++)
    {
      applicationData[outputIndex] = (rawValue >> (8 * byteIndex)) & 0xFF;
      outputIndex++;
    }
  }
  return outputIndex;
}

int E2E_ResolveUpdateBit(int pduIndex)
{
  if (gE2E_PanelUbMode[pduIndex] == 1) return 0;
  if (gE2E_PanelUbMode[pduIndex] == 2) return 1;
  return 1;
}

void E2E_TxInitialize()
{
  int pduIndex;
  int rawIndex;

  gE2E_BridgeActive = 1;
  E2E_ResetTxCounters();
  for (pduIndex = 0; pduIndex < E2E_TX_PDU_COUNT; pduIndex++)
  {
    gE2E_PanelUbMode[pduIndex] = 0;
    gE2E_PanelProtectMode[pduIndex] = 1;
    gE2E_LastState[pduIndex] = 0;
    gE2E_LastCounter[pduIndex] = 0;
    gE2E_LastCrcCalc[pduIndex] = 0;
    gE2E_LastCrcTx[pduIndex] = 0;
    gE2E_LastUb[pduIndex] = 0;
    gE2E_ProtectedFrames[pduIndex] = 0;
  }
  for (rawIndex = 0; rawIndex < 40; rawIndex++)
  {
    gE2E_InputPayload[rawIndex] = 0;
    gE2E_FinalPayload[rawIndex] = 0;
  }
  @sysvar::SRS3_E2E::WpfBridge::PanelBridge[E2E_TX_B_CONFIG_COMMAND] = 0;
  gE2E_LastSelectedPdu = E2E_BridgeSelectedPdu();
  E2E_BridgePublishControlState();
  E2E_BridgePublishSelectedTelemetry(gE2E_LastSelectedPdu);
  E2E_ResetFaults();
}

void E2E_TxShutdown()
{
  gE2E_BridgeActive = 0;
  @sysvar::SRS3_E2E::WpfBridge::PanelBridge[E2E_TX_B_CONFIG_COMMAND] = 0;
  E2E_BridgePublishControlState();
}

dword E2E_TxProcess(char pduName[], dword payloadLength, byte data[])
{
  int pduIndex;
  int logicalLength;
  int updateBit;
  int faultType;
  int permitEvent;
  int state;
  byte counter;
  byte crcCalculated;
  byte crcTransmitted;
  dword rawCounter;
  dword rawCrc;
  dword rawUb;
  dword parameter;
  dword crcDataId;
  byte logicalData[16];
  dword rawValues[8];

  E2E_BridgePollConfiguration();
  pduIndex = E2E_FindTxPdu(pduName);
  if (pduIndex < 0) return 1;
  if (payloadLength < E2E_GetTxDlc(pduIndex))
  {
    gE2E_LastState[pduIndex] = 3;
    E2E_BridgePublishControlState();
    return 0;
  }

  E2E_StoreInputPayload(pduIndex, data);
  E2E_FaultPollCommand(pduIndex);
  E2E_FaultBeginEvent(pduIndex);
  faultType = E2E_FaultGetType(pduIndex);

  if (!gE2E_PanelProtectMode[pduIndex])
  {
    rawCounter = 0;
    rawCrc = 0;
    rawUb = 0;
    E2E_GetMotorolaRaw(data, payloadLength, E2E_GetTxCounterStartBit(pduIndex), 4, rawCounter);
    E2E_GetMotorolaRaw(data, payloadLength, E2E_GetTxCrcStartBit(pduIndex), 8, rawCrc);
    E2E_GetMotorolaRaw(data, payloadLength, E2E_GetTxUbStartBit(pduIndex), 1, rawUb);
    crcCalculated = rawCrc;
    permitEvent = 1;
    if ((faultType == E2E_FAULT_CORRUPT_CRC) ||
        (faultType == E2E_FAULT_CORRUPT_PAYLOAD) ||
        (faultType == E2E_FAULT_STOP_TX))
    {
      permitEvent = E2E_ApplyPostProtectFault(pduIndex, data, payloadLength);
    }
    E2E_GetMotorolaRaw(data, payloadLength, E2E_GetTxCrcStartBit(pduIndex), 8, rawCrc);
    state = permitEvent ? (E2E_FaultAppliedThisEvent(pduIndex) ? 7 : 6) : 8;
    E2E_RecordFrame(pduIndex, state, rawCounter, crcCalculated, rawCrc, rawUb, data);
    return permitEvent;
  }

  if (!E2E_ReadApplicationRaw(pduIndex, data, payloadLength, rawValues))
  {
    E2E_RecordFrame(pduIndex, 3, 0, 0, 0, 0, data);
    return 0;
  }

  counter = gE2E_TxCounter[pduIndex];
  parameter = E2E_FaultGetParameter(pduIndex);
  if (faultType == E2E_FAULT_COUNTER_15) counter = 15;
  else if (faultType == E2E_FAULT_COUNTER_JUMP)
  {
    if (parameter == 0) parameter = 1;
    counter = (counter + parameter) % 15;
  }

  updateBit = E2E_ResolveUpdateBit(pduIndex);
  if (faultType == E2E_FAULT_UB_ZERO) updateBit = 0;
  E2E_SetMotorolaRaw(data, payloadLength, E2E_GetTxUbStartBit(pduIndex), 1, updateBit);
  E2E_SetMotorolaRaw(data, payloadLength, E2E_GetTxCounterStartBit(pduIndex), 4, counter);

  logicalLength = E2E_BuildLogicalApplicationData(pduIndex, rawValues, logicalData);
  crcCalculated = E2E_ProfileGCalculate(E2E_GetTxDataId(pduIndex), counter, logicalData, logicalLength);
  crcDataId = E2E_GetTxDataId(pduIndex);
  if (faultType == E2E_FAULT_WRONG_DATA_ID)
  {
    if (parameter == 0) parameter = 1;
    crcDataId ^= parameter;
  }
  crcTransmitted = E2E_ProfileGCalculate(crcDataId, counter, logicalData, logicalLength);
  E2E_SetMotorolaRaw(data, payloadLength, E2E_GetTxCrcStartBit(pduIndex), 8, crcTransmitted);

  permitEvent = E2E_ApplyPostProtectFault(pduIndex, data, payloadLength);
  rawCrc = crcTransmitted;
  rawUb = updateBit;
  E2E_GetMotorolaRaw(data, payloadLength, E2E_GetTxCrcStartBit(pduIndex), 8, rawCrc);
  E2E_GetMotorolaRaw(data, payloadLength, E2E_GetTxUbStartBit(pduIndex), 1, rawUb);
  if (permitEvent) gE2E_ProtectedFrames[pduIndex]++;

  if (faultType != E2E_FAULT_FREEZE_COUNTER)
  {
    gE2E_TxCounter[pduIndex] = E2E_ProfileGNextCounter(counter);
  }

  state = permitEvent ? (E2E_FaultAppliedThisEvent(pduIndex) ? 7 : 1) : 8;
  E2E_RecordFrame(pduIndex, state, counter, crcCalculated, rawCrc, rawUb, data);
  return permitEvent;
}
