/*@!Encoding:1252*/

/* CANoe 12 provides enableControl() and setControlVisibility(). All controls
 * are created statically in Panel Designer; CAPL only switches their state. */

void E2E_PanelShowTxPdu(char panelName[], int selectedPdu)
{
  setControlVisibility(panelName, "grpVehMtnSt", selectedPdu == E2E_TX_VEH_MTN_ST);
  setControlVisibility(panelName, "grpPreCrashFrontData", selectedPdu == E2E_TX_PRE_CRASH_FRONT_DATA);
  setControlVisibility(panelName, "grpVehSpdLgt", selectedPdu == E2E_TX_VEH_SPD_LGT);
  setControlVisibility(panelName, "grpVehModMngtGlbSafe1", selectedPdu == E2E_TX_VEH_MOD_MNGT_GLB_SAFE1);
  setControlVisibility(panelName, "grpPassAirbLampStsRec", selectedPdu == E2E_TX_PASS_AIRB_LAMP_STS_REC);
}

void E2E_PanelEnableTxEditing(char panelName[], int enabled)
{
  enableControl(panelName, "btnApplyNextCycle", enabled);
  enableControl(panelName, "btnRestoreNormal", enabled);
  enableControl(panelName, "cmbOverrideMode", enabled);
  enableControl(panelName, "cmbUpdateBitMode", enabled);
}

