/*@!Encoding:1252*/

includes
{
  #include "..\CAPL\E2E\E2E_ProfileG_Core.cin"
  #include "..\CAPL\E2E\E2E_BitCodec.cin"
  #include "..\CAPL\E2E\Generated\E2E_RxRules_Generated.cin"
  #include "..\CAPL\E2E\E2E_RxMonitor.cin"
}

variables
{
  msTimer gE2E_RxWatchdog;
}

on preStart
{
  E2E_RxInitialize(1);
  write("[E2E-RX] CANFD3 checker ready: 5 protected groups, monitor only");
}

on start
{
  setTimer(gE2E_RxWatchdog, 10);
}

on message *
{
  int index;
  int payloadLength;
  byte payload[64];

  payloadLength = canGetDataLength(this);
  for (index = 0; index < 64; index++)
  {
    payload[index] = 0;
  }
  for (index = 0; (index < payloadLength) && (index < 64); index++)
  {
    payload[index] = this.byte(index);
  }
  E2E_RxProcessFrame(1, this.id, payloadLength, payload);
}

on timer gE2E_RxWatchdog
{
  E2E_RxTick(1, 10);
  setTimer(gE2E_RxWatchdog, 10);
}

on stopMeasurement
{
  cancelTimer(gE2E_RxWatchdog);
  E2E_RxSetReady(1, 0);
}
