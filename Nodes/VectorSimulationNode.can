/*@!Encoding:936*/
includes
{
  // Import required CAPL include files
  //--- begin generated part --- Block start #Hdr_Includes#; do not delete this line and do not add application code in this code block!
  /* #ChannelStart# |CAN1| #BusStart# |ZCUD_CAN1| */
  /* #ChannelEnd# |CAN1| #BusEnd# |ZCUD_CAN1| */
  //--- end generated part --- Block end #Hdr_Includes#; do not delete this line! Add application code below this line.
  //--- begin generated part --- Block start #Body_Includes#; do not delete this line and do not add application code in this code block!
  /* #ChannelStart# |CAN1| #BusStart# |ZCUD_CAN1| */
  // without NM: NM panel helper intentionally not used
  #include "..\CAPL\PDU-IL-KL15-Helper_CAN1.cin"
  /* #ChannelEnd# |CAN1| #BusEnd# |ZCUD_CAN1| */
  //--- end generated part --- Block end #Body_Includes#; do not delete this line! Add application code below this line.
  #include "..\CAPL\E2E\Generated\E2E_TxRules_Generated.cin"
  #include "..\CAPL\E2E\E2E_ProfileG_Core.cin"
  #include "..\CAPL\E2E\E2E_BitCodec.cin"
  #include "..\CAPL\E2E\E2E_FaultInjection.cin"
  #include "..\CAPL\E2E\E2E_TxController.cin"
}

variables
{
  // Define global variables for this CAPL file

  /*--- #GenHeader Begin# --- begin generated comment ---
  | Generated on Tuesday, ?? 11, 2026, 19:05:10
  | By ModelGenerator for Vector 1.0.0.4, ModelGeneratorVectorDLL 1.4.0.29
  | Package Vector 3.3.1
  | Target Bus: ZCUD_CAN1; Channel: CAN1; DB Cluster: ZCUD_CAN1;
  | From Database: SDB325300_SRS3_AR-4.2.2_251215_UnFlattened.arxml
  | CANoe Version 12.0.75.0
    --- #GenHeader End  # --- end generated comment --- */

  char gECU[256] = "VectorSimulationNode";
  //--- begin generated part --- Block start #Hdr_GlobalVariables#; do not delete this line and do not add application code in this code block!
  /* #ChannelStart# |CAN1| #BusStart# |ZCUD_CAN1| */
  /* #ChannelEnd# |CAN1| #BusEnd# |ZCUD_CAN1| */
  //--- end generated part --- Block end #Hdr_GlobalVariables#; do not delete this line! Add application code below this line.
  //--- begin generated part --- Block start #Body_GlobalVariables#; do not delete this line and do not add application code in this code block!
  /* #ChannelStart# |CAN1| #BusStart# |ZCUD_CAN1| */
  char gCAN1BusName[256] = "CAN";
  int gCAN1Channel = 1; //// The channel the bus is attached to

  long gCAN1DisturbanceMode;
  long gCAN1DisturbanceCount;
  long gCAN1DisturbanceValue;
  long gCAN1DisturbanceContinueMode;
  double gCAN1DisturbancePeriod;
  /* #ChannelEnd# |CAN1| #BusEnd# |ZCUD_CAN1| */
  //--- end generated part --- Block end #Body_GlobalVariables#; do not delete this line! Add application code below this line.
}

on preStart
{
  // Initialize CAPL includes and node's modules/DLLs
  //--- begin generated part --- Block start #Hdr_OnInit#; do not delete this line and do not add application code in this code block!
  /* #ChannelStart# |CAN1| #BusStart# |ZCUD_CAN1| */
  /* #ChannelEnd# |CAN1| #BusEnd# |ZCUD_CAN1| */
  //--- end generated part --- Block end #Hdr_OnInit#; do not delete this line! Add application code below this line.
  //--- begin generated part --- Block start #Body_OnInit#; do not delete this line and do not add application code in this code block!
  /* #ChannelStart# |CAN1| #BusStart# |ZCUD_CAN1| */
  ILCAN1_OnInit();
  /* #ChannelEnd# |CAN1| #BusEnd# |ZCUD_CAN1| */
  //--- end generated part --- Block end #Body_OnInit#; do not delete this line! Add application code below this line.
}

on start
{
  // Start CAPL includes and node's modules/DLLs
  //--- begin generated part --- Block start #Hdr_OnStart#; do not delete this line and do not add application code in this code block!
  /* #ChannelStart# |CAN1| #BusStart# |ZCUD_CAN1| */
  /* #ChannelEnd# |CAN1| #BusEnd# |ZCUD_CAN1| */
  //--- end generated part --- Block end #Hdr_OnStart#; do not delete this line! Add application code below this line.
  //--- begin generated part --- Block start #Body_OnStart#; do not delete this line and do not add application code in this code block!
  /* #ChannelStart# |CAN1| #BusStart# |ZCUD_CAN1| */
  ILCAN1_OnStart();
  /* #ChannelEnd# |CAN1| #BusEnd# |ZCUD_CAN1| */
  //--- end generated part --- Block end #Body_OnStart#; do not delete this line! Add application code below this line.
  E2E_TxInitialize();
}

on preStop
{
  E2E_TxShutdown();
  // Prepare stopping
  //--- begin generated part --- Block start #Hdr_OnStopping#; do not delete this line and do not add application code in this code block!
  /* #ChannelStart# |CAN1| #BusStart# |ZCUD_CAN1| */
  /* #ChannelEnd# |CAN1| #BusEnd# |ZCUD_CAN1| */
  //--- end generated part --- Block end #Hdr_OnStopping#; do not delete this line! Add application code below this line.
  //--- begin generated part --- Block start #Body_OnStopping#; do not delete this line and do not add application code in this code block!
  /* #ChannelStart# |CAN1| #BusStart# |ZCUD_CAN1| */
  /* #ChannelEnd# |CAN1| #BusEnd# |ZCUD_CAN1| */
  //--- end generated part --- Block end #Body_OnStopping#; do not delete this line! Add application code below this line.
}

on stopMeasurement
{
  // Stop actions
  //--- begin generated part --- Block start #Hdr_OnStop#; do not delete this line and do not add application code in this code block!
  /* #ChannelStart# |CAN1| #BusStart# |ZCUD_CAN1| */
  /* #ChannelEnd# |CAN1| #BusEnd# |ZCUD_CAN1| */
  //--- end generated part --- Block end #Hdr_OnStop#; do not delete this line! Add application code below this line.
  //--- begin generated part --- Block start #Body_OnStop#; do not delete this line and do not add application code in this code block!
  /* #ChannelStart# |CAN1| #BusStart# |ZCUD_CAN1| */
  /* #ChannelEnd# |CAN1| #BusEnd# |ZCUD_CAN1| */
  //--- end generated part --- Block end #Body_OnStop#; do not delete this line! Add application code below this line.
}

void StartSim(dword busContext, int busActive, int mode)
{
  // Called when ... due to ...
  //   mode == 1: ILControlResume
  //   mode == 2: ILControlStart
  //   mode == 3: ILControlSimulationOn
  //--- begin generated part --- Block start #Hdr_StartSim#; do not delete this line and do not add application code in this code block!
  /* #ChannelStart# |CAN1| #BusStart# |ZCUD_CAN1| */
  /* #ChannelEnd# |CAN1| #BusEnd# |ZCUD_CAN1| */
  //--- end generated part --- Block end #Hdr_StartSim#; do not delete this line! Add application code below this line.
  //write("[%.6f %NODE_NAME%] StartSim(0x%X, %d, %d)", TimeNowNS()/1e9, busContext, busActive, mode);
  //--- begin generated part --- Block start #Body_StartSim#; do not delete this line and do not add application code in this code block!
  /* #ChannelStart# |CAN1| #BusStart# |ZCUD_CAN1| */
  /* #ChannelEnd# |CAN1| #BusEnd# |ZCUD_CAN1| */
  //--- end generated part --- Block end #Body_StartSim#; do not delete this line! Add application code below this line.
}

void StopSim(dword busContext, int busActive, int mode)
{
  // Called when ... due to ...
  //   mode == 1: ILControlWait
  //   mode == 2: ILControlStop
  //   mode == 3: ILControlSimulationOff
  //--- begin generated part --- Block start #Hdr_StopSim#; do not delete this line and do not add application code in this code block!
  /* #ChannelStart# |CAN1| #BusStart# |ZCUD_CAN1| */
  /* #ChannelEnd# |CAN1| #BusEnd# |ZCUD_CAN1| */
  //--- end generated part --- Block end #Hdr_StopSim#; do not delete this line! Add application code below this line.
  //write("[%.6f %NODE_NAME%] StopSim(0x%X, %d, %d)", TimeNowNS()/1e9, busContext, busActive, mode);
  //--- begin generated part --- Block start #Body_StopSim#; do not delete this line and do not add application code in this code block!
  /* #ChannelStart# |CAN1| #BusStart# |ZCUD_CAN1| */
  /* #ChannelEnd# |CAN1| #BusEnd# |ZCUD_CAN1| */
  //--- end generated part --- Block end #Body_StopSim#; do not delete this line! Add application code below this line.
}

on sysvar_update sysvar::IL::Klemme15
{
  // Handle system state variable
  //--- begin generated part --- Block start #Hdr_KL15_Klemme15#; do not delete this line and do not add application code in this code block!
  /* #ChannelStart# |CAN1| #BusStart# |ZCUD_CAN1| */
  /* #ChannelEnd# |CAN1| #BusEnd# |ZCUD_CAN1| */
  //--- end generated part --- Block end #Hdr_KL15_Klemme15#; do not delete this line! Add application code below this line.
  //--- begin generated part --- Block start #Body_KL15_Klemme15#; do not delete this line and do not add application code in this code block!
  /* #ChannelStart# |CAN1| #BusStart# |ZCUD_CAN1| */
  ILCAN1_OnEnvKlemme15(@this);
  /* #ChannelEnd# |CAN1| #BusEnd# |ZCUD_CAN1| */
  //--- end generated part --- Block end #Body_KL15_Klemme15#; do not delete this line! Add application code below this line.
}

on sysvar_update sysvar::IL::Klemme30
{
  // Handle system state variable
  //--- begin generated part --- Block start #Hdr_KL30_Klemme30#; do not delete this line and do not add application code in this code block!
  /* #ChannelStart# |CAN1| #BusStart# |ZCUD_CAN1| */
  /* #ChannelEnd# |CAN1| #BusEnd# |ZCUD_CAN1| */
  //--- end generated part --- Block end #Hdr_KL30_Klemme30#; do not delete this line! Add application code below this line.
  //--- begin generated part --- Block start #Body_KL30_Klemme30#; do not delete this line and do not add application code in this code block!
  /* #ChannelStart# |CAN1| #BusStart# |ZCUD_CAN1| */
  ILCAN1_OnEnvKlemme30(@this);
  /* #ChannelEnd# |CAN1| #BusEnd# |ZCUD_CAN1| */
  //--- end generated part --- Block end #Body_KL30_Klemme30#; do not delete this line! Add application code below this line.
}

on sysvar_update sysvar::SRS3_E2E::Control::GlobalEnable
{
  E2E_BridgePublishControlState();
}

int E2E_StrEq(char a[], char b[])
{
  int i;

  i = 0;

  while (1)
  {
    if (a[i] != b[i])
    {
      return 0;
    }

    if (a[i] == 0)
    {
      return 1;
    }

    i++;
  }
}

dword applPDUILTxPending(dword busContext, dword shortId, dword longId, char name[], dword& aPDULength, byte data[])
{
  return E2E_TxProcess(name, aPDULength, data);
}

dword applPDUILStart(dword busContext, dword busActive, dword mode)
{
  dword ret = 1;
  //--- begin generated part --- Block start #Hdr_applPDUILStart#; do not delete this line and do not add application code in this code block!
  /* #ChannelStart# |CAN1| #BusStart# |ZCUD_CAN1| */
  /* #ChannelEnd# |CAN1| #BusEnd# |ZCUD_CAN1| */
  //--- end generated part --- Block end #Hdr_applPDUILStart#; do not delete this line! Add application code below this line.
  //write("[%.6f %NODE_NAME%] applPDUILStart(0x%X, %d, %d)", TimeNowNS()/1e9, busContext, busActive, mode);
  //--- begin generated part --- Block start #Body_applPDUILStart#; do not delete this line and do not add application code in this code block!
  /* #ChannelStart# |CAN1| #BusStart# |ZCUD_CAN1| */
  /* #ChannelEnd# |CAN1| #BusEnd# |ZCUD_CAN1| */
  //--- end generated part --- Block end #Body_applPDUILStart#; do not delete this line! Add application code below this line.
  //--- begin generated part --- Block start #Footer_applPDUILStart#; do not delete this line and do not add application code in this code block!
  /* #ChannelStart# |CAN1| #BusStart# |ZCUD_CAN1| */
  StartSim(busContext, busActive, mode);
  /* #ChannelEnd# |CAN1| #BusEnd# |ZCUD_CAN1| */
  //--- end generated part --- Block end #Footer_applPDUILStart#; do not delete this line! Add application code below this line.
  return ret;
}

dword applPDUILStop(dword busContext, dword busActive, dword mode)
{
  dword ret = 1;
  //--- begin generated part --- Block start #Hdr_applPDUILStop#; do not delete this line and do not add application code in this code block!
  /* #ChannelStart# |CAN1| #BusStart# |ZCUD_CAN1| */
  /* #ChannelEnd# |CAN1| #BusEnd# |ZCUD_CAN1| */
  //--- end generated part --- Block end #Hdr_applPDUILStop#; do not delete this line! Add application code below this line.
  //write("[%.6f %NODE_NAME%] applPDUILStop(0x%X, %d, %d)", TimeNowNS()/1e9, busContext, busActive, mode);
  //--- begin generated part --- Block start #Body_applPDUILStop#; do not delete this line and do not add application code in this code block!
  /* #ChannelStart# |CAN1| #BusStart# |ZCUD_CAN1| */
  StopSim(busContext, busActive, mode);
  /* #ChannelEnd# |CAN1| #BusEnd# |ZCUD_CAN1| */
  //--- end generated part --- Block end #Body_applPDUILStop#; do not delete this line! Add application code below this line.
  //--- begin generated part --- Block start #Footer_applPDUILStop#; do not delete this line and do not add application code in this code block!
  /* #ChannelStart# |CAN1| #BusStart# |ZCUD_CAN1| */
  /* #ChannelEnd# |CAN1| #BusEnd# |ZCUD_CAN1| */
  //--- end generated part --- Block end #Footer_applPDUILStop#; do not delete this line! Add application code below this line.
  return ret;
}

//--- begin generated part --- Block start <#Helper_Functions#> do not delete this line and do not add application code in this code block!
/* #ChannelStart# |CAN1| #BusStart# |ZCUD_CAN1| */
/* #ChannelEnd# |CAN1| #BusEnd# |ZCUD_CAN1| */
//--- end generated part --- Block end <#Helper_Functions#> do not delete this line! Add application code below this line.

//--- begin generated part --- Block start <#SysVar_Handler#> do not delete this line and do not add application code in this code block!
/* #ChannelStart# |CAN1| #BusStart# |ZCUD_CAN1| */
on sysvar_update sysvar::IL_CAN1::NODES::N_VectorSimulationNode::EnableNode
{
  ILCAN1_Enable(@this && @sysvar::IL_CAN1::enable_AllNodes);
}

on sysvar_update sysvar::IL_CAN1::enable_AllNodes
{
  ILCAN1_Enable(@this && @sysvar::IL_CAN1::NODES::N_VectorSimulationNode::EnableNode);
}

/* #ChannelEnd# |CAN1| #BusEnd# |ZCUD_CAN1| */
//--- end generated part --- Block end <#SysVar_Handler#> do not delete this line! Add application code below this line.

//--- begin generated part --- Block start <#MsgUpdateFcns#> do not delete this line and do not add application code in this code block!
/* #ChannelStart# |CAN1| #BusStart# |ZCUD_CAN1| */
/* #ChannelEnd# |CAN1| #BusEnd# |ZCUD_CAN1| */
//--- end generated part --- Block end <#MsgUpdateFcns#> do not delete this line! Add application code below this line.

